/* generated by ASAP2 Studio 1.8.10.6039 */
/* @@@@ File written by CANAPE_VERSION 17 0 31 @@@@ */ ASAP2_VERSION 1 71
/begin PROJECT New ""
/begin MODULE New ""
/begin MOD_PAR "" /end MOD_PAR
/begin MOD_COMMON "" BYTE_ORDER MSB_LAST ALIGNMENT_BYTE 1 ALIGNMENT_WORD 2 ALIGNMENT_LONG 4 ALIGNMENT_FLOAT16_IEEE 1 ALIGNMENT_FLOAT32_IEEE 4 ALIGNMENT_FLOAT64_IEEE 8 ALIGNMENT_INT64 8 /end MOD_COMMON
/begin IF_DATA XCP
 /begin PROTOCOL_LAYER 0x0100 0x07D0 0x2710 0x00 0x00 0x00 0x00 0x00 0x08 0x08 BYTE_ORDER_MSB_LAST ADDRESS_GRANULARITY_BYTE OPTIONAL_CMD GET_DAQ_PROCESSOR_INFO OPTIONAL_CMD UPLOAD OPTIONAL_CMD SET_MTA OPTIONAL_CMD GET_COMM_MODE_INFO COMMUNICATION_MODE_SUPPORTED BLOCK SLAVE MASTER 0x2B 0xC8 /end PROTOCOL_LAYER
 /begin DAQ DYNAMIC 0x00 0x00 0x00 OPTIMISATION_TYPE_DEFAULT ADDRESS_EXTENSION_FREE IDENTIFICATION_FIELD_TYPE_ABSOLUTE GRANULARITY_ODT_ENTRY_SIZE_DAQ_BYTE 0x04 OVERLOAD_INDICATION_PID PRESCALER_SUPPORTED /begin STIM GRANULARITY_ODT_ENTRY_SIZE_STIM_BYTE 0x00 /end STIM /begin TIMESTAMP_SUPPORTED 0x01 SIZE_WORD UNIT_1MS /end TIMESTAMP_SUPPORTED /end DAQ
 /begin PAG 0x00 /end PAG
 /begin PGM PGM_MODE_ABSOLUTE 0x00 0x00 /end PGM
 /begin XCP_ON_CAN 0x0100 CAN_ID_MASTER 0x0731 CAN_ID_SLAVE 0x0732 BAUDRATE 0x07A120 SAMPLE_POINT 0x4B SAMPLE_RATE SINGLE BTL_CYCLES 0x08 SJW 0x02 SYNC_EDGE SINGLE /end XCP_ON_CAN
/end IF_DATA
/begin CHARACTERISTIC rtARID_DEF_CpApAdcuRx100.PP_SG_mAdcuFaults_VDP_SG_mAdcuF "" VALUE 0x340EEEA0 __UBYTE_S 0 NO_COMPU_METHOD 0 255 FORMAT "%.15" /end CHARACTERISTIC
/begin CHARACTERISTIC rtARID_DEF_CpApAdcuRx100.PP_SG_mAdcuFaults_VDP_SG_mAdcuF.Flt_EPVMC_Cameras "" VALUE 0x340EEEA0 __UBYTE_S 0 NO_COMPU_METHOD 0 255 FORMAT "%.15" /end CHARACTERISTIC
/begin MEASUREMENT rtARID_DEF_CpApAdcuRx100.PP_SG_mExtLightsADRq_VDP_SG_mEx.HornCmd "" UBYTE NO_COMPU_METHOD 0 0 0 255 ECU_ADDRESS 0x340EEE94 FORMAT "%.15" /end MEASUREMENT
/begin MEASUREMENT rtARID_DEF_CpApAdcuRx100.PP_SG_mExtLightsADRq_VDP_SG_mEx.LightHazardCmd "" UBYTE NO_COMPU_METHOD 0 0 0 255 ECU_ADDRESS 0x340EEE95 FORMAT "%.15" /end MEASUREMENT
/begin MEASUREMENT rtARID_DEF_CpApAdcuRx100.PP_SG_mExtLightsADRq_VDP_SG_mEx.LightHighCmd "" UBYTE NO_COMPU_METHOD 0 0 0 255 ECU_ADDRESS 0x340EEE96 FORMAT "%.15" /end MEASUREMENT
/begin MEASUREMENT rtARID_DEF_CpApAdcuRx100.PP_SG_mExtLightsADRq_VDP_SG_mEx.LightTurnCmdL "" UBYTE NO_COMPU_METHOD 0 0 0 255 ECU_ADDRESS 0x340EEE97 FORMAT "%.15" /end MEASUREMENT
/begin MEASUREMENT rtARID_DEF_CpApAdcuRx100.PP_SG_mExtLightsADRq_VDP_SG_mEx.LightTurnCmdR "" UBYTE NO_COMPU_METHOD 0 0 0 255 ECU_ADDRESS 0x340EEE98 FORMAT "%.15" /end MEASUREMENT
/begin MEASUREMENT rtARID_DEF_CpApAdcuRx10000.PP_SG_mAdcuSwVer_VDP_SG_mAdcuSw.SwMaj "" UBYTE NO_COMPU_METHOD 0 0 0 255 ECU_ADDRESS 0x340EEEBC FORMAT "%.15" /end MEASUREMENT
/begin MEASUREMENT rtARID_DEF_CpApAdcuRx10000.PP_SG_mAdcuSwVer_VDP_SG_mAdcuSw.SwMin "" UBYTE NO_COMPU_METHOD 0 0 0 255 ECU_ADDRESS 0x340EEEBD FORMAT "%.15" /end MEASUREMENT
/begin MEASUREMENT rtARID_DEF_CpApAdcuRx10000.PP_SG_mAdcuSwVer_VDP_SG_mAdcuSw.SwRev "" UBYTE NO_COMPU_METHOD 0 0 0 255 ECU_ADDRESS 0x340EEEBE FORMAT "%.15" /end MEASUREMENT
/begin MEASUREMENT rtARID_DEF_CpApAdcuRx10000.PP_SG_mAdcuSwVer_VDP_SG_mAdcuSw.SwStat "" UBYTE NO_COMPU_METHOD 0 0 0 255 ECU_ADDRESS 0x340EEEBF FORMAT "%.15" /end MEASUREMENT
/begin MEASUREMENT rtARID_DEF_CpApAdcuRx20.PP_SG_mAdcuStat_VDP_SG_mAdcuSta.AD_Mission_Cmplt "" UBYTE NO_COMPU_METHOD 0 0 0 255 ECU_ADDRESS 0x340EEEDC FORMAT "%.15" /end MEASUREMENT
/begin MEASUREMENT rtARID_DEF_CpApAdcuRx20.PP_SG_mAdcuStat_VDP_SG_mAdcuSta.AD_Ready "" UBYTE NO_COMPU_METHOD 0 0 0 255 ECU_ADDRESS 0x340EEEDD FORMAT "%.15" /end MEASUREMENT
/begin MEASUREMENT rtARID_DEF_CpApAdcuRx20.PP_SG_mAdcuStat_VDP_SG_mAdcuSta.AdcuEstopRq "" UBYTE NO_COMPU_METHOD 0 0 0 255 ECU_ADDRESS 0x340EEEDE FORMAT "%.15" /end MEASUREMENT
/begin MEASUREMENT rtARID_DEF_CpApAdcuRx20.PP_SG_mAdcuStat_VDP_SG_mAdcuSta.AdcuShtdwnRdy "" UBYTE NO_COMPU_METHOD 0 0 0 255 ECU_ADDRESS 0x340EEEDF FORMAT "%.15" /end MEASUREMENT
/begin MEASUREMENT rtARID_DEF_CpApAdcuRx20.PP_SG_mAdcuStat_VDP_SG_mAdcuSta.AdcuStatus "" UBYTE NO_COMPU_METHOD 0 0 0 255 ECU_ADDRESS 0x340EEEE0 FORMAT "%.15" /end MEASUREMENT
/begin MEASUREMENT rtARID_DEF_CpApAdcuRx20.PP_SG_mAdcuStat_VDP_SG_mAdcuSta.MsgCntr "" UBYTE NO_COMPU_METHOD 0 0 0 255 ECU_ADDRESS 0x340EEEE1 FORMAT "%.15" /end MEASUREMENT
/begin MEASUREMENT rtARID_DEF_CpApAdcuRx20.PP_SG_mAdcuStat_VDP_SG_mAdcuSta.MsgCrc "" UBYTE NO_COMPU_METHOD 0 0 0 255 ECU_ADDRESS 0x340EEEE2 FORMAT "%.15" /end MEASUREMENT
/begin MEASUREMENT rtARID_DEF_CpApAdcuRx20.PP_SG_mAdcuStat_VDP_SG_mAdcuSta.TO_Assistance_Rq "" UBYTE NO_COMPU_METHOD 0 0 0 255 ECU_ADDRESS 0x340EEEE3 FORMAT "%.15" /end MEASUREMENT
/begin MEASUREMENT rtARID_DEF_CpApAdcuRx20.PP_SG_mVehCtrlADRq_VDP_SG_mVehC.AebEvent "" UBYTE NO_COMPU_METHOD 0 0 0 255 ECU_ADDRESS 0x340EEEC4 /end MEASUREMENT
/begin MEASUREMENT rtARID_DEF_CpApAdcuRx20.PP_SG_mVehCtrlADRq_VDP_SG_mVehC.AebSrc "" UBYTE NO_COMPU_METHOD 0 0 0 255 ECU_ADDRESS 0x340EEEC5 /end MEASUREMENT
/begin MEASUREMENT rtARID_DEF_CpApAdcuRx20.PP_SG_mVehCtrlADRq_VDP_SG_mVehC.MsgCntr "" UBYTE NO_COMPU_METHOD 0 0 0 255 ECU_ADDRESS 0x340EEEC7 /end MEASUREMENT
/begin MEASUREMENT rtARID_DEF_CpApAdcuRx20.PP_SG_mVehCtrlADRq_VDP_SG_mVehC.MsgCrc "" UBYTE NO_COMPU_METHOD 0 0 0 255 ECU_ADDRESS 0x340EEEC8 /end MEASUREMENT
/begin MEASUREMENT rtARID_DEF_CpApAdcuRx20.PP_SG_mVehCtrlADRq_VDP_SG_mVehC.VehAccelLongCmd "" FLOAT32_IEEE NO_COMPU_METHOD 0 0 -3.40282346639E+38 3.40282346639E+38 ECU_ADDRESS 0x340EEECC /end MEASUREMENT
/begin MEASUREMENT rtARID_DEF_CpApAdcuRx20.PP_SG_mVehCtrlADRq_VDP_SG_mVehC.VehDirCmd "" UBYTE NO_COMPU_METHOD 0 0 0 255 ECU_ADDRESS 0x340EEED0 /end MEASUREMENT
/begin MEASUREMENT rtARID_DEF_CpApAdcuRx20.PP_SG_mVehCtrlADRq_VDP_SG_mVehC.VehRoadWhlAngleCmd "" FLOAT32_IEEE NO_COMPU_METHOD 0 0 -3.40282346639E+38 3.40282346639E+38 ECU_ADDRESS 0x340EEED4 /end MEASUREMENT
/begin MEASUREMENT rtARID_DEF_CpApAdcuRx20.PP_SG_mVehCtrlADRq_VDP_SG_mVehC.VehSpdCmd "" FLOAT32_IEEE NO_COMPU_METHOD 0 0 -3.40282346639E+38 3.40282346639E+38 ECU_ADDRESS 0x340EEED8 /end MEASUREMENT
/begin MEASUREMENT rtARID_DEF_CpApAdcuRx20.PP_SG_mVehCtrlADRq_VDP_SG_mVehC.b_High_Deceleration_Flag "" UBYTE NO_COMPU_METHOD 0 0 0 255 ECU_ADDRESS 0x340EEEC6 /end MEASUREMENT
/begin MEASUREMENT rtARID_DEF_CpApAvasRx500.PP_SG_mAVAS_Stat_VDP_SG_mAVAS_S.AVAS_E2E_Fault "" UBYTE NO_COMPU_METHOD 0 0 0 255 ECU_ADDRESS 0x340EEF90 FORMAT "%.15" /end MEASUREMENT
/begin MEASUREMENT rtARID_DEF_CpApAvasRx500.PP_SG_mAVAS_Stat_VDP_SG_mAVAS_S.AVAS_LoC "" UBYTE NO_COMPU_METHOD 0 0 0 255 ECU_ADDRESS 0x340EEF91 FORMAT "%.15" /end MEASUREMENT
/begin MEASUREMENT rtARID_DEF_CpApAvasRx500.PP_SG_mAVAS_Stat_VDP_SG_mAVAS_S.HwMaj "" UBYTE NO_COMPU_METHOD 0 0 0 255 ECU_ADDRESS 0x340EEF92 FORMAT "%.15" /end MEASUREMENT
/begin MEASUREMENT rtARID_DEF_CpApAvasRx500.PP_SG_mAVAS_Stat_VDP_SG_mAVAS_S.HwMin "" UBYTE NO_COMPU_METHOD 0 0 0 255 ECU_ADDRESS 0x340EEF93 FORMAT "%.15" /end MEASUREMENT
/begin MEASUREMENT rtARID_DEF_CpApAvasRx500.PP_SG_mAVAS_Stat_VDP_SG_mAVAS_S.MsgCntr "" UBYTE NO_COMPU_METHOD 0 0 0 255 ECU_ADDRESS 0x340EEF94 FORMAT "%.15" /end MEASUREMENT
/begin MEASUREMENT rtARID_DEF_CpApAvasRx500.PP_SG_mAVAS_Stat_VDP_SG_mAVAS_S.MsgCrc "" UBYTE NO_COMPU_METHOD 0 0 0 255 ECU_ADDRESS 0x340EEF95 FORMAT "%.15" /end MEASUREMENT
/begin MEASUREMENT rtARID_DEF_CpApAvasRx500.PP_SG_mAVAS_Stat_VDP_SG_mAVAS_S.SwMaj "" UBYTE NO_COMPU_METHOD 0 0 0 255 ECU_ADDRESS 0x340EEF96 FORMAT "%.15" /end MEASUREMENT
/begin MEASUREMENT rtARID_DEF_CpApAvasRx500.PP_SG_mAVAS_Stat_VDP_SG_mAVAS_S.SwMin "" UBYTE NO_COMPU_METHOD 0 0 0 255 ECU_ADDRESS 0x340EEF97 FORMAT "%.15" /end MEASUREMENT
/begin MEASUREMENT rtARID_DEF_CpApCgmRx1000.PP_SG_mFMS_PTT_Sched_VDP_SG_mFM.PTT_48VSysChk "" UBYTE NO_COMPU_METHOD 0 0 0 255 ECU_ADDRESS 0x340EEFE0 FORMAT "%.15" /end MEASUREMENT
/begin MEASUREMENT rtARID_DEF_CpApCgmRx1000.PP_SG_mFMS_PTT_Sched_VDP_SG_mFM.PTT_AudioAlertsChk "" UBYTE NO_COMPU_METHOD 0 0 0 255 ECU_ADDRESS 0x340EEFE1 FORMAT "%.15" /end MEASUREMENT
/begin MEASUREMENT rtARID_DEF_CpApCgmRx1000.PP_SG_mFMS_PTT_Sched_VDP_SG_mFM.PTT_BrkChk "" UBYTE NO_COMPU_METHOD 0 0 0 255 ECU_ADDRESS 0x340EEFE2 FORMAT "%.15" /end MEASUREMENT
/begin MEASUREMENT rtARID_DEF_CpApCgmRx1000.PP_SG_mFMS_PTT_Sched_VDP_SG_mFM.PTT_EpbChk "" UBYTE NO_COMPU_METHOD 0 0 0 255 ECU_ADDRESS 0x340EEFE3 FORMAT "%.15" /end MEASUREMENT
/begin MEASUREMENT rtARID_DEF_CpApCgmRx1000.PP_SG_mFMS_PTT_Sched_VDP_SG_mFM.PTT_ExtLightChk "" UBYTE NO_COMPU_METHOD 0 0 0 255 ECU_ADDRESS 0x340EEFE4 FORMAT "%.15" /end MEASUREMENT
/begin MEASUREMENT rtARID_DEF_CpApCgmRx1000.PP_SG_mFMS_PTT_Sched_VDP_SG_mFM.PTT_SteerSysChk "" UBYTE NO_COMPU_METHOD 0 0 0 255 ECU_ADDRESS 0x340EEFE5 FORMAT "%.15" /end MEASUREMENT
/begin MEASUREMENT rtARID_DEF_CpApCgmRx20.PP_SG_mVehCtrlTORq_VDP_SG_mVehC.MsgCntr "" UBYTE NO_COMPU_METHOD 0 0 0 255 ECU_ADDRESS 0x340EEFEC FORMAT "%.15" /end MEASUREMENT
/begin MEASUREMENT rtARID_DEF_CpApCgmRx20.PP_SG_mVehCtrlTORq_VDP_SG_mVehC.MsgCrc "" UBYTE NO_COMPU_METHOD 0 0 0 255 ECU_ADDRESS 0x340EEFED FORMAT "%.15" /end MEASUREMENT
/begin MEASUREMENT rtARID_DEF_CpApCgmRx20.PP_SG_mVehCtrlTORq_VDP_SG_mVehC.TO_Accel_Cmd "" FLOAT32_IEEE NO_COMPU_METHOD 0 0 -3.40282346639E+38 3.40282346639E+38 ECU_ADDRESS 0x340EEFF0 FORMAT "%.15" /end MEASUREMENT
/begin MEASUREMENT rtARID_DEF_CpApCgmRx20.PP_SG_mVehCtrlTORq_VDP_SG_mVehC.TO_EstopRq "" UBYTE NO_COMPU_METHOD 0 0 0 255 ECU_ADDRESS 0x340EEFF4 FORMAT "%.15" /end MEASUREMENT
/begin MEASUREMENT rtARID_DEF_CpApCgmRx20.PP_SG_mVehCtrlTORq_VDP_SG_mVehC.TO_Steer_Cmd "" FLOAT32_IEEE NO_COMPU_METHOD 0 0 -3.40282346639E+38 3.40282346639E+38 ECU_ADDRESS 0x340EEFF8 FORMAT "%.15" /end MEASUREMENT
/begin MEASUREMENT rtARID_DEF_CpApCgmRx500.PP_SG_mBECargoPIN_VDP_SG_mBECar.tripCargoDoorOnePin "" ULONG NO_COMPU_METHOD 0 0 0 4294967295 ECU_ADDRESS 0x340EF020 FORMAT "%.15" /end MEASUREMENT
/begin MEASUREMENT rtARID_DEF_CpApCgmRx500.PP_SG_mBECargoPIN_VDP_SG_mBECar.tripCargoDoorTwoPin "" ULONG NO_COMPU_METHOD 0 0 0 4294967295 ECU_ADDRESS 0x340EF024 FORMAT "%.15" /end MEASUREMENT
/begin MEASUREMENT rtARID_DEF_CpApCgmRx500.PP_SG_mBECmd_VDP_SG_mBECmd.AllowDeliveryMode "" UBYTE NO_COMPU_METHOD 0 0 0 255 ECU_ADDRESS 0x340EF008 FORMAT "%.15" /end MEASUREMENT
/begin MEASUREMENT rtARID_DEF_CpApCgmRx500.PP_SG_mBECmd_VDP_SG_mBECmd.BETripMeterReset "" UBYTE NO_COMPU_METHOD 0 0 0 255 ECU_ADDRESS 0x340EF00D FORMAT "%.15" /end MEASUREMENT
/begin MEASUREMENT rtARID_DEF_CpApCgmRx500.PP_SG_mBECmd_VDP_SG_mBECmd.BETripMeterStart "" UBYTE NO_COMPU_METHOD 0 0 0 255 ECU_ADDRESS 0x340EF00E FORMAT "%.15" /end MEASUREMENT
/begin MEASUREMENT rtARID_DEF_CpApCgmRx500.PP_SG_mBECmd_VDP_SG_mBECmd.Bay1DoorRemoteCmd "" UBYTE NO_COMPU_METHOD 0 0 0 255 ECU_ADDRESS 0x340EF009 FORMAT "%.15" /end MEASUREMENT
/begin MEASUREMENT rtARID_DEF_CpApCgmRx500.PP_SG_mBECmd_VDP_SG_mBECmd.Bay1HtrRemoteCmd "" UBYTE NO_COMPU_METHOD 0 0 0 255 ECU_ADDRESS 0x340EF00A FORMAT "%.15" /end MEASUREMENT
/begin MEASUREMENT rtARID_DEF_CpApCgmRx500.PP_SG_mBECmd_VDP_SG_mBECmd.Bay2DoorRemoteCmd "" UBYTE NO_COMPU_METHOD 0 0 0 255 ECU_ADDRESS 0x340EF00B FORMAT "%.15" /end MEASUREMENT
/begin MEASUREMENT rtARID_DEF_CpApCgmRx500.PP_SG_mBECmd_VDP_SG_mBECmd.Bay2HtrRemoteCmd "" UBYTE NO_COMPU_METHOD 0 0 0 255 ECU_ADDRESS 0x340EF00C FORMAT "%.15" /end MEASUREMENT
/begin MEASUREMENT rtARID_DEF_CpApCgmRx500.PP_SG_mBECmd_VDP_SG_mBECmd.MsgCntr "" UBYTE NO_COMPU_METHOD 0 0 0 255 ECU_ADDRESS 0x340EF010 FORMAT "%.15" /end MEASUREMENT
/begin MEASUREMENT rtARID_DEF_CpApCgmRx500.PP_SG_mBECmd_VDP_SG_mBECmd.MsgCrc "" UBYTE NO_COMPU_METHOD 0 0 0 255 ECU_ADDRESS 0x340EF011 FORMAT "%.15" /end MEASUREMENT
/begin MEASUREMENT rtARID_DEF_CpApCgmRx500.PP_SG_mBECmd_VDP_SG_mBECmd.jobType "" UBYTE NO_COMPU_METHOD 0 0 0 255 ECU_ADDRESS 0x340EF00F FORMAT "%.15" /end MEASUREMENT
/begin MEASUREMENT rtARID_DEF_CpApCgmRx500.PP_SG_mBECmd_VDP_SG_mBECmd.tripIsActive "" UBYTE NO_COMPU_METHOD 0 0 0 255 ECU_ADDRESS 0x340EF012 FORMAT "%.15" /end MEASUREMENT
/begin MEASUREMENT rtARID_DEF_CpApCgmRx500.PP_SG_mCgmFaults_VDP_SG_mCgmFau.adcu_grpc_bridge_fault "" UBYTE NO_COMPU_METHOD 0 0 0 255 ECU_ADDRESS 0x340EF013 FORMAT "%.15" /end MEASUREMENT
/begin MEASUREMENT rtARID_DEF_CpApCgmRx500.PP_SG_mCgmFaults_VDP_SG_mCgmFau.adcu_ros_bridge_fault "" UBYTE NO_COMPU_METHOD 0 0 0 255 ECU_ADDRESS 0x340EF014 FORMAT "%.15" /end MEASUREMENT
/begin MEASUREMENT rtARID_DEF_CpApCgmRx500.PP_SG_mCgmFaults_VDP_SG_mCgmFau.fms_connection_fault "" UBYTE NO_COMPU_METHOD 0 0 0 255 ECU_ADDRESS 0x340EF015 FORMAT "%.15" /end MEASUREMENT
/begin MEASUREMENT rtARID_DEF_CpApCgmRx500.PP_SG_mCgmFaults_VDP_SG_mCgmFau.gps_sensor_fault "" UBYTE NO_COMPU_METHOD 0 0 0 255 ECU_ADDRESS 0x340EF016 FORMAT "%.15" /end MEASUREMENT
/begin MEASUREMENT rtARID_DEF_CpApCgmRx500.PP_SG_mCgmFaults_VDP_SG_mCgmFau.modem_telematics_fault "" UBYTE NO_COMPU_METHOD 0 0 0 255 ECU_ADDRESS 0x340EF017 FORMAT "%.15" /end MEASUREMENT
/begin MEASUREMENT rtARID_DEF_CpApCgmRx500.PP_SG_mCgmFaults_VDP_SG_mCgmFau.modem_teleops_1_fault "" UBYTE NO_COMPU_METHOD 0 0 0 255 ECU_ADDRESS 0x340EF018 FORMAT "%.15" /end MEASUREMENT
/begin MEASUREMENT rtARID_DEF_CpApCgmRx500.PP_SG_mCgmFaults_VDP_SG_mCgmFau.modem_teleops_2_fault "" UBYTE NO_COMPU_METHOD 0 0 0 255 ECU_ADDRESS 0x340EF019 FORMAT "%.15" /end MEASUREMENT
/begin MEASUREMENT rtARID_DEF_CpApCgmRx500.PP_SG_mCgmFaults_VDP_SG_mCgmFau.modem_teleops_3_fault "" UBYTE NO_COMPU_METHOD 0 0 0 255 ECU_ADDRESS 0x340EF01A FORMAT "%.15" /end MEASUREMENT
/begin MEASUREMENT rtARID_DEF_CpApCgmRx500.PP_SG_mCgmFaults_VDP_SG_mCgmFau.to_connection_fault "" UBYTE NO_COMPU_METHOD 0 0 0 255 ECU_ADDRESS 0x340EF01B FORMAT "%.15" /end MEASUREMENT
/begin MEASUREMENT rtARID_DEF_CpApCgmRx500.PP_SG_mCgmFaults_VDP_SG_mCgmFau.vcu_connection_fault "" UBYTE NO_COMPU_METHOD 0 0 0 255 ECU_ADDRESS 0x340EF01C FORMAT "%.15" /end MEASUREMENT
/begin MEASUREMENT rtARID_DEF_CpApCgmRx500.PP_SG_mCgmHeartbeat_VDP_SG_mCgm.nanoseconds "" ULONG NO_COMPU_METHOD 0 0 0 4294967295 ECU_ADDRESS 0x340EF028 FORMAT "%.15" /end MEASUREMENT
/begin MEASUREMENT rtARID_DEF_CpApCgmRx500.PP_SG_mCgmHeartbeat_VDP_SG_mCgm.seconds "" SLONG NO_COMPU_METHOD 0 0 -2147483648 2147483647 ECU_ADDRESS 0x340EF02C FORMAT "%.15" /end MEASUREMENT
/begin MEASUREMENT rtARID_DEF_CpApCgmRx500.PP_SG_mCgmSwVer_VDP_SG_mCgmSwVe.SwMaj "" UBYTE NO_COMPU_METHOD 0 0 0 255 ECU_ADDRESS 0x340EF03E FORMAT "%.15" /end MEASUREMENT
/begin MEASUREMENT rtARID_DEF_CpApCgmRx500.PP_SG_mCgmSwVer_VDP_SG_mCgmSwVe.SwMin "" UBYTE NO_COMPU_METHOD 0 0 0 255 ECU_ADDRESS 0x340EF03F FORMAT "%.15" /end MEASUREMENT
/begin MEASUREMENT rtARID_DEF_CpApCgmRx500.PP_SG_mCgmSwVer_VDP_SG_mCgmSwVe.SwRev "" UBYTE NO_COMPU_METHOD 0 0 0 255 ECU_ADDRESS 0x340EF040 FORMAT "%.15" /end MEASUREMENT
/begin MEASUREMENT rtARID_DEF_CpApCgmRx500.PP_SG_mCgmSwVer_VDP_SG_mCgmSwVe.SwStat "" UBYTE NO_COMPU_METHOD 0 0 0 255 ECU_ADDRESS 0x340EF041 FORMAT "%.15" /end MEASUREMENT
/begin MEASUREMENT rtARID_DEF_CpApCgmRx500.PP_SG_mExtLightsTORq_VDP_SG_mEx.HornCmd "" UBYTE NO_COMPU_METHOD 0 0 0 255 ECU_ADDRESS 0x340EF030 FORMAT "%.15" /end MEASUREMENT
/begin MEASUREMENT rtARID_DEF_CpApCgmRx500.PP_SG_mExtLightsTORq_VDP_SG_mEx.LightHazardCmd "" UBYTE NO_COMPU_METHOD 0 0 0 255 ECU_ADDRESS 0x340EF031 FORMAT "%.15" /end MEASUREMENT
/begin MEASUREMENT rtARID_DEF_CpApCgmRx500.PP_SG_mExtLightsTORq_VDP_SG_mEx.LightHighCmd "" UBYTE NO_COMPU_METHOD 0 0 0 255 ECU_ADDRESS 0x340EF032 FORMAT "%.15" /end MEASUREMENT
/begin MEASUREMENT rtARID_DEF_CpApCgmRx500.PP_SG_mExtLightsTORq_VDP_SG_mEx.LightTurnCmdL "" UBYTE NO_COMPU_METHOD 0 0 0 255 ECU_ADDRESS 0x340EF033 FORMAT "%.15" /end MEASUREMENT
/begin MEASUREMENT rtARID_DEF_CpApCgmRx500.PP_SG_mExtLightsTORq_VDP_SG_mEx.LightTurnCmdR "" UBYTE NO_COMPU_METHOD 0 0 0 255 ECU_ADDRESS 0x340EF034 FORMAT "%.15" /end MEASUREMENT
/begin MEASUREMENT rtARID_DEF_CpApCgmRx500.PP_SG_mExtLightsTORq_VDP_SG_mEx.MsgCntr "" UBYTE NO_COMPU_METHOD 0 0 0 255 ECU_ADDRESS 0x340EF035 FORMAT "%.15" /end MEASUREMENT
/begin MEASUREMENT rtARID_DEF_CpApCgmRx500.PP_SG_mExtLightsTORq_VDP_SG_mEx.MsgCrc "" UBYTE NO_COMPU_METHOD 0 0 0 255 ECU_ADDRESS 0x340EF036 FORMAT "%.15" /end MEASUREMENT
/begin MEASUREMENT rtARID_DEF_CpApCgmRx500.PP_SG_mTOStat_VDP_SG_mTOStat.MsgCntr "" UBYTE NO_COMPU_METHOD 0 0 0 255 ECU_ADDRESS 0x340EF037 FORMAT "%.15" /end MEASUREMENT
/begin MEASUREMENT rtARID_DEF_CpApCgmRx500.PP_SG_mTOStat_VDP_SG_mTOStat.MsgCrc "" UBYTE NO_COMPU_METHOD 0 0 0 255 ECU_ADDRESS 0x340EF038 FORMAT "%.15" /end MEASUREMENT
/begin MEASUREMENT rtARID_DEF_CpApCgmRx500.PP_SG_mTOStat_VDP_SG_mTOStat.TO_ConnectionStat "" UBYTE NO_COMPU_METHOD 0 0 0 255 ECU_ADDRESS 0x340EF03A FORMAT "%.15" /end MEASUREMENT
/begin MEASUREMENT rtARID_DEF_CpApCgmRx500.PP_SG_mTOStat_VDP_SG_mTOStat.TO_cmd_veh_mode "" UBYTE NO_COMPU_METHOD 0 0 0 255 ECU_ADDRESS 0x340EF039 FORMAT "%.15" /end MEASUREMENT
/begin MEASUREMENT rtARID_DEF_CpApCgmRx500.PP_SG_mTOStat_VDP_SG_mTOStat.TO_dlg_resp_code "" UBYTE NO_COMPU_METHOD 0 0 0 255 ECU_ADDRESS 0x340EF03B FORMAT "%.15" /end MEASUREMENT
/begin MEASUREMENT rtARID_DEF_CpApCgmRx500.PP_SG_mTOStat_VDP_SG_mTOStat.TO_dlg_resp_id "" UBYTE NO_COMPU_METHOD 0 0 0 255 ECU_ADDRESS 0x340EF03C FORMAT "%.15" /end MEASUREMENT
/begin MEASUREMENT rtARID_DEF_CpApCgmRx500.PP_SG_mTOStat_VDP_SG_mTOStat.VehDirCmd "" UBYTE NO_COMPU_METHOD 0 0 0 255 ECU_ADDRESS 0x340EF03D FORMAT "%.15" /end MEASUREMENT
/begin MEASUREMENT rtARID_DEF_CpApEbcm1URx10.PP_SG_mEbcm1U_BrkPress2_VDP_SG_.MsgCntr "" UBYTE NO_COMPU_METHOD 0 0 0 255 ECU_ADDRESS 0x340EF08C FORMAT "%.15" /end MEASUREMENT
/begin MEASUREMENT rtARID_DEF_CpApEbcm1URx10.PP_SG_mEbcm1U_BrkPress2_VDP_SG_.MsgCrc "" UBYTE NO_COMPU_METHOD 0 0 0 255 ECU_ADDRESS 0x340EF08D FORMAT "%.15" /end MEASUREMENT
/begin MEASUREMENT rtARID_DEF_CpApEbcm1URx10.PP_SG_mEbcm1U_BrkPress2_VDP_SG_.PrsrEstMstCyl "" FLOAT32_IEEE NO_COMPU_METHOD 0 0 -3.40282346639E+38 3.40282346639E+38 ECU_ADDRESS 0x340EF090 FORMAT "%.15" /end MEASUREMENT
/begin MEASUREMENT rtARID_DEF_CpApEbcm1URx10.PP_SG_mEbcm1U_BrkPress2_VDP_SG_.PrsrEstMstrCylValid "" UBYTE NO_COMPU_METHOD 0 0 0 255 ECU_ADDRESS 0x340EF094 FORMAT "%.15" /end MEASUREMENT
/begin MEASUREMENT rtARID_DEF_CpApEbcm1URx10.PP_SG_mEbcm1U_BrkPress2_VDP_SG_.PrsrFrontWCP "" FLOAT32_IEEE NO_COMPU_METHOD 0 0 -3.40282346639E+38 3.40282346639E+38 ECU_ADDRESS 0x340EF098 FORMAT "%.15" /end MEASUREMENT
/begin MEASUREMENT rtARID_DEF_CpApEbcm1URx10.PP_SG_mEbcm1U_BrkPress2_VDP_SG_.PrsrRearWCP "" FLOAT32_IEEE NO_COMPU_METHOD 0 0 -3.40282346639E+38 3.40282346639E+38 ECU_ADDRESS 0x340EF09C FORMAT "%.15" /end MEASUREMENT
/begin MEASUREMENT rtARID_DEF_CpApEbcm1URx10000.PP_SG_mEbcm1U_SwVer_VDP_SG_mEbc.SwVerMaj "" UBYTE NO_COMPU_METHOD 0 0 0 255 ECU_ADDRESS 0x340EF0A0 FORMAT "%.15" /end MEASUREMENT
/begin MEASUREMENT rtARID_DEF_CpApEbcm1URx10000.PP_SG_mEbcm1U_SwVer_VDP_SG_mEbc.SwVerMin "" UBYTE NO_COMPU_METHOD 0 0 0 255 ECU_ADDRESS 0x340EF0A1 FORMAT "%.15" /end MEASUREMENT
/begin MEASUREMENT rtARID_DEF_CpApEbcm1URx10000.PP_SG_mEbcm1U_SwVer_VDP_SG_mEbc.SwVerRev "" UBYTE NO_COMPU_METHOD 0 0 0 255 ECU_ADDRESS 0x340EF0A2 FORMAT "%.15" /end MEASUREMENT
/begin MEASUREMENT rtARID_DEF_CpApEbcm1URx10000.PP_SG_mEbcm1U_SwVer_VDP_SG_mEbc.SwVerStat "" UBYTE NO_COMPU_METHOD 0 0 0 255 ECU_ADDRESS 0x340EF0A3 FORMAT "%.15" /end MEASUREMENT
/begin MEASUREMENT rtARID_DEF_CpApEbcm1URx20.PP_SG_mEbcm1U_Stat2_VDP_SG_mEbc "" UBYTE NO_COMPU_METHOD 0 0 0 255 ECU_ADDRESS 0x340EF0C8 FORMAT "%.15" /end MEASUREMENT
/begin MEASUREMENT rtARID_DEF_CpApEbcm1URx20.PP_SG_mEbcm1U_Stat2_VDP_SG_mEbc.HoldStat "" UBYTE NO_COMPU_METHOD 0 0 0 255 ECU_ADDRESS 0x340EF0C8 FORMAT "%.15" /end MEASUREMENT
/begin MEASUREMENT rtARID_DEF_CpApEbcm1URx20.PP_SG_mEbcm1U_Stat2_VDP_SG_mEbc.LvVolt "" FLOAT32_IEEE NO_COMPU_METHOD 0 0 -3.40282346639E+38 3.40282346639E+38 ECU_ADDRESS 0x340EF0CC FORMAT "%.15" /end MEASUREMENT
/begin MEASUREMENT rtARID_DEF_CpApEbcm1URx20.PP_SG_mEbcm1U_Stat2_VDP_SG_mEbc.MsgCntr "" UBYTE NO_COMPU_METHOD 0 0 0 255 ECU_ADDRESS 0x340EF0D0 FORMAT "%.15" /end MEASUREMENT
/begin MEASUREMENT rtARID_DEF_CpApEbcm1URx20.PP_SG_mEbcm1U_Stat2_VDP_SG_mEbc.MsgCrc "" UBYTE NO_COMPU_METHOD 0 0 0 255 ECU_ADDRESS 0x340EF0D1 FORMAT "%.15" /end MEASUREMENT
/begin MEASUREMENT rtARID_DEF_CpApEbcm1URx20.PP_SG_mEbcm1U_Stat2_VDP_SG_mEbc.MtrCurrEst "" UBYTE NO_COMPU_METHOD 0 0 0 255 ECU_ADDRESS 0x340EF0D2 FORMAT "%.15" /end MEASUREMENT
/begin MEASUREMENT rtARID_DEF_CpApEbcm1URx20.PP_SG_mEbcm1U_Stat2_VDP_SG_mEbc.ToShtdwn "" UBYTE NO_COMPU_METHOD 0 0 0 255 ECU_ADDRESS 0x340EF0D3 FORMAT "%.15" /end MEASUREMENT
/begin MEASUREMENT rtARID_DEF_CpApEbcm1URx20.PP_SG_mEbcm1U_Stat_VDP_SG_mEbcm.AutoBrkEngd "" UBYTE NO_COMPU_METHOD 0 0 0 255 ECU_ADDRESS 0x340EF0A8 FORMAT "%.15" /end MEASUREMENT
/begin MEASUREMENT rtARID_DEF_CpApEbcm1URx20.PP_SG_mEbcm1U_Stat_VDP_SG_mEbcm.BrkFluidLevSns_EBCM1 "" UBYTE NO_COMPU_METHOD 0 0 0 255 ECU_ADDRESS 0x340EF0A9 FORMAT "%.15" /end MEASUREMENT
/begin MEASUREMENT rtARID_DEF_CpApEbcm1URx20.PP_SG_mEbcm1U_Stat_VDP_SG_mEbcm.EbcmControllerID "" UBYTE NO_COMPU_METHOD 0 0 0 255 ECU_ADDRESS 0x340EF0AA FORMAT "%.15" /end MEASUREMENT
/begin MEASUREMENT rtARID_DEF_CpApEbcm1URx20.PP_SG_mEbcm1U_Stat_VDP_SG_mEbcm.EbcmRdy "" UBYTE NO_COMPU_METHOD 0 0 0 255 ECU_ADDRESS 0x340EF0AB FORMAT "%.15" /end MEASUREMENT
/begin MEASUREMENT rtARID_DEF_CpApEbcm1URx20.PP_SG_mEbcm1U_Stat_VDP_SG_mEbcm.EbcmShtdwnRdy "" UBYTE NO_COMPU_METHOD 0 0 0 255 ECU_ADDRESS 0x340EF0AC FORMAT "%.15" /end MEASUREMENT
/begin MEASUREMENT rtARID_DEF_CpApEbcm1URx20.PP_SG_mEbcm1U_Stat_VDP_SG_mEbcm.Flt_12vCtrl "" UBYTE NO_COMPU_METHOD 0 0 0 255 ECU_ADDRESS 0x340EF0AD FORMAT "%.15" /end MEASUREMENT
/begin MEASUREMENT rtARID_DEF_CpApEbcm1URx20.PP_SG_mEbcm1U_Stat_VDP_SG_mEbcm.Flt_12vMtr "" UBYTE NO_COMPU_METHOD 0 0 0 255 ECU_ADDRESS 0x340EF0AE FORMAT "%.15" /end MEASUREMENT
/begin MEASUREMENT rtARID_DEF_CpApEbcm1URx20.PP_SG_mEbcm1U_Stat_VDP_SG_mEbcm.Flt_CanWhlSpdFL "" UBYTE NO_COMPU_METHOD 0 0 0 255 ECU_ADDRESS 0x340EF0AF FORMAT "%.15" /end MEASUREMENT
/begin MEASUREMENT rtARID_DEF_CpApEbcm1URx20.PP_SG_mEbcm1U_Stat_VDP_SG_mEbcm.Flt_CanWhlSpdFR "" UBYTE NO_COMPU_METHOD 0 0 0 255 ECU_ADDRESS 0x340EF0B0 FORMAT "%.15" /end MEASUREMENT
/begin MEASUREMENT rtARID_DEF_CpApEbcm1URx20.PP_SG_mEbcm1U_Stat_VDP_SG_mEbcm.Flt_CanWhlSpdR "" UBYTE NO_COMPU_METHOD 0 0 0 255 ECU_ADDRESS 0x340EF0B1 FORMAT "%.15" /end MEASUREMENT
/begin MEASUREMENT rtARID_DEF_CpApEbcm1URx20.PP_SG_mEbcm1U_Stat_VDP_SG_mEbcm.Flt_Critical "" UBYTE NO_COMPU_METHOD 0 0 0 255 ECU_ADDRESS 0x340EF0B2 FORMAT "%.15" /end MEASUREMENT
/begin MEASUREMENT rtARID_DEF_CpApEbcm1URx20.PP_SG_mEbcm1U_Stat_VDP_SG_mEbcm.Flt_Hold "" UBYTE NO_COMPU_METHOD 0 0 0 255 ECU_ADDRESS 0x340EF0B3 FORMAT "%.15" /end MEASUREMENT
/begin MEASUREMENT rtARID_DEF_CpApEbcm1URx20.PP_SG_mEbcm1U_Stat_VDP_SG_mEbcm.Flt_MtrTmpr "" UBYTE NO_COMPU_METHOD 0 0 0 255 ECU_ADDRESS 0x340EF0B5 FORMAT "%.15" /end MEASUREMENT
/begin MEASUREMENT rtARID_DEF_CpApEbcm1URx20.PP_SG_mEbcm1U_Stat_VDP_SG_mEbcm.Flt_mBrkCtrl "" UBYTE NO_COMPU_METHOD 0 0 0 255 ECU_ADDRESS 0x340EF0B4 FORMAT "%.15" /end MEASUREMENT
/begin MEASUREMENT rtARID_DEF_CpApEbcm1URx20.PP_SG_mEbcm1U_Stat_VDP_SG_mEbcm.Flt_mVcuImuAngVel "" UBYTE NO_COMPU_METHOD 0 0 0 255 ECU_ADDRESS 0x340EF0B6 FORMAT "%.15" /end MEASUREMENT
/begin MEASUREMENT rtARID_DEF_CpApEbcm1URx20.PP_SG_mEbcm1U_Stat_VDP_SG_mEbcm.Flt_mVcuImuLinAccel "" UBYTE NO_COMPU_METHOD 0 0 0 255 ECU_ADDRESS 0x340EF0B7 FORMAT "%.15" /end MEASUREMENT
/begin MEASUREMENT rtARID_DEF_CpApEbcm1URx20.PP_SG_mEbcm1U_Stat_VDP_SG_mEbcm.Flt_mVehState "" UBYTE NO_COMPU_METHOD 0 0 0 255 ECU_ADDRESS 0x340EF0B8 FORMAT "%.15" /end MEASUREMENT
/begin MEASUREMENT rtARID_DEF_CpApEbcm1URx20.PP_SG_mEbcm1U_Stat_VDP_SG_mEbcm.Flt_mVehState2 "" UBYTE NO_COMPU_METHOD 0 0 0 255 ECU_ADDRESS 0x340EF0B9 FORMAT "%.15" /end MEASUREMENT
/begin MEASUREMENT rtARID_DEF_CpApEbcm1URx20.PP_SG_mEbcm1U_Stat_VDP_SG_mEbcm.Flt_mWhdCtrl "" UBYTE NO_COMPU_METHOD 0 0 0 255 ECU_ADDRESS 0x340EF0BA FORMAT "%.15" /end MEASUREMENT
/begin MEASUREMENT rtARID_DEF_CpApEbcm1URx20.PP_SG_mEbcm1U_Stat_VDP_SG_mEbcm.Flt_mWhdStat "" UBYTE NO_COMPU_METHOD 0 0 0 255 ECU_ADDRESS 0x340EF0BB FORMAT "%.15" /end MEASUREMENT
/begin MEASUREMENT rtARID_DEF_CpApEbcm1URx20.PP_SG_mEbcm1U_Stat_VDP_SG_mEbcm.MsgCntr "" UBYTE NO_COMPU_METHOD 0 0 0 255 ECU_ADDRESS 0x340EF0BC FORMAT "%.15" /end MEASUREMENT
/begin MEASUREMENT rtARID_DEF_CpApEbcm1URx20.PP_SG_mEbcm1U_Stat_VDP_SG_mEbcm.MsgCrc "" UBYTE NO_COMPU_METHOD 0 0 0 255 ECU_ADDRESS 0x340EF0BD FORMAT "%.15" /end MEASUREMENT
/begin MEASUREMENT rtARID_DEF_CpApEbcm1URx20.PP_SG_mEbcm1U_Stat_VDP_SG_mEbcm.MtrTmprEst "" FLOAT32_IEEE NO_COMPU_METHOD 0 0 -3.40282346639E+38 3.40282346639E+38 ECU_ADDRESS 0x340EF0C0 FORMAT "%.15" /end MEASUREMENT
/begin MEASUREMENT rtARID_DEF_CpApEbcm1URx20.PP_SG_mEbcm1U_Stat_VDP_SG_mEbcm.WakeStat "" UBYTE NO_COMPU_METHOD 0 0 0 255 ECU_ADDRESS 0x340EF0C4 FORMAT "%.15" /end MEASUREMENT
/begin MEASUREMENT rtARID_DEF_CpApEbcm1URx20.PP_SG_mEbcm1U_Stat_VDP_SG_mEbcm.Warn_MtrTmpr "" UBYTE NO_COMPU_METHOD 0 0 0 255 ECU_ADDRESS 0x340EF0C5 FORMAT "%.15" /end MEASUREMENT
/begin MEASUREMENT rtARID_DEF_CpApEbcm2LRx10000.PP_SG_mEbcm2L_SwVer_VDP_SG_mEbc.SwVerMaj "" UBYTE NO_COMPU_METHOD 0 0 0 255 ECU_ADDRESS 0x340EF0FC FORMAT "%.15" /end MEASUREMENT
/begin MEASUREMENT rtARID_DEF_CpApEbcm2LRx10000.PP_SG_mEbcm2L_SwVer_VDP_SG_mEbc.SwVerMin "" UBYTE NO_COMPU_METHOD 0 0 0 255 ECU_ADDRESS 0x340EF0FD FORMAT "%.15" /end MEASUREMENT
/begin MEASUREMENT rtARID_DEF_CpApEbcm2LRx10000.PP_SG_mEbcm2L_SwVer_VDP_SG_mEbc.SwVerRev "" UBYTE NO_COMPU_METHOD 0 0 0 255 ECU_ADDRESS 0x340EF0FE FORMAT "%.15" /end MEASUREMENT
/begin MEASUREMENT rtARID_DEF_CpApEbcm2LRx10000.PP_SG_mEbcm2L_SwVer_VDP_SG_mEbc.SwVerStat "" UBYTE NO_COMPU_METHOD 0 0 0 255 ECU_ADDRESS 0x340EF0FF FORMAT "%.15" /end MEASUREMENT
/begin MEASUREMENT rtARID_DEF_CpApEbcm2LRx10_1.PP_SG_mEbcm2L_BrkPress2_VDP_SG_.MsgCntr "" UBYTE NO_COMPU_METHOD 0 0 0 255 ECU_ADDRESS 0x340EF11C FORMAT "%.15" /end MEASUREMENT
/begin MEASUREMENT rtARID_DEF_CpApEbcm2LRx10_1.PP_SG_mEbcm2L_BrkPress2_VDP_SG_.MsgCrc "" UBYTE NO_COMPU_METHOD 0 0 0 255 ECU_ADDRESS 0x340EF11D FORMAT "%.15" /end MEASUREMENT
/begin MEASUREMENT rtARID_DEF_CpApEbcm2LRx10_1.PP_SG_mEbcm2L_BrkPress2_VDP_SG_.PrsrEstFL "" FLOAT32_IEEE NO_COMPU_METHOD 0 0 -3.40282346639E+38 3.40282346639E+38 ECU_ADDRESS 0x340EF120 FORMAT "%.15" /end MEASUREMENT
/begin MEASUREMENT rtARID_DEF_CpApEbcm2LRx10_1.PP_SG_mEbcm2L_BrkPress2_VDP_SG_.PrsrEstFR "" FLOAT32_IEEE NO_COMPU_METHOD 0 0 -3.40282346639E+38 3.40282346639E+38 ECU_ADDRESS 0x340EF124 FORMAT "%.15" /end MEASUREMENT
/begin MEASUREMENT rtARID_DEF_CpApEbcm2LRx10_1.PP_SG_mEbcm2L_BrkPress2_VDP_SG_.PrsrEstRL "" FLOAT32_IEEE NO_COMPU_METHOD 0 0 -3.40282346639E+38 3.40282346639E+38 ECU_ADDRESS 0x340EF128 FORMAT "%.15" /end MEASUREMENT
/begin MEASUREMENT rtARID_DEF_CpApEbcm2LRx10_1.PP_SG_mEbcm2L_BrkPress2_VDP_SG_.PrsrEstRR "" FLOAT32_IEEE NO_COMPU_METHOD 0 0 -3.40282346639E+38 3.40282346639E+38 ECU_ADDRESS 0x340EF12C FORMAT "%.15" /end MEASUREMENT
/begin MEASUREMENT rtARID_DEF_CpApEbcm2LRx10_1.PP_SG_mEbcm2L_BrkPress_VDP_SG_m "" UBYTE NO_COMPU_METHOD 0 0 0 255 ECU_ADDRESS 0x340EF148 FORMAT "%.15" /end MEASUREMENT
/begin MEASUREMENT rtARID_DEF_CpApEbcm2LRx10_1.PP_SG_mEbcm2L_BrkPress_VDP_SG_m.MsgCntr "" UBYTE NO_COMPU_METHOD 0 0 0 255 ECU_ADDRESS 0x340EF148 FORMAT "%.15" /end MEASUREMENT
/begin MEASUREMENT rtARID_DEF_CpApEbcm2LRx10_1.PP_SG_mEbcm2L_BrkPress_VDP_SG_m.MsgCrc "" UBYTE NO_COMPU_METHOD 0 0 0 255 ECU_ADDRESS 0x340EF149 FORMAT "%.15" /end MEASUREMENT
/begin MEASUREMENT rtARID_DEF_CpApEbcm2LRx10_1.PP_SG_mEbcm2L_BrkPress_VDP_SG_m.PrsrFrontWCP "" FLOAT32_IEEE NO_COMPU_METHOD 0 0 -3.40282346639E+38 3.40282346639E+38 ECU_ADDRESS 0x340EF14C FORMAT "%.15" /end MEASUREMENT
/begin MEASUREMENT rtARID_DEF_CpApEbcm2LRx10_1.PP_SG_mEbcm2L_BrkPress_VDP_SG_m.PrsrMstCyl "" FLOAT32_IEEE NO_COMPU_METHOD 0 0 -3.40282346639E+38 3.40282346639E+38 ECU_ADDRESS 0x340EF150 FORMAT "%.15" /end MEASUREMENT
/begin MEASUREMENT rtARID_DEF_CpApEbcm2LRx10_1.PP_SG_mEbcm2L_BrkPress_VDP_SG_m.PrsrMstrCylValid "" UBYTE NO_COMPU_METHOD 0 0 0 255 ECU_ADDRESS 0x340EF154 FORMAT "%.15" /end MEASUREMENT
/begin MEASUREMENT rtARID_DEF_CpApEbcm2LRx10_1.PP_SG_mEbcm2L_BrkPress_VDP_SG_m.PrsrRearWCP "" FLOAT32_IEEE NO_COMPU_METHOD 0 0 -3.40282346639E+38 3.40282346639E+38 ECU_ADDRESS 0x340EF158 FORMAT "%.15" /end MEASUREMENT
/begin MEASUREMENT rtARID_DEF_CpApEbcm2LRx10_1.PP_SG_mEbcm2L_BrkTrqEst_VDP_SG_.BrkTrqEstFL "" FLOAT32_IEEE NO_COMPU_METHOD 0 0 -3.40282346639E+38 3.40282346639E+38 ECU_ADDRESS 0x340EF15C FORMAT "%.15" /end MEASUREMENT
/begin MEASUREMENT rtARID_DEF_CpApEbcm2LRx10_1.PP_SG_mEbcm2L_BrkTrqEst_VDP_SG_.BrkTrqEstFR "" FLOAT32_IEEE NO_COMPU_METHOD 0 0 -3.40282346639E+38 3.40282346639E+38 ECU_ADDRESS 0x340EF160 FORMAT "%.15" /end MEASUREMENT
/begin MEASUREMENT rtARID_DEF_CpApEbcm2LRx10_1.PP_SG_mEbcm2L_BrkTrqEst_VDP_SG_.BrkTrqEstR "" FLOAT32_IEEE NO_COMPU_METHOD 0 0 -3.40282346639E+38 3.40282346639E+38 ECU_ADDRESS 0x340EF164 FORMAT "%.15" /end MEASUREMENT
/begin MEASUREMENT rtARID_DEF_CpApEbcm2LRx10_1.PP_SG_mEbcm2L_BrkTrqEst_VDP_SG_.MsgCntr "" UBYTE NO_COMPU_METHOD 0 0 0 255 ECU_ADDRESS 0x340EF168 FORMAT "%.15" /end MEASUREMENT
/begin MEASUREMENT rtARID_DEF_CpApEbcm2LRx10_1.PP_SG_mEbcm2L_BrkTrqEst_VDP_SG_.MsgCrc "" UBYTE NO_COMPU_METHOD 0 0 0 255 ECU_ADDRESS 0x340EF169 FORMAT "%.15" /end MEASUREMENT
/begin MEASUREMENT rtARID_DEF_CpApEbcm2LRx10_1.PP_SG_mEbcm2L_TrqLmts_VDP_SG_mE.MsgCntr "" UBYTE NO_COMPU_METHOD 0 0 0 255 ECU_ADDRESS 0x340EF130 FORMAT "%.15" /end MEASUREMENT
/begin MEASUREMENT rtARID_DEF_CpApEbcm2LRx10_1.PP_SG_mEbcm2L_TrqLmts_VDP_SG_mE.MsgCrc "" UBYTE NO_COMPU_METHOD 0 0 0 255 ECU_ADDRESS 0x340EF131 FORMAT "%.15" /end MEASUREMENT
/begin MEASUREMENT rtARID_DEF_CpApEbcm2LRx10_1.PP_SG_mEbcm2L_TrqLmts_VDP_SG_mE.RegBrkTrqRq "" FLOAT32_IEEE NO_COMPU_METHOD 0 0 -3.40282346639E+38 3.40282346639E+38 ECU_ADDRESS 0x340EF134 FORMAT "%.15" /end MEASUREMENT
/begin MEASUREMENT rtARID_DEF_CpApEbcm2LRx10_1.PP_SG_mEbcm2L_TrqLmts_VDP_SG_mE.StopLightRq "" UBYTE NO_COMPU_METHOD 0 0 0 255 ECU_ADDRESS 0x340EF138 FORMAT "%.15" /end MEASUREMENT
/begin MEASUREMENT rtARID_DEF_CpApEbcm2LRx10_1.PP_SG_mEbcm2L_TrqLmts_VDP_SG_mE.TrqLmtMtrRq "" FLOAT32_IEEE NO_COMPU_METHOD 0 0 -3.40282346639E+38 3.40282346639E+38 ECU_ADDRESS 0x340EF13C FORMAT "%.15" /end MEASUREMENT
/begin MEASUREMENT rtARID_DEF_CpApEbcm2LRx10_1.PP_SG_mEbcm2L_TrqLmts_VDP_SG_mE.TrqSlewRq "" UBYTE NO_COMPU_METHOD 0 0 0 255 ECU_ADDRESS 0x340EF140 FORMAT "%.15" /end MEASUREMENT
/begin MEASUREMENT rtARID_DEF_CpApEbcm2LRx10_1.PP_SG_mEbcm2L_TrqLmts_VDP_SG_mE.VehAccelEbcm "" FLOAT32_IEEE NO_COMPU_METHOD 0 0 -3.40282346639E+38 3.40282346639E+38 ECU_ADDRESS 0x340EF144 FORMAT "%.15" /end MEASUREMENT
/begin MEASUREMENT rtARID_DEF_CpApEbcm2LRx10_2.PP_SG_mEbcm2L_WhlCnt_VDP_SG_mEb.WhlCntFL "" UWORD NO_COMPU_METHOD 0 0 0 65535 ECU_ADDRESS 0x340EF17C FORMAT "%.15" /end MEASUREMENT
/begin MEASUREMENT rtARID_DEF_CpApEbcm2LRx10_2.PP_SG_mEbcm2L_WhlCnt_VDP_SG_mEb.WhlCntFR "" UWORD NO_COMPU_METHOD 0 0 0 65535 ECU_ADDRESS 0x340EF17E FORMAT "%.15" /end MEASUREMENT
/begin MEASUREMENT rtARID_DEF_CpApEbcm2LRx10_2.PP_SG_mEbcm2L_WhlCnt_VDP_SG_mEb.WhlCntR "" UWORD NO_COMPU_METHOD 0 0 0 65535 ECU_ADDRESS 0x340EF180 FORMAT "%.15" /end MEASUREMENT
/begin MEASUREMENT rtARID_DEF_CpApEbcm2LRx20_1.PP_SG_mEbcm2L_EpbStat_VDP_SG_mE.EPB_Current "" FLOAT32_IEEE NO_COMPU_METHOD 0 0 -3.40282346639E+38 3.40282346639E+38 ECU_ADDRESS 0x340EF198 FORMAT "%.15" /end MEASUREMENT
/begin MEASUREMENT rtARID_DEF_CpApEbcm2LRx20_1.PP_SG_mEbcm2L_EpbStat_VDP_SG_mE.EpbStat "" UBYTE NO_COMPU_METHOD 0 0 0 255 ECU_ADDRESS 0x340EF19C FORMAT "%.15" /end MEASUREMENT
/begin MEASUREMENT rtARID_DEF_CpApEbcm2LRx20_1.PP_SG_mEbcm2L_EpbStat_VDP_SG_mE.Flt_Epb "" UBYTE NO_COMPU_METHOD 0 0 0 255 ECU_ADDRESS 0x340EF19D FORMAT "%.15" /end MEASUREMENT
/begin MEASUREMENT rtARID_DEF_CpApEbcm2LRx20_1.PP_SG_mEbcm2L_EpbStat_VDP_SG_mE.Flt_EpbBattShort "" UBYTE NO_COMPU_METHOD 0 0 0 255 ECU_ADDRESS 0x340EF19E FORMAT "%.15" /end MEASUREMENT
/begin MEASUREMENT rtARID_DEF_CpApEbcm2LRx20_1.PP_SG_mEbcm2L_EpbStat_VDP_SG_mE.Flt_EpbGndShort "" UBYTE NO_COMPU_METHOD 0 0 0 255 ECU_ADDRESS 0x340EF19F FORMAT "%.15" /end MEASUREMENT
/begin MEASUREMENT rtARID_DEF_CpApEbcm2LRx20_1.PP_SG_mEbcm2L_EpbStat_VDP_SG_mE.Flt_EpbIC "" UBYTE NO_COMPU_METHOD 0 0 0 255 ECU_ADDRESS 0x340EF1A0 FORMAT "%.15" /end MEASUREMENT
/begin MEASUREMENT rtARID_DEF_CpApEbcm2LRx20_1.PP_SG_mEbcm2L_EpbStat_VDP_SG_mE.Flt_EpbMtrCurrent "" UBYTE NO_COMPU_METHOD 0 0 0 255 ECU_ADDRESS 0x340EF1A1 FORMAT "%.15" /end MEASUREMENT
/begin MEASUREMENT rtARID_DEF_CpApEbcm2LRx20_1.PP_SG_mEbcm2L_EpbStat_VDP_SG_mE.Flt_EpbOpenCircuit "" UBYTE NO_COMPU_METHOD 0 0 0 255 ECU_ADDRESS 0x340EF1A2 FORMAT "%.15" /end MEASUREMENT
/begin MEASUREMENT rtARID_DEF_CpApEbcm2LRx20_1.PP_SG_mEbcm2L_EpbStat_VDP_SG_mE.MsgCntr "" UBYTE NO_COMPU_METHOD 0 0 0 255 ECU_ADDRESS 0x340EF1A3 FORMAT "%.15" /end MEASUREMENT
/begin MEASUREMENT rtARID_DEF_CpApEbcm2LRx20_1.PP_SG_mEbcm2L_EpbStat_VDP_SG_mE.MsgCrc "" UBYTE NO_COMPU_METHOD 0 0 0 255 ECU_ADDRESS 0x340EF1A4 FORMAT "%.15" /end MEASUREMENT
/begin MEASUREMENT rtARID_DEF_CpApEbcm2LRx20_2.PP_SG_mEbcm2L_Stat_VDP_SG_mEbcm.AutoBrkEngd "" UBYTE NO_COMPU_METHOD 0 0 0 255 ECU_ADDRESS 0x340EF1A8 FORMAT "%.15" /end MEASUREMENT
/begin MEASUREMENT rtARID_DEF_CpApEbcm2LRx20_2.PP_SG_mEbcm2L_Stat_VDP_SG_mEbcm.BrkFluidLevSns_EBCM2 "" UBYTE NO_COMPU_METHOD 0 0 0 255 ECU_ADDRESS 0x340EF1A9 FORMAT "%.15" /end MEASUREMENT
/begin MEASUREMENT rtARID_DEF_CpApEbcm2LRx20_2.PP_SG_mEbcm2L_Stat_VDP_SG_mEbcm.EbcmControllerID "" UBYTE NO_COMPU_METHOD 0 0 0 255 ECU_ADDRESS 0x340EF1AA FORMAT "%.15" /end MEASUREMENT
/begin MEASUREMENT rtARID_DEF_CpApEbcm2LRx20_2.PP_SG_mEbcm2L_Stat_VDP_SG_mEbcm.EbcmRdy "" UBYTE NO_COMPU_METHOD 0 0 0 255 ECU_ADDRESS 0x340EF1AB FORMAT "%.15" /end MEASUREMENT
/begin MEASUREMENT rtARID_DEF_CpApEbcm2LRx20_2.PP_SG_mEbcm2L_Stat_VDP_SG_mEbcm.EbcmShtdwnRdy "" UBYTE NO_COMPU_METHOD 0 0 0 255 ECU_ADDRESS 0x340EF1AC FORMAT "%.15" /end MEASUREMENT
/begin MEASUREMENT rtARID_DEF_CpApEbcm2LRx20_2.PP_SG_mEbcm2L_Stat_VDP_SG_mEbcm.Flt_12vCtrl "" UBYTE NO_COMPU_METHOD 0 0 0 255 ECU_ADDRESS 0x340EF1AD FORMAT "%.15" /end MEASUREMENT
/begin MEASUREMENT rtARID_DEF_CpApEbcm2LRx20_2.PP_SG_mEbcm2L_Stat_VDP_SG_mEbcm.Flt_12vMtr "" UBYTE NO_COMPU_METHOD 0 0 0 255 ECU_ADDRESS 0x340EF1AE FORMAT "%.15" /end MEASUREMENT
/begin MEASUREMENT rtARID_DEF_CpApEbcm2LRx20_2.PP_SG_mEbcm2L_Stat_VDP_SG_mEbcm.Flt_Critical "" UBYTE NO_COMPU_METHOD 0 0 0 255 ECU_ADDRESS 0x340EF1AF FORMAT "%.15" /end MEASUREMENT
/begin MEASUREMENT rtARID_DEF_CpApEbcm2LRx20_2.PP_SG_mEbcm2L_Stat_VDP_SG_mEbcm.Flt_ElWhlSpdFL "" UBYTE NO_COMPU_METHOD 0 0 0 255 ECU_ADDRESS 0x340EF1B0 FORMAT "%.15" /end MEASUREMENT
/begin MEASUREMENT rtARID_DEF_CpApEbcm2LRx20_2.PP_SG_mEbcm2L_Stat_VDP_SG_mEbcm.Flt_ElWhlSpdFR "" UBYTE NO_COMPU_METHOD 0 0 0 255 ECU_ADDRESS 0x340EF1B1 FORMAT "%.15" /end MEASUREMENT
/begin MEASUREMENT rtARID_DEF_CpApEbcm2LRx20_2.PP_SG_mEbcm2L_Stat_VDP_SG_mEbcm.Flt_ElWhlSpdR "" UBYTE NO_COMPU_METHOD 0 0 0 255 ECU_ADDRESS 0x340EF1B2 FORMAT "%.15" /end MEASUREMENT
/begin MEASUREMENT rtARID_DEF_CpApEbcm2LRx20_2.PP_SG_mEbcm2L_Stat_VDP_SG_mEbcm.Flt_Hold "" UBYTE NO_COMPU_METHOD 0 0 0 255 ECU_ADDRESS 0x340EF1B3 FORMAT "%.15" /end MEASUREMENT
/begin MEASUREMENT rtARID_DEF_CpApEbcm2LRx20_2.PP_SG_mEbcm2L_Stat_VDP_SG_mEbcm.Flt_MtrTmpr "" UBYTE NO_COMPU_METHOD 0 0 0 255 ECU_ADDRESS 0x340EF1B5 FORMAT "%.15" /end MEASUREMENT
/begin MEASUREMENT rtARID_DEF_CpApEbcm2LRx20_2.PP_SG_mEbcm2L_Stat_VDP_SG_mEbcm.Flt_mBrkCtrl "" UBYTE NO_COMPU_METHOD 0 0 0 255 ECU_ADDRESS 0x340EF1B4 FORMAT "%.15" /end MEASUREMENT
/begin MEASUREMENT rtARID_DEF_CpApEbcm2LRx20_2.PP_SG_mEbcm2L_Stat_VDP_SG_mEbcm.Flt_mVcuImuAngVel "" UBYTE NO_COMPU_METHOD 0 0 0 255 ECU_ADDRESS 0x340EF1B6 FORMAT "%.15" /end MEASUREMENT
/begin MEASUREMENT rtARID_DEF_CpApEbcm2LRx20_2.PP_SG_mEbcm2L_Stat_VDP_SG_mEbcm.Flt_mVcuImuLinAccel "" UBYTE NO_COMPU_METHOD 0 0 0 255 ECU_ADDRESS 0x340EF1B7 FORMAT "%.15" /end MEASUREMENT
/begin MEASUREMENT rtARID_DEF_CpApEbcm2LRx20_2.PP_SG_mEbcm2L_Stat_VDP_SG_mEbcm.Flt_mVehState "" UBYTE NO_COMPU_METHOD 0 0 0 255 ECU_ADDRESS 0x340EF1B8 FORMAT "%.15" /end MEASUREMENT
/begin MEASUREMENT rtARID_DEF_CpApEbcm2LRx20_2.PP_SG_mEbcm2L_Stat_VDP_SG_mEbcm.Flt_mVehState2 "" UBYTE NO_COMPU_METHOD 0 0 0 255 ECU_ADDRESS 0x340EF1B9 FORMAT "%.15" /end MEASUREMENT
/begin MEASUREMENT rtARID_DEF_CpApEbcm2LRx20_2.PP_SG_mEbcm2L_Stat_VDP_SG_mEbcm.Flt_mWhdCtrl "" UBYTE NO_COMPU_METHOD 0 0 0 255 ECU_ADDRESS 0x340EF1BA FORMAT "%.15" /end MEASUREMENT
/begin MEASUREMENT rtARID_DEF_CpApEbcm2LRx20_2.PP_SG_mEbcm2L_Stat_VDP_SG_mEbcm.Flt_mWhdStat "" UBYTE NO_COMPU_METHOD 0 0 0 255 ECU_ADDRESS 0x340EF1BB FORMAT "%.15" /end MEASUREMENT
/begin MEASUREMENT rtARID_DEF_CpApEbcm2LRx20_2.PP_SG_mEbcm2L_Stat_VDP_SG_mEbcm.MsgCntr "" UBYTE NO_COMPU_METHOD 0 0 0 255 ECU_ADDRESS 0x340EF1BC FORMAT "%.15" /end MEASUREMENT
/begin MEASUREMENT rtARID_DEF_CpApEbcm2LRx20_2.PP_SG_mEbcm2L_Stat_VDP_SG_mEbcm.MsgCrc "" UBYTE NO_COMPU_METHOD 0 0 0 255 ECU_ADDRESS 0x340EF1BD FORMAT "%.15" /end MEASUREMENT
/begin MEASUREMENT rtARID_DEF_CpApEbcm2LRx20_2.PP_SG_mEbcm2L_Stat_VDP_SG_mEbcm.MtrTmprEst "" FLOAT32_IEEE NO_COMPU_METHOD 0 0 -3.40282346639E+38 3.40282346639E+38 ECU_ADDRESS 0x340EF1C0 FORMAT "%.15" /end MEASUREMENT
/begin MEASUREMENT rtARID_DEF_CpApEbcm2LRx20_2.PP_SG_mEbcm2L_Stat_VDP_SG_mEbcm.VehMvmt "" UBYTE NO_COMPU_METHOD 0 0 0 255 ECU_ADDRESS 0x340EF1C4 FORMAT "%.15" /end MEASUREMENT
/begin MEASUREMENT rtARID_DEF_CpApEbcm2LRx20_2.PP_SG_mEbcm2L_Stat_VDP_SG_mEbcm.WakeStat "" UBYTE NO_COMPU_METHOD 0 0 0 255 ECU_ADDRESS 0x340EF1C5 FORMAT "%.15" /end MEASUREMENT
/begin MEASUREMENT rtARID_DEF_CpApEbcm2LRx20_2.PP_SG_mEbcm2L_Stat_VDP_SG_mEbcm.Warn_MtrTmpr "" UBYTE NO_COMPU_METHOD 0 0 0 255 ECU_ADDRESS 0x340EF1C6 FORMAT "%.15" /end MEASUREMENT
/begin MEASUREMENT rtARID_DEF_CpApEbcm2LRx20_2.PP_SG_mEbcm2L_WhlSlip_VDP_SG_mE.MsgCntr "" UBYTE NO_COMPU_METHOD 0 0 0 255 ECU_ADDRESS 0x340EF1C8 FORMAT "%.15" /end MEASUREMENT
/begin MEASUREMENT rtARID_DEF_CpApEbcm2LRx20_2.PP_SG_mEbcm2L_WhlSlip_VDP_SG_mE.MsgCrc "" UBYTE NO_COMPU_METHOD 0 0 0 255 ECU_ADDRESS 0x340EF1C9 FORMAT "%.15" /end MEASUREMENT
/begin MEASUREMENT rtARID_DEF_CpApEbcm2LRx20_2.PP_SG_mEbcm2L_WhlSlip_VDP_SG_mE.WhlSlipFL "" FLOAT32_IEEE NO_COMPU_METHOD 0 0 -3.40282346639E+38 3.40282346639E+38 ECU_ADDRESS 0x340EF1CC FORMAT "%.15" /end MEASUREMENT
/begin MEASUREMENT rtARID_DEF_CpApEbcm2LRx20_2.PP_SG_mEbcm2L_WhlSlip_VDP_SG_mE.WhlSlipFR "" FLOAT32_IEEE NO_COMPU_METHOD 0 0 -3.40282346639E+38 3.40282346639E+38 ECU_ADDRESS 0x340EF1D0 FORMAT "%.15" /end MEASUREMENT
/begin MEASUREMENT rtARID_DEF_CpApEbcm2LRx20_2.PP_SG_mEbcm2L_WhlSlip_VDP_SG_mE.WhlSlipR "" FLOAT32_IEEE NO_COMPU_METHOD 0 0 -3.40282346639E+38 3.40282346639E+38 ECU_ADDRESS 0x340EF1D4 FORMAT "%.15" /end MEASUREMENT
/begin MEASUREMENT rtARID_DEF_CpApEpbRx20.PP_SG_mEpbStat_EpbStat_VDP_SG_m.EPB_Current "" FLOAT32_IEEE NO_COMPU_METHOD 0 0 -3.40282346639E+38 3.40282346639E+38 ECU_ADDRESS 0x340EF204 FORMAT "%.15" /end MEASUREMENT
/begin MEASUREMENT rtARID_DEF_CpApEpbRx20.PP_SG_mEpbStat_EpbStat_VDP_SG_m.EpbStat "" UBYTE NO_COMPU_METHOD 0 0 0 255 ECU_ADDRESS 0x340EF208 FORMAT "%.15" /end MEASUREMENT
/begin MEASUREMENT rtARID_DEF_CpApEpbRx20.PP_SG_mEpbStat_EpbStat_VDP_SG_m.Flt_Epb "" UBYTE NO_COMPU_METHOD 0 0 0 255 ECU_ADDRESS 0x340EF209 FORMAT "%.15" /end MEASUREMENT
/begin MEASUREMENT rtARID_DEF_CpApEpbRx20.PP_SG_mEpbStat_EpbStat_VDP_SG_m.Flt_EpbBattShort "" UBYTE NO_COMPU_METHOD 0 0 0 255 ECU_ADDRESS 0x340EF20A FORMAT "%.15" /end MEASUREMENT
/begin MEASUREMENT rtARID_DEF_CpApEpbRx20.PP_SG_mEpbStat_EpbStat_VDP_SG_m.Flt_EpbGndShort "" UBYTE NO_COMPU_METHOD 0 0 0 255 ECU_ADDRESS 0x340EF20B FORMAT "%.15" /end MEASUREMENT
/begin MEASUREMENT rtARID_DEF_CpApEpbRx20.PP_SG_mEpbStat_EpbStat_VDP_SG_m.Flt_EpbIC "" UBYTE NO_COMPU_METHOD 0 0 0 255 ECU_ADDRESS 0x340EF20C FORMAT "%.15" /end MEASUREMENT
/begin MEASUREMENT rtARID_DEF_CpApEpbRx20.PP_SG_mEpbStat_EpbStat_VDP_SG_m.Flt_EpbMtrCurrent "" UBYTE NO_COMPU_METHOD 0 0 0 255 ECU_ADDRESS 0x340EF20D FORMAT "%.15" /end MEASUREMENT
/begin MEASUREMENT rtARID_DEF_CpApEpbRx20.PP_SG_mEpbStat_EpbStat_VDP_SG_m.Flt_EpbOpenCircuit "" UBYTE NO_COMPU_METHOD 0 0 0 255 ECU_ADDRESS 0x340EF20E FORMAT "%.15" /end MEASUREMENT
/begin MEASUREMENT rtARID_DEF_CpApEpbRx20.PP_SG_mEpbStat_EpbStat_VDP_SG_m.Flt_StallDisengaged "" UBYTE NO_COMPU_METHOD 0 0 0 255 ECU_ADDRESS 0x340EF210 FORMAT "%.15" /end MEASUREMENT
/begin MEASUREMENT rtARID_DEF_CpApEpbRx20.PP_SG_mEpbStat_EpbStat_VDP_SG_m.Flt_StallEngaged "" UBYTE NO_COMPU_METHOD 0 0 0 255 ECU_ADDRESS 0x340EF211 FORMAT "%.15" /end MEASUREMENT
/begin MEASUREMENT rtARID_DEF_CpApEpbRx20.PP_SG_mEpbStat_EpbStat_VDP_SG_m.Flt_mBrkCtrl "" UBYTE NO_COMPU_METHOD 0 0 0 255 ECU_ADDRESS 0x340EF20F FORMAT "%.15" /end MEASUREMENT
/begin MEASUREMENT rtARID_DEF_CpApEpbRx20.PP_SG_mEpbStat_EpbStat_VDP_SG_m.MsgCntr "" UBYTE NO_COMPU_METHOD 0 0 0 255 ECU_ADDRESS 0x340EF212 FORMAT "%.15" /end MEASUREMENT
/begin MEASUREMENT rtARID_DEF_CpApEpbRx20.PP_SG_mEpbStat_EpbStat_VDP_SG_m.MsgCrc "" UBYTE NO_COMPU_METHOD 0 0 0 255 ECU_ADDRESS 0x340EF213 FORMAT "%.15" /end MEASUREMENT
/begin MEASUREMENT rtARID_DEF_CpApEpbRx20.PP_SG_mEpbStat_EpbStat_VDP_SG_m.SwMaj "" UBYTE NO_COMPU_METHOD 0 0 0 255 ECU_ADDRESS 0x340EF214 FORMAT "%.15" /end MEASUREMENT
/begin MEASUREMENT rtARID_DEF_CpApEpbRx20.PP_SG_mEpbStat_EpbStat_VDP_SG_m.SwMin "" UBYTE NO_COMPU_METHOD 0 0 0 255 ECU_ADDRESS 0x340EF215 FORMAT "%.15" /end MEASUREMENT
/begin MEASUREMENT rtARID_DEF_CpApEpbRx20.PP_SG_mEpbStat_EpbStat_VDP_SG_m.SwRev "" UBYTE NO_COMPU_METHOD 0 0 0 255 ECU_ADDRESS 0x340EF216 FORMAT "%.15" /end MEASUREMENT
/begin MEASUREMENT rtARID_DEF_CpApEpbRx20.PP_SG_mEpbStat_EpbStat_VDP_SG_m.SwStat "" UBYTE NO_COMPU_METHOD 0 0 0 255 ECU_ADDRESS 0x340EF217 FORMAT "%.15" /end MEASUREMENT
/begin MEASUREMENT rtARID_DEF_CpApEssRx10.PP_SG_STATUS_BMS2_VDP_SG_STATUS.STATUS_Runmode_F3 "" UBYTE NO_COMPU_METHOD 0 0 0 255 ECU_ADDRESS 0x340EF22C FORMAT "%.15" /end MEASUREMENT
/begin MEASUREMENT rtARID_DEF_CpApEssRx1000.PP_SG_VEP2_BMS2_VDP_SG_VEP2_BMS.MvVoltAux "" FLOAT32_IEEE NO_COMPU_METHOD 0 0 -3.40282346639E+38 3.40282346639E+38 ECU_ADDRESS 0x340EF230 FORMAT "%.15" /end MEASUREMENT
/begin CHARACTERISTIC rtARID_DEF_CpApEssRx100_1.PP_SG_AUXIO_BMS2_VDP_SG_AUXIO_B.AUX_01_HPR "" VALUE 0x340EF280 __UBYTE_S 0 NO_COMPU_METHOD 0 255 FORMAT "%.15" /end CHARACTERISTIC
/begin CHARACTERISTIC rtARID_DEF_CpApEssRx100_1.PP_SG_AUXIO_BMS2_VDP_SG_AUXIO_B.AUX_02 "" VALUE 0x340EF281 __UBYTE_S 0 NO_COMPU_METHOD 0 255 FORMAT "%.15" /end CHARACTERISTIC
/begin CHARACTERISTIC rtARID_DEF_CpApEssRx100_1.PP_SG_AUXIO_BMS2_VDP_SG_AUXIO_B.AUX_03 "" VALUE 0x340EF282 __UBYTE_S 0 NO_COMPU_METHOD 0 255 FORMAT "%.15" /end CHARACTERISTIC
/begin CHARACTERISTIC rtARID_DEF_CpApEssRx100_1.PP_SG_AUXIO_BMS2_VDP_SG_AUXIO_B.AUX_04_LPR "" VALUE 0x340EF283 __UBYTE_S 0 NO_COMPU_METHOD 0 255 FORMAT "%.15" /end CHARACTERISTIC
/begin CHARACTERISTIC rtARID_DEF_CpApEssRx100_1.PP_SG_AUXIO_BMS2_VDP_SG_AUXIO_B.AUX_05 "" VALUE 0x340EF284 __UBYTE_S 0 NO_COMPU_METHOD 0 255 FORMAT "%.15" /end CHARACTERISTIC
/begin CHARACTERISTIC rtARID_DEF_CpApEssRx100_1.PP_SG_AUXIO_BMS2_VDP_SG_AUXIO_B.AUX_06 "" VALUE 0x340EF285 __UBYTE_S 0 NO_COMPU_METHOD 0 255 FORMAT "%.15" /end CHARACTERISTIC
/begin CHARACTERISTIC rtARID_DEF_CpApEssRx100_1.PP_SG_AUXIO_BMS2_VDP_SG_AUXIO_B.AUX_07 "" VALUE 0x340EF286 __UBYTE_S 0 NO_COMPU_METHOD 0 255 FORMAT "%.15" /end CHARACTERISTIC
/begin CHARACTERISTIC rtARID_DEF_CpApEssRx100_1.PP_SG_AUXIO_BMS2_VDP_SG_AUXIO_B.AUX_08 "" VALUE 0x340EF287 __UBYTE_S 0 NO_COMPU_METHOD 0 255 FORMAT "%.15" /end CHARACTERISTIC
/begin CHARACTERISTIC rtARID_DEF_CpApEssRx100_1.PP_SG_HVESSD10_BMS2_VDP_SG_HVES.CellSocMaxIdCell "" VALUE 0x340EF268 __UBYTE_S 0 NO_COMPU_METHOD 0 255 FORMAT "%.15" /end CHARACTERISTIC
/begin CHARACTERISTIC rtARID_DEF_CpApEssRx100_1.PP_SG_HVESSD10_BMS2_VDP_SG_HVES.CellSocMaxIdMod "" VALUE 0x340EF269 __UBYTE_S 0 NO_COMPU_METHOD 0 255 FORMAT "%.15" /end CHARACTERISTIC
/begin CHARACTERISTIC rtARID_DEF_CpApEssRx100_1.PP_SG_HVESSD10_BMS2_VDP_SG_HVES.CellSocMinIdCell "" VALUE 0x340EF26A __UBYTE_S 0 NO_COMPU_METHOD 0 255 FORMAT "%.15" /end CHARACTERISTIC
/begin CHARACTERISTIC rtARID_DEF_CpApEssRx100_1.PP_SG_HVESSD10_BMS2_VDP_SG_HVES.CellSocMinIdMod "" VALUE 0x340EF26B __UBYTE_S 0 NO_COMPU_METHOD 0 255 FORMAT "%.15" /end CHARACTERISTIC
/begin CHARACTERISTIC rtARID_DEF_CpApEssRx100_1.PP_SG_HVESSD10_BMS2_VDP_SG_HVES.HvIsoResistActive "" VALUE 0x340EF26C __FLOAT32_IEEE_S 0 NO_COMPU_METHOD -3.40282346639E+38 3.40282346639E+38 FORMAT "%.15" /end CHARACTERISTIC
/begin CHARACTERISTIC rtARID_DEF_CpApEssRx100_1.PP_SG_HVESSD10_BMS2_VDP_SG_HVES.HvIsoResistPassive "" VALUE 0x340EF270 __FLOAT32_IEEE_S 0 NO_COMPU_METHOD -3.40282346639E+38 3.40282346639E+38 FORMAT "%.15" /end CHARACTERISTIC
/begin CHARACTERISTIC rtARID_DEF_CpApEssRx100_1.PP_SG_HVESSD2_BMS2_VDP_SG_HVESS.BattSocFast "" VALUE 0x340EF248 __FLOAT32_IEEE_S 0 NO_COMPU_METHOD -3.40282346639E+38 3.40282346639E+38 FORMAT "%.15" /end CHARACTERISTIC
/begin CHARACTERISTIC rtARID_DEF_CpApEssRx100_1.PP_SG_HVESSD2_BMS2_VDP_SG_HVESS.CellVoltDeltaStat "" VALUE 0x340EF24C __UBYTE_S 0 NO_COMPU_METHOD 0 255 FORMAT "%.15" /end CHARACTERISTIC
/begin CHARACTERISTIC rtARID_DEF_CpApEssRx100_1.PP_SG_HVESSD2_BMS2_VDP_SG_HVESS.CellVoltMax "" VALUE 0x340EF250 __FLOAT32_IEEE_S 0 NO_COMPU_METHOD -3.40282346639E+38 3.40282346639E+38 FORMAT "%.15" /end CHARACTERISTIC
/begin CHARACTERISTIC rtARID_DEF_CpApEssRx100_1.PP_SG_HVESSD2_BMS2_VDP_SG_HVESS.CellVoltMin "" VALUE 0x340EF254 __FLOAT32_IEEE_S 0 NO_COMPU_METHOD -3.40282346639E+38 3.40282346639E+38 FORMAT "%.15" /end CHARACTERISTIC
/begin CHARACTERISTIC rtARID_DEF_CpApEssRx100_1.PP_SG_HVESSD3_BMS2_VDP_SG_HVESS.CellTmprAvg "" VALUE 0x340EF258 __FLOAT32_IEEE_S 0 NO_COMPU_METHOD -3.40282346639E+38 3.40282346639E+38 FORMAT "%.15" /end CHARACTERISTIC
/begin CHARACTERISTIC rtARID_DEF_CpApEssRx100_1.PP_SG_HVESSD3_BMS2_VDP_SG_HVESS.CellTmprDeltaStat "" VALUE 0x340EF25C __UBYTE_S 0 NO_COMPU_METHOD 0 255 FORMAT "%.15" /end CHARACTERISTIC
/begin CHARACTERISTIC rtARID_DEF_CpApEssRx100_1.PP_SG_HVESSD3_BMS2_VDP_SG_HVESS.CellTmprMax "" VALUE 0x340EF260 __FLOAT32_IEEE_S 0 NO_COMPU_METHOD -3.40282346639E+38 3.40282346639E+38 FORMAT "%.15" /end CHARACTERISTIC
/begin CHARACTERISTIC rtARID_DEF_CpApEssRx100_1.PP_SG_HVESSD3_BMS2_VDP_SG_HVESS.CellTmprMin "" VALUE 0x340EF264 __FLOAT32_IEEE_S 0 NO_COMPU_METHOD -3.40282346639E+38 3.40282346639E+38 FORMAT "%.15" /end CHARACTERISTIC
/begin CHARACTERISTIC rtARID_DEF_CpApEssRx100_1.PP_SG_HVESSD4_BMS2_VDP_SG_HVESS.CapacAvailChrg "" VALUE 0x340EF274 __FLOAT32_IEEE_S 0 NO_COMPU_METHOD -3.40282346639E+38 3.40282346639E+38 FORMAT "%.15" /end CHARACTERISTIC
/begin CHARACTERISTIC rtARID_DEF_CpApEssRx100_1.PP_SG_HVESSD4_BMS2_VDP_SG_HVESS.CapacAvailDschrg "" VALUE 0x340EF278 __FLOAT32_IEEE_S 0 NO_COMPU_METHOD -3.40282346639E+38 3.40282346639E+38 FORMAT "%.15" /end CHARACTERISTIC
/begin CHARACTERISTIC rtARID_DEF_CpApEssRx100_1.PP_SG_HVESSD4_BMS2_VDP_SG_HVESS.CellBalCount "" VALUE 0x340EF27C __UWORD_S 0 NO_COMPU_METHOD 0 65535 FORMAT "%.15" /end CHARACTERISTIC
/begin CHARACTERISTIC rtARID_DEF_CpApEssRx100_1.PP_SG_HVESSD5_BMS2_VDP_SG_HVESS.CellSocMax "" VALUE 0x340EF238 __FLOAT32_IEEE_S 0 NO_COMPU_METHOD -3.40282346639E+38 3.40282346639E+38 FORMAT "%.15" /end CHARACTERISTIC
/begin CHARACTERISTIC rtARID_DEF_CpApEssRx100_1.PP_SG_HVESSD5_BMS2_VDP_SG_HVESS.CellSocMin "" VALUE 0x340EF23C __FLOAT32_IEEE_S 0 NO_COMPU_METHOD -3.40282346639E+38 3.40282346639E+38 FORMAT "%.15" /end CHARACTERISTIC
/begin CHARACTERISTIC rtARID_DEF_CpApEssRx100_1.PP_SG_HVESSD5_BMS2_VDP_SG_HVESS.CurrAvailChrg "" VALUE 0x340EF240 __FLOAT32_IEEE_S 0 NO_COMPU_METHOD -3.40282346639E+38 3.40282346639E+38 FORMAT "%.15" /end CHARACTERISTIC
/begin CHARACTERISTIC rtARID_DEF_CpApEssRx100_1.PP_SG_HVESSD5_BMS2_VDP_SG_HVESS.CurrAvailDschrg "" VALUE 0x340EF244 __FLOAT32_IEEE_S 0 NO_COMPU_METHOD -3.40282346639E+38 3.40282346639E+38 FORMAT "%.15" /end CHARACTERISTIC
/begin MEASUREMENT rtARID_DEF_CpApEssRx100_2.PP_SG_HVESSD6_BMS2_VDP_SG_HVESS.BattTmpr "" UBYTE NO_COMPU_METHOD 0 0 0 255 ECU_ADDRESS 0x340EF2E4 FORMAT "%.15" /end MEASUREMENT
/begin MEASUREMENT rtARID_DEF_CpApEssRx100_2.PP_SG_HVESSD6_BMS2_VDP_SG_HVESS.ElecTmpr "" UBYTE NO_COMPU_METHOD 0 0 0 255 ECU_ADDRESS 0x340EF2E5 FORMAT "%.15" /end MEASUREMENT
/begin MEASUREMENT rtARID_DEF_CpApEssRx100_2.PP_SG_HVESSD6_BMS2_VDP_SG_HVESS.MvVoltBus "" FLOAT32_IEEE NO_COMPU_METHOD 0 0 -3.40282346639E+38 3.40282346639E+38 ECU_ADDRESS 0x340EF2E8 FORMAT "%.15" /end MEASUREMENT
/begin MEASUREMENT rtARID_DEF_CpApEssRx100_2.PP_SG_HVESSD7_BMS2_VDP_SG_HVESS.ChrgVoltMax "" FLOAT32_IEEE NO_COMPU_METHOD 0 0 -3.40282346639E+38 3.40282346639E+38 ECU_ADDRESS 0x340EF2D0 FORMAT "%.15" /end MEASUREMENT
/begin MEASUREMENT rtARID_DEF_CpApEssRx100_2.PP_SG_HVESSD7_BMS2_VDP_SG_HVESS.EnrgyAvailChrg "" FLOAT32_IEEE NO_COMPU_METHOD 0 0 -3.40282346639E+38 3.40282346639E+38 ECU_ADDRESS 0x340EF2D4 FORMAT "%.15" /end MEASUREMENT
/begin MEASUREMENT rtARID_DEF_CpApEssRx100_2.PP_SG_HVESSD7_BMS2_VDP_SG_HVESS.EnrgyAvailDschrg "" FLOAT32_IEEE NO_COMPU_METHOD 0 0 -3.40282346639E+38 3.40282346639E+38 ECU_ADDRESS 0x340EF2D8 FORMAT "%.15" /end MEASUREMENT
/begin MEASUREMENT rtARID_DEF_CpApEssRx100_2.PP_SG_HVESSD8_BMS2_VDP_SG_HVESS.CellVoltAvg "" FLOAT32_IEEE NO_COMPU_METHOD 0 0 -3.40282346639E+38 3.40282346639E+38 ECU_ADDRESS 0x340EF2DC FORMAT "%.15" /end MEASUREMENT
/begin MEASUREMENT rtARID_DEF_CpApEssRx100_2.PP_SG_HVESSD8_BMS2_VDP_SG_HVESS.CellVoltMaxIdCell "" UBYTE NO_COMPU_METHOD 0 0 0 255 ECU_ADDRESS 0x340EF2E0 FORMAT "%.15" /end MEASUREMENT
/begin MEASUREMENT rtARID_DEF_CpApEssRx100_2.PP_SG_HVESSD8_BMS2_VDP_SG_HVESS.CellVoltMaxIdMod "" UBYTE NO_COMPU_METHOD 0 0 0 255 ECU_ADDRESS 0x340EF2E1 FORMAT "%.15" /end MEASUREMENT
/begin MEASUREMENT rtARID_DEF_CpApEssRx100_2.PP_SG_HVESSD8_BMS2_VDP_SG_HVESS.CellVoltMinIdCell "" UBYTE NO_COMPU_METHOD 0 0 0 255 ECU_ADDRESS 0x340EF2E2 FORMAT "%.15" /end MEASUREMENT
/begin MEASUREMENT rtARID_DEF_CpApEssRx100_2.PP_SG_HVESSD8_BMS2_VDP_SG_HVESS.CellVoltMinIdMod "" UBYTE NO_COMPU_METHOD 0 0 0 255 ECU_ADDRESS 0x340EF2E3 FORMAT "%.15" /end MEASUREMENT
/begin MEASUREMENT rtARID_DEF_CpApEssRx100_2.PP_SG_HVESSD9_BMS2_VDP_SG_HVESS.CellTmprMaxIdCell "" UBYTE NO_COMPU_METHOD 0 0 0 255 ECU_ADDRESS 0x340EF2EC FORMAT "%.15" /end MEASUREMENT
/begin MEASUREMENT rtARID_DEF_CpApEssRx100_2.PP_SG_HVESSD9_BMS2_VDP_SG_HVESS.CellTmprMaxIdMod "" UBYTE NO_COMPU_METHOD 0 0 0 255 ECU_ADDRESS 0x340EF2ED FORMAT "%.15" /end MEASUREMENT
/begin MEASUREMENT rtARID_DEF_CpApEssRx100_2.PP_SG_HVESSD9_BMS2_VDP_SG_HVESS.CellTmprMinIdCell "" UBYTE NO_COMPU_METHOD 0 0 0 255 ECU_ADDRESS 0x340EF2EE FORMAT "%.15" /end MEASUREMENT
/begin MEASUREMENT rtARID_DEF_CpApEssRx100_2.PP_SG_HVESSD9_BMS2_VDP_SG_HVESS.CellTmprMinIdMod "" UBYTE NO_COMPU_METHOD 0 0 0 255 ECU_ADDRESS 0x340EF2EF FORMAT "%.15" /end MEASUREMENT
/begin MEASUREMENT rtARID_DEF_CpApEssRx100_2.PP_SG_HVESSD9_BMS2_VDP_SG_HVESS.ThrmlEventDetect "" UBYTE NO_COMPU_METHOD 0 0 0 255 ECU_ADDRESS 0x340EF2F0 FORMAT "%.15" /end MEASUREMENT
/begin MEASUREMENT rtARID_DEF_CpApEssRx100_3.PP_SG_HVESSS1_BMS2_VDP_SG_HVESS.BattCntctrNeg "" UBYTE NO_COMPU_METHOD 0 0 0 255 ECU_ADDRESS 0x340EF314 FORMAT "%.15" /end MEASUREMENT
/begin MEASUREMENT rtARID_DEF_CpApEssRx100_3.PP_SG_HVESSS1_BMS2_VDP_SG_HVESS.BattCntctrPcStat "" UBYTE NO_COMPU_METHOD 0 0 0 255 ECU_ADDRESS 0x340EF315 FORMAT "%.15" /end MEASUREMENT
/begin MEASUREMENT rtARID_DEF_CpApEssRx100_3.PP_SG_HVESSS1_BMS2_VDP_SG_HVESS.BattCntctrPos "" UBYTE NO_COMPU_METHOD 0 0 0 255 ECU_ADDRESS 0x340EF316 FORMAT "%.15" /end MEASUREMENT
/begin MEASUREMENT rtARID_DEF_CpApEssRx100_3.PP_SG_HVESSS1_BMS2_VDP_SG_HVESS.BattCntctrStat "" UBYTE NO_COMPU_METHOD 0 0 0 255 ECU_ADDRESS 0x340EF317 FORMAT "%.15" /end MEASUREMENT
/begin MEASUREMENT rtARID_DEF_CpApEssRx100_3.PP_SG_HVESSS1_BMS2_VDP_SG_HVESS.BattDiscWarn "" UBYTE NO_COMPU_METHOD 0 0 0 255 ECU_ADDRESS 0x340EF318 FORMAT "%.15" /end MEASUREMENT
/begin MEASUREMENT rtARID_DEF_CpApEssRx100_3.PP_SG_HVESSS1_BMS2_VDP_SG_HVESS.BattEnblStat "" UBYTE NO_COMPU_METHOD 0 0 0 255 ECU_ADDRESS 0x340EF319 FORMAT "%.15" /end MEASUREMENT
/begin MEASUREMENT rtARID_DEF_CpApEssRx100_3.PP_SG_HVESSS1_BMS2_VDP_SG_HVESS.BattRdyCount "" UBYTE NO_COMPU_METHOD 0 0 0 255 ECU_ADDRESS 0x340EF31A FORMAT "%.15" /end MEASUREMENT
/begin MEASUREMENT rtARID_DEF_CpApEssRx100_3.PP_SG_HVESSS1_BMS2_VDP_SG_HVESS.BattSocStat "" UBYTE NO_COMPU_METHOD 0 0 0 255 ECU_ADDRESS 0x340EF31B FORMAT "%.15" /end MEASUREMENT
/begin MEASUREMENT rtARID_DEF_CpApEssRx100_3.PP_SG_HVESSS1_BMS2_VDP_SG_HVESS.CellBalActive "" UBYTE NO_COMPU_METHOD 0 0 0 255 ECU_ADDRESS 0x340EF31C FORMAT "%.15" /end MEASUREMENT
/begin MEASUREMENT rtARID_DEF_CpApEssRx100_3.PP_SG_HVESSS1_BMS2_VDP_SG_HVESS.CellBalStat "" UBYTE NO_COMPU_METHOD 0 0 0 255 ECU_ADDRESS 0x340EF31D FORMAT "%.15" /end MEASUREMENT
/begin MEASUREMENT rtARID_DEF_CpApEssRx100_3.PP_SG_HVESSS1_BMS2_VDP_SG_HVESS.HvIsoStatActive "" UBYTE NO_COMPU_METHOD 0 0 0 255 ECU_ADDRESS 0x340EF31F FORMAT "%.15" /end MEASUREMENT
/begin MEASUREMENT rtARID_DEF_CpApEssRx100_3.PP_SG_HVESSS1_BMS2_VDP_SG_HVESS.HvIsoStatPassive "" UBYTE NO_COMPU_METHOD 0 0 0 255 ECU_ADDRESS 0x340EF320 FORMAT "%.15" /end MEASUREMENT
/begin MEASUREMENT rtARID_DEF_CpApEssRx100_3.PP_SG_HVESSS1_BMS2_VDP_SG_HVESS.HvilStat "" UBYTE NO_COMPU_METHOD 0 0 0 255 ECU_ADDRESS 0x340EF31E FORMAT "%.15" /end MEASUREMENT
/begin MEASUREMENT rtARID_DEF_CpApEssRx100_3.PP_SG_HVESSS1_BMS2_VDP_SG_HVESS.InertSwStat "" UBYTE NO_COMPU_METHOD 0 0 0 255 ECU_ADDRESS 0x340EF321 FORMAT "%.15" /end MEASUREMENT
/begin MEASUREMENT rtARID_DEF_CpApEssRx100_3.PP_SG_HVESSS1_BMS2_VDP_SG_HVESS.IntChrgrStat "" UBYTE NO_COMPU_METHOD 0 0 0 255 ECU_ADDRESS 0x340EF322 FORMAT "%.15" /end MEASUREMENT
/begin MEASUREMENT rtARID_DEF_CpApEssRx100_3.PP_SG_HVESSS1_BMS2_VDP_SG_HVESS.MsgCntr "" UBYTE NO_COMPU_METHOD 0 0 0 255 ECU_ADDRESS 0x340EF323 FORMAT "%.15" /end MEASUREMENT
/begin MEASUREMENT rtARID_DEF_CpApEssRx100_3.PP_SG_HVESSS1_BMS2_VDP_SG_HVESS.MsgCrc "" UBYTE NO_COMPU_METHOD 0 0 0 255 ECU_ADDRESS 0x340EF324 FORMAT "%.15" /end MEASUREMENT
/begin MEASUREMENT rtARID_DEF_CpApEssRx100_3.PP_SG_HVESSS1_BMS2_VDP_SG_HVESS.OpStat "" UBYTE NO_COMPU_METHOD 0 0 0 255 ECU_ADDRESS 0x340EF325 FORMAT "%.15" /end MEASUREMENT
/begin CHARACTERISTIC rtARID_DEF_CpApEssRx100_3.PP_SG_HVESSS2_BMS2_VDP_SG_HVESS.LmtChrg_Curr "" VALUE 0x340EF326 __UBYTE_S 0 NO_COMPU_METHOD 0 255 FORMAT "%.15" /end CHARACTERISTIC
/begin CHARACTERISTIC rtARID_DEF_CpApEssRx100_3.PP_SG_HVESSS2_BMS2_VDP_SG_HVESS.LmtChrg_Diag "" VALUE 0x340EF327 __UBYTE_S 0 NO_COMPU_METHOD 0 255 FORMAT "%.15" /end CHARACTERISTIC
/begin CHARACTERISTIC rtARID_DEF_CpApEssRx100_3.PP_SG_HVESSS2_BMS2_VDP_SG_HVESS.LmtChrg_Soc "" VALUE 0x340EF328 __UBYTE_S 0 NO_COMPU_METHOD 0 255 FORMAT "%.15" /end CHARACTERISTIC
/begin CHARACTERISTIC rtARID_DEF_CpApEssRx100_3.PP_SG_HVESSS2_BMS2_VDP_SG_HVESS.LmtChrg_Tbd "" VALUE 0x340EF329 __UBYTE_S 0 NO_COMPU_METHOD 0 255 FORMAT "%.15" /end CHARACTERISTIC
/begin CHARACTERISTIC rtARID_DEF_CpApEssRx100_3.PP_SG_HVESSS2_BMS2_VDP_SG_HVESS.LmtChrg_Tmpr "" VALUE 0x340EF32A __UBYTE_S 0 NO_COMPU_METHOD 0 255 FORMAT "%.15" /end CHARACTERISTIC
/begin CHARACTERISTIC rtARID_DEF_CpApEssRx100_3.PP_SG_HVESSS2_BMS2_VDP_SG_HVESS.LmtChrg_Volt "" VALUE 0x340EF32B __UBYTE_S 0 NO_COMPU_METHOD 0 255 FORMAT "%.15" /end CHARACTERISTIC
/begin CHARACTERISTIC rtARID_DEF_CpApEssRx100_3.PP_SG_HVESSS2_BMS2_VDP_SG_HVESS.LmtDschrg_Curr "" VALUE 0x340EF32C __UBYTE_S 0 NO_COMPU_METHOD 0 255 FORMAT "%.15" /end CHARACTERISTIC
/begin CHARACTERISTIC rtARID_DEF_CpApEssRx100_3.PP_SG_HVESSS2_BMS2_VDP_SG_HVESS.LmtDschrg_Diag "" VALUE 0x340EF32D __UBYTE_S 0 NO_COMPU_METHOD 0 255 FORMAT "%.15" /end CHARACTERISTIC
/begin CHARACTERISTIC rtARID_DEF_CpApEssRx100_3.PP_SG_HVESSS2_BMS2_VDP_SG_HVESS.LmtDschrg_Soc "" VALUE 0x340EF32E __UBYTE_S 0 NO_COMPU_METHOD 0 255 FORMAT "%.15" /end CHARACTERISTIC
/begin CHARACTERISTIC rtARID_DEF_CpApEssRx100_3.PP_SG_HVESSS2_BMS2_VDP_SG_HVESS.LmtDschrg_Tbd "" VALUE 0x340EF32F __UBYTE_S 0 NO_COMPU_METHOD 0 255 FORMAT "%.15" /end CHARACTERISTIC
/begin CHARACTERISTIC rtARID_DEF_CpApEssRx100_3.PP_SG_HVESSS2_BMS2_VDP_SG_HVESS.LmtDschrg_Tmpr "" VALUE 0x340EF330 __UBYTE_S 0 NO_COMPU_METHOD 0 255 FORMAT "%.15" /end CHARACTERISTIC
/begin CHARACTERISTIC rtARID_DEF_CpApEssRx100_3.PP_SG_HVESSS2_BMS2_VDP_SG_HVESS.LmtDschrg_Volt "" VALUE 0x340EF331 __UBYTE_S 0 NO_COMPU_METHOD 0 255 FORMAT "%.15" /end CHARACTERISTIC
/begin CHARACTERISTIC rtARID_DEF_CpApEssRx20.PP_SG_HVESSD1_BMS2_VDP_SG_HVESS.MvCurrBatt "" VALUE 0x340EF350 __FLOAT32_IEEE_S 0 NO_COMPU_METHOD -3.40282346639E+38 3.40282346639E+38 FORMAT "%.15" /end CHARACTERISTIC
/begin CHARACTERISTIC rtARID_DEF_CpApEssRx20.PP_SG_HVESSD1_BMS2_VDP_SG_HVESS.MvVoltBatt "" VALUE 0x340EF354 __FLOAT32_IEEE_S 0 NO_COMPU_METHOD -3.40282346639E+38 3.40282346639E+38 FORMAT "%.15" /end CHARACTERISTIC
/begin CHARACTERISTIC rtARID_DEF_CpApEssRx20.PP_SG_HVESSD1_BMS2_VDP_SG_HVESS.PwrAvailChrg "" VALUE 0x340EF358 __FLOAT32_IEEE_S 0 NO_COMPU_METHOD -3.40282346639E+38 3.40282346639E+38 FORMAT "%.15" /end CHARACTERISTIC
/begin CHARACTERISTIC rtARID_DEF_CpApEssRx20.PP_SG_HVESSD1_BMS2_VDP_SG_HVESS.PwrAvailDischrg "" VALUE 0x340EF35C __FLOAT32_IEEE_S 0 NO_COMPU_METHOD -3.40282346639E+38 3.40282346639E+38 FORMAT "%.15" /end CHARACTERISTIC
/begin MEASUREMENT rtARID_DEF_CpApEssRx500.PP_SG_mCurrAvailPeak_BMS2_VDP_S.CurrAvailChrgPeak "" FLOAT32_IEEE NO_COMPU_METHOD 0 0 -3.40282346639E+38 3.40282346639E+38 ECU_ADDRESS 0x340EF370 FORMAT "%.15" /end MEASUREMENT
/begin MEASUREMENT rtARID_DEF_CpApEssRx500.PP_SG_mCurrAvailPeak_BMS2_VDP_S.CurrAvailDschrgPeak "" FLOAT32_IEEE NO_COMPU_METHOD 0 0 -3.40282346639E+38 3.40282346639E+38 ECU_ADDRESS 0x340EF374 FORMAT "%.15" /end MEASUREMENT
/begin MEASUREMENT rtARID_DEF_CpApFcmRx100.PP_SG_FCM_0x487_VDT_SG_FCM_0x48.FCM_BattVoltBelowThd "" UBYTE NO_COMPU_METHOD 0 0 0 255 ECU_ADDRESS 0x340EF380 FORMAT "%.15" /end MEASUREMENT
/begin MEASUREMENT rtARID_DEF_CpApFcmRx100.PP_SG_FCM_0x487_VDT_SG_FCM_0x48.FCM_BattVoltOverThd "" UBYTE NO_COMPU_METHOD 0 0 0 255 ECU_ADDRESS 0x340EF381 FORMAT "%.15" /end MEASUREMENT
/begin MEASUREMENT rtARID_DEF_CpApFcmRx100.PP_SG_FCM_0x487_VDT_SG_FCM_0x48.FCM_CamBli "" UBYTE NO_COMPU_METHOD 0 0 0 255 ECU_ADDRESS 0x340EF382 FORMAT "%.15" /end MEASUREMENT
/begin MEASUREMENT rtARID_DEF_CpApFcmRx100.PP_SG_FCM_0x487_VDT_SG_FCM_0x48.FCM_ChkInvldSig_CIM "" UBYTE NO_COMPU_METHOD 0 0 0 255 ECU_ADDRESS 0x340EF383 FORMAT "%.15" /end MEASUREMENT
/begin MEASUREMENT rtARID_DEF_CpApFcmRx100.PP_SG_FCM_0x487_VDT_SG_FCM_0x48.FCM_ChkInvldSig_ECC "" UBYTE NO_COMPU_METHOD 0 0 0 255 ECU_ADDRESS 0x340EF384 FORMAT "%.15" /end MEASUREMENT
/begin MEASUREMENT rtARID_DEF_CpApFcmRx100.PP_SG_FCM_0x487_VDT_SG_FCM_0x48.FCM_ChkInvldSig_EPS "" UBYTE NO_COMPU_METHOD 0 0 0 255 ECU_ADDRESS 0x340EF385 FORMAT "%.15" /end MEASUREMENT
/begin MEASUREMENT rtARID_DEF_CpApFcmRx100.PP_SG_FCM_0x487_VDT_SG_FCM_0x48.FCM_ChkInvldSig_ESP "" UBYTE NO_COMPU_METHOD 0 0 0 255 ECU_ADDRESS 0x340EF386 FORMAT "%.15" /end MEASUREMENT
/begin MEASUREMENT rtARID_DEF_CpApFcmRx100.PP_SG_FCM_0x487_VDT_SG_FCM_0x48.FCM_ChkInvldSig_ICC "" UBYTE NO_COMPU_METHOD 0 0 0 255 ECU_ADDRESS 0x340EF388 FORMAT "%.15" /end MEASUREMENT
/begin MEASUREMENT rtARID_DEF_CpApFcmRx100.PP_SG_FCM_0x487_VDT_SG_FCM_0x48.FCM_ChkInvldSig_PEPS "" UBYTE NO_COMPU_METHOD 0 0 0 255 ECU_ADDRESS 0x340EF389 FORMAT "%.15" /end MEASUREMENT
/begin MEASUREMENT rtARID_DEF_CpApFcmRx100.PP_SG_FCM_0x487_VDT_SG_FCM_0x48.FCM_ChkInvldSig_YRS "" UBYTE NO_COMPU_METHOD 0 0 0 255 ECU_ADDRESS 0x340EF38A FORMAT "%.15" /end MEASUREMENT
/begin MEASUREMENT rtARID_DEF_CpApFcmRx100.PP_SG_FCM_0x487_VDT_SG_FCM_0x48.FCM_ChkInvldSig_iBooster "" UBYTE NO_COMPU_METHOD 0 0 0 255 ECU_ADDRESS 0x340EF387 FORMAT "%.15" /end MEASUREMENT
/begin MEASUREMENT rtARID_DEF_CpApFcmRx100.PP_SG_FCM_0x487_VDT_SG_FCM_0x48.FCM_ChkPrivateCANBusOff "" UBYTE NO_COMPU_METHOD 0 0 0 255 ECU_ADDRESS 0x340EF38B FORMAT "%.15" /end MEASUREMENT
/begin MEASUREMENT rtARID_DEF_CpApFcmRx100.PP_SG_FCM_0x487_VDT_SG_FCM_0x48.FCM_ChkPublicCANBusOff "" UBYTE NO_COMPU_METHOD 0 0 0 255 ECU_ADDRESS 0x340EF38C FORMAT "%.15" /end MEASUREMENT
/begin MEASUREMENT rtARID_DEF_CpApFcmRx100.PP_SG_FCM_0x487_VDT_SG_FCM_0x48.FCM_ComE2EFlt "" UBYTE NO_COMPU_METHOD 0 0 0 255 ECU_ADDRESS 0x340EF38D FORMAT "%.15" /end MEASUREMENT
/begin MEASUREMENT rtARID_DEF_CpApFcmRx100.PP_SG_FCM_0x487_VDT_SG_FCM_0x48.FCM_ComLostFlt_ADAS "" UBYTE NO_COMPU_METHOD 0 0 0 255 ECU_ADDRESS 0x340EF38E FORMAT "%.15" /end MEASUREMENT
/begin MEASUREMENT rtARID_DEF_CpApFcmRx100.PP_SG_FCM_0x487_VDT_SG_FCM_0x48.FCM_ComLostFlt_BCM "" UBYTE NO_COMPU_METHOD 0 0 0 255 ECU_ADDRESS 0x340EF38F FORMAT "%.15" /end MEASUREMENT
/begin MEASUREMENT rtARID_DEF_CpApFcmRx100.PP_SG_FCM_0x487_VDT_SG_FCM_0x48.FCM_ComLostFlt_CIM "" UBYTE NO_COMPU_METHOD 0 0 0 255 ECU_ADDRESS 0x340EF390 FORMAT "%.15" /end MEASUREMENT
/begin MEASUREMENT rtARID_DEF_CpApFcmRx100.PP_SG_FCM_0x487_VDT_SG_FCM_0x48.FCM_ComLostFlt_ECC "" UBYTE NO_COMPU_METHOD 0 0 0 255 ECU_ADDRESS 0x340EF391 FORMAT "%.15" /end MEASUREMENT
/begin MEASUREMENT rtARID_DEF_CpApFcmRx100.PP_SG_FCM_0x487_VDT_SG_FCM_0x48.FCM_ComLostFlt_EPS "" UBYTE NO_COMPU_METHOD 0 0 0 255 ECU_ADDRESS 0x340EF392 FORMAT "%.15" /end MEASUREMENT
/begin MEASUREMENT rtARID_DEF_CpApFcmRx100.PP_SG_FCM_0x487_VDT_SG_FCM_0x48.FCM_ComLostFlt_ESP "" UBYTE NO_COMPU_METHOD 0 0 0 255 ECU_ADDRESS 0x340EF393 FORMAT "%.15" /end MEASUREMENT
/begin MEASUREMENT rtARID_DEF_CpApFcmRx100.PP_SG_FCM_0x487_VDT_SG_FCM_0x48.FCM_ComLostFlt_ICC "" UBYTE NO_COMPU_METHOD 0 0 0 255 ECU_ADDRESS 0x340EF395 FORMAT "%.15" /end MEASUREMENT
/begin MEASUREMENT rtARID_DEF_CpApFcmRx100.PP_SG_FCM_0x487_VDT_SG_FCM_0x48.FCM_ComLostFlt_MRR "" UBYTE NO_COMPU_METHOD 0 0 0 255 ECU_ADDRESS 0x340EF396 FORMAT "%.15" /end MEASUREMENT
/begin MEASUREMENT rtARID_DEF_CpApFcmRx100.PP_SG_FCM_0x487_VDT_SG_FCM_0x48.FCM_ComLostFlt_PEPS "" UBYTE NO_COMPU_METHOD 0 0 0 255 ECU_ADDRESS 0x340EF397 FORMAT "%.15" /end MEASUREMENT
/begin MEASUREMENT rtARID_DEF_CpApFcmRx100.PP_SG_FCM_0x487_VDT_SG_FCM_0x48.FCM_ComLostFlt_TBOX "" UBYTE NO_COMPU_METHOD 0 0 0 255 ECU_ADDRESS 0x340EF398 FORMAT "%.15" /end MEASUREMENT
/begin MEASUREMENT rtARID_DEF_CpApFcmRx100.PP_SG_FCM_0x487_VDT_SG_FCM_0x48.FCM_ComLostFlt_YRS "" UBYTE NO_COMPU_METHOD 0 0 0 255 ECU_ADDRESS 0x340EF399 FORMAT "%.15" /end MEASUREMENT
/begin MEASUREMENT rtARID_DEF_CpApFcmRx100.PP_SG_FCM_0x487_VDT_SG_FCM_0x48.FCM_ComLostFlt_iBooster "" UBYTE NO_COMPU_METHOD 0 0 0 255 ECU_ADDRESS 0x340EF394 FORMAT "%.15" /end MEASUREMENT
/begin MEASUREMENT rtARID_DEF_CpApFcmRx100.PP_SG_FCM_0x487_VDT_SG_FCM_0x48.FCM_DLCFlt_ADAS "" UBYTE NO_COMPU_METHOD 0 0 0 255 ECU_ADDRESS 0x340EF39A FORMAT "%.15" /end MEASUREMENT
/begin MEASUREMENT rtARID_DEF_CpApFcmRx100.PP_SG_FCM_0x487_VDT_SG_FCM_0x48.FCM_DLCFlt_BCM "" UBYTE NO_COMPU_METHOD 0 0 0 255 ECU_ADDRESS 0x340EF39B FORMAT "%.15" /end MEASUREMENT
/begin MEASUREMENT rtARID_DEF_CpApFcmRx100.PP_SG_FCM_0x487_VDT_SG_FCM_0x48.FCM_DLCFlt_CIM "" UBYTE NO_COMPU_METHOD 0 0 0 255 ECU_ADDRESS 0x340EF39C FORMAT "%.15" /end MEASUREMENT
/begin MEASUREMENT rtARID_DEF_CpApFcmRx100.PP_SG_FCM_0x487_VDT_SG_FCM_0x48.FCM_DLCFlt_ECC "" UBYTE NO_COMPU_METHOD 0 0 0 255 ECU_ADDRESS 0x340EF39D FORMAT "%.15" /end MEASUREMENT
/begin MEASUREMENT rtARID_DEF_CpApFcmRx100.PP_SG_FCM_0x487_VDT_SG_FCM_0x48.FCM_DLCFlt_EPS "" UBYTE NO_COMPU_METHOD 0 0 0 255 ECU_ADDRESS 0x340EF39E FORMAT "%.15" /end MEASUREMENT
/begin MEASUREMENT rtARID_DEF_CpApFcmRx100.PP_SG_FCM_0x487_VDT_SG_FCM_0x48.FCM_DLCFlt_ESP "" UBYTE NO_COMPU_METHOD 0 0 0 255 ECU_ADDRESS 0x340EF39F FORMAT "%.15" /end MEASUREMENT
/begin MEASUREMENT rtARID_DEF_CpApFcmRx100.PP_SG_FCM_0x487_VDT_SG_FCM_0x48.FCM_DLCFlt_ICC "" UBYTE NO_COMPU_METHOD 0 0 0 255 ECU_ADDRESS 0x340EF3A1 FORMAT "%.15" /end MEASUREMENT
/begin MEASUREMENT rtARID_DEF_CpApFcmRx100.PP_SG_FCM_0x487_VDT_SG_FCM_0x48.FCM_DLCFlt_MRR "" UBYTE NO_COMPU_METHOD 0 0 0 255 ECU_ADDRESS 0x340EF3A2 FORMAT "%.15" /end MEASUREMENT
/begin MEASUREMENT rtARID_DEF_CpApFcmRx100.PP_SG_FCM_0x487_VDT_SG_FCM_0x48.FCM_DLCFlt_PEPS "" UBYTE NO_COMPU_METHOD 0 0 0 255 ECU_ADDRESS 0x340EF3A3 FORMAT "%.15" /end MEASUREMENT
/begin MEASUREMENT rtARID_DEF_CpApFcmRx100.PP_SG_FCM_0x487_VDT_SG_FCM_0x48.FCM_DLCFlt_TBOX "" UBYTE NO_COMPU_METHOD 0 0 0 255 ECU_ADDRESS 0x340EF3A4 FORMAT "%.15" /end MEASUREMENT
/begin MEASUREMENT rtARID_DEF_CpApFcmRx100.PP_SG_FCM_0x487_VDT_SG_FCM_0x48.FCM_DLCFlt_YRS "" UBYTE NO_COMPU_METHOD 0 0 0 255 ECU_ADDRESS 0x340EF3A5 FORMAT "%.15" /end MEASUREMENT
/begin MEASUREMENT rtARID_DEF_CpApFcmRx100.PP_SG_FCM_0x487_VDT_SG_FCM_0x48.FCM_DLCFlt_iBooster "" UBYTE NO_COMPU_METHOD 0 0 0 255 ECU_ADDRESS 0x340EF3A0 FORMAT "%.15" /end MEASUREMENT
/begin MEASUREMENT rtARID_DEF_CpApFcmRx100.PP_SG_FCM_0x487_VDT_SG_FCM_0x48.FCM_ECUTmpHiTProtn "" UBYTE NO_COMPU_METHOD 0 0 0 255 ECU_ADDRESS 0x340EF3A6 FORMAT "%.15" /end MEASUREMENT
/begin MEASUREMENT rtARID_DEF_CpApFcmRx100.PP_SG_FCM_0x487_VDT_SG_FCM_0x48.FCM_IniCalOutOfRng "" UBYTE NO_COMPU_METHOD 0 0 0 255 ECU_ADDRESS 0x340EF3A7 FORMAT "%.15" /end MEASUREMENT
/begin MEASUREMENT rtARID_DEF_CpApFcmRx100.PP_SG_FCM_0x487_VDT_SG_FCM_0x48.FCM_IniCalTimeout "" UBYTE NO_COMPU_METHOD 0 0 0 255 ECU_ADDRESS 0x340EF3A8 FORMAT "%.15" /end MEASUREMENT
/begin MEASUREMENT rtARID_DEF_CpApFcmRx100.PP_SG_FCM_0x487_VDT_SG_FCM_0x48.FCM_IntCircFlt "" UBYTE NO_COMPU_METHOD 0 0 0 255 ECU_ADDRESS 0x340EF3A9 FORMAT "%.15" /end MEASUREMENT
/begin MEASUREMENT rtARID_DEF_CpApFcmRx100.PP_SG_FCM_0x487_VDT_SG_FCM_0x48.FCM_IntCircOutpVoltBelowThd "" UBYTE NO_COMPU_METHOD 0 0 0 255 ECU_ADDRESS 0x340EF3AA FORMAT "%.15" /end MEASUREMENT
/begin MEASUREMENT rtARID_DEF_CpApFcmRx100.PP_SG_FCM_0x487_VDT_SG_FCM_0x48.FCM_IntCircOutpVoltOverThd "" UBYTE NO_COMPU_METHOD 0 0 0 255 ECU_ADDRESS 0x340EF3AB FORMAT "%.15" /end MEASUREMENT
/begin MEASUREMENT rtARID_DEF_CpApFcmRx100.PP_SG_FCM_0x487_VDT_SG_FCM_0x48.FCM_IntCircPrmntFlt "" UBYTE NO_COMPU_METHOD 0 0 0 255 ECU_ADDRESS 0x340EF3AC FORMAT "%.15" /end MEASUREMENT
/begin MEASUREMENT rtARID_DEF_CpApFcmRx100.PP_SG_FCM_0x487_VDT_SG_FCM_0x48.FCM_MatchParaErr "" UBYTE NO_COMPU_METHOD 0 0 0 255 ECU_ADDRESS 0x340EF3AD FORMAT "%.15" /end MEASUREMENT
/begin MEASUREMENT rtARID_DEF_CpApFcmRx100.PP_SG_FCM_0x487_VDT_SG_FCM_0x48.FCM_NotCal "" UBYTE NO_COMPU_METHOD 0 0 0 255 ECU_ADDRESS 0x340EF3AE FORMAT "%.15" /end MEASUREMENT
/begin MEASUREMENT rtARID_DEF_CpApFcmRx100.PP_SG_FCM_0x487_VDT_SG_FCM_0x48.FCM_OTARdy_Fb "" UBYTE NO_COMPU_METHOD 0 0 0 255 ECU_ADDRESS 0x340EF3B0 FORMAT "%.15" /end MEASUREMENT
/begin MEASUREMENT rtARID_DEF_CpApFcmRx100.PP_SG_FCM_0x487_VDT_SG_FCM_0x48.FCM_OnlineCalOutOfRng "" UBYTE NO_COMPU_METHOD 0 0 0 255 ECU_ADDRESS 0x340EF3AF FORMAT "%.15" /end MEASUREMENT
/begin MEASUREMENT rtARID_DEF_CpApFcmRx100.PP_SG_FCM_0x487_VDT_SG_FCM_0x48.FCM_VehCfgInfoErr "" UBYTE NO_COMPU_METHOD 0 0 0 255 ECU_ADDRESS 0x340EF3B1 FORMAT "%.15" /end MEASUREMENT
/begin MEASUREMENT rtARID_DEF_CpApFcmRx1000.PP_SG_FCM_0x67D_VDT_SG_FCM_0x67.FCM_HwVers "" UBYTE NO_COMPU_METHOD 0 0 0 255 ECU_ADDRESS 0x340EF3E4 FORMAT "%.15" /end MEASUREMENT
/begin MEASUREMENT rtARID_DEF_CpApFcmRx1000.PP_SG_FCM_0x67D_VDT_SG_FCM_0x67.FCM_PartVers "" ULONG NO_COMPU_METHOD 0 0 0 4294967295 ECU_ADDRESS 0x340EF3E8 FORMAT "%.15" /end MEASUREMENT
/begin MEASUREMENT rtARID_DEF_CpApFcmRx1000.PP_SG_FCM_0x67D_VDT_SG_FCM_0x67.FCM_SwVersM "" UBYTE NO_COMPU_METHOD 0 0 0 255 ECU_ADDRESS 0x340EF3EC FORMAT "%.15" /end MEASUREMENT
/begin MEASUREMENT rtARID_DEF_CpApFcmRx1000.PP_SG_FCM_0x67D_VDT_SG_FCM_0x67.FCM_SwVersS "" UBYTE NO_COMPU_METHOD 0 0 0 255 ECU_ADDRESS 0x340EF3ED FORMAT "%.15" /end MEASUREMENT
/begin MEASUREMENT rtARID_DEF_CpApFcmRx60.PP_SG_FCM_NM_0x42E_VDT_SG_FCM_N.FCM_CtrlBitVector_Bit0_RMR "" UBYTE NO_COMPU_METHOD 0 0 0 255 ECU_ADDRESS 0x340EF3F8 FORMAT "%.15" /end MEASUREMENT
/begin MEASUREMENT rtARID_DEF_CpApFcmRx60.PP_SG_FCM_NM_0x42E_VDT_SG_FCM_N.FCM_CtrlBitVector_Bit1_Res "" UBYTE NO_COMPU_METHOD 0 0 0 255 ECU_ADDRESS 0x340EF3F9 FORMAT "%.15" /end MEASUREMENT
/begin MEASUREMENT rtARID_DEF_CpApFcmRx60.PP_SG_FCM_NM_0x42E_VDT_SG_FCM_N.FCM_CtrlBitVector_Bit2_Res "" UBYTE NO_COMPU_METHOD 0 0 0 255 ECU_ADDRESS 0x340EF3FA FORMAT "%.15" /end MEASUREMENT
/begin MEASUREMENT rtARID_DEF_CpApFcmRx60.PP_SG_FCM_NM_0x42E_VDT_SG_FCM_N.FCM_CtrlBitVector_Bit3_NMCoord "" UBYTE NO_COMPU_METHOD 0 0 0 255 ECU_ADDRESS 0x340EF3FB FORMAT "%.15" /end MEASUREMENT
/begin MEASUREMENT rtARID_DEF_CpApFcmRx60.PP_SG_FCM_NM_0x42E_VDT_SG_FCM_N.FCM_CtrlBitVector_Bit4_ActWake "" UBYTE NO_COMPU_METHOD 0 0 0 255 ECU_ADDRESS 0x340EF3FC FORMAT "%.15" /end MEASUREMENT
/begin MEASUREMENT rtARID_DEF_CpApFcmRx60.PP_SG_FCM_NM_0x42E_VDT_SG_FCM_N.FCM_CtrlBitVector_Bit5_Res "" UBYTE NO_COMPU_METHOD 0 0 0 255 ECU_ADDRESS 0x340EF3FD FORMAT "%.15" /end MEASUREMENT
/begin MEASUREMENT rtARID_DEF_CpApFcmRx60.PP_SG_FCM_NM_0x42E_VDT_SG_FCM_N.FCM_CtrlBitVector_Bit6_PNI "" UBYTE NO_COMPU_METHOD 0 0 0 255 ECU_ADDRESS 0x340EF3FE FORMAT "%.15" /end MEASUREMENT
/begin MEASUREMENT rtARID_DEF_CpApFcmRx60.PP_SG_FCM_NM_0x42E_VDT_SG_FCM_N.FCM_CtrlBitVector_Bit7_Res "" UBYTE NO_COMPU_METHOD 0 0 0 255 ECU_ADDRESS 0x340EF3FF FORMAT "%.15" /end MEASUREMENT
/begin MEASUREMENT rtARID_DEF_CpApFcmRx60.PP_SG_FCM_NM_0x42E_VDT_SG_FCM_N.FCM_SrcNodeID "" UBYTE NO_COMPU_METHOD 0 0 0 255 ECU_ADDRESS 0x340EF400 FORMAT "%.15" /end MEASUREMENT
/begin MEASUREMENT rtARID_DEF_CpApFcmRx60.PP_SG_FCM_NM_0x42E_VDT_SG_FCM_N.FCM_UsrData0 "" UBYTE NO_COMPU_METHOD 0 0 0 255 ECU_ADDRESS 0x340EF401 FORMAT "%.15" /end MEASUREMENT
/begin MEASUREMENT rtARID_DEF_CpApFcmRx60.PP_SG_FCM_NM_0x42E_VDT_SG_FCM_N.FCM_UsrData1_Bit0_IGN_WAKEUP "" UBYTE NO_COMPU_METHOD 0 0 0 255 ECU_ADDRESS 0x340EF402 FORMAT "%.15" /end MEASUREMENT
/begin MEASUREMENT rtARID_DEF_CpApFcmRx60.PP_SG_FCM_NM_0x42E_VDT_SG_FCM_N.FCM_UsrData1_Bit1_RESET_WAKEUP "" UBYTE NO_COMPU_METHOD 0 0 0 255 ECU_ADDRESS 0x340EF403 FORMAT "%.15" /end MEASUREMENT
/begin MEASUREMENT rtARID_DEF_CpApFcmRx60.PP_SG_FCM_NM_0x42E_VDT_SG_FCM_N.FCM_UsrData1_Bit2_NETWORK_WAKEUP "" UBYTE NO_COMPU_METHOD 0 0 0 255 ECU_ADDRESS 0x340EF404 FORMAT "%.15" /end MEASUREMENT
/begin MEASUREMENT rtARID_DEF_CpApFcmRx60.PP_SG_FCM_NM_0x42E_VDT_SG_FCM_N.FCM_UsrData1_Bit3_ECUSPEC_WAKEUP "" UBYTE NO_COMPU_METHOD 0 0 0 255 ECU_ADDRESS 0x340EF405 FORMAT "%.15" /end MEASUREMENT
/begin MEASUREMENT rtARID_DEF_CpApFcmRx60.PP_SG_FCM_NM_0x42E_VDT_SG_FCM_N.FCM_UsrData1_Bit4_NETWORK_AWAKE "" UBYTE NO_COMPU_METHOD 0 0 0 255 ECU_ADDRESS 0x340EF406 FORMAT "%.15" /end MEASUREMENT
/begin MEASUREMENT rtARID_DEF_CpApFcmRx60.PP_SG_FCM_NM_0x42E_VDT_SG_FCM_N.FCM_UsrData1_Bit5_IGNITION_AWAKE "" UBYTE NO_COMPU_METHOD 0 0 0 255 ECU_ADDRESS 0x340EF407 FORMAT "%.15" /end MEASUREMENT
/begin MEASUREMENT rtARID_DEF_CpApFcmRx60.PP_SG_FCM_NM_0x42E_VDT_SG_FCM_N.FCM_UsrData1_Bit6_DIAGN_AWAKE "" UBYTE NO_COMPU_METHOD 0 0 0 255 ECU_ADDRESS 0x340EF408 FORMAT "%.15" /end MEASUREMENT
/begin MEASUREMENT rtARID_DEF_CpApFcmRx60.PP_SG_FCM_NM_0x42E_VDT_SG_FCM_N.FCM_UsrData1_Bit7_ECUSPEC_AWAKE "" UBYTE NO_COMPU_METHOD 0 0 0 255 ECU_ADDRESS 0x340EF409 FORMAT "%.15" /end MEASUREMENT
/begin MEASUREMENT rtARID_DEF_CpApFcmRx60.PP_SG_FCM_NM_0x42E_VDT_SG_FCM_N.FCM_UsrData2 "" UBYTE NO_COMPU_METHOD 0 0 0 255 ECU_ADDRESS 0x340EF40A FORMAT "%.15" /end MEASUREMENT
/begin MEASUREMENT rtARID_DEF_CpApFcmRx60.PP_SG_FCM_NM_0x42E_VDT_SG_FCM_N.FCM_UsrData3 "" UBYTE NO_COMPU_METHOD 0 0 0 255 ECU_ADDRESS 0x340EF40B FORMAT "%.15" /end MEASUREMENT
/begin MEASUREMENT rtARID_DEF_CpApFcmRx60.PP_SG_FCM_NM_0x42E_VDT_SG_FCM_N.FCM_UsrData4_PN_Info1 "" UBYTE NO_COMPU_METHOD 0 0 0 255 ECU_ADDRESS 0x340EF40C FORMAT "%.15" /end MEASUREMENT
/begin MEASUREMENT rtARID_DEF_CpApFcmRx60.PP_SG_FCM_NM_0x42E_VDT_SG_FCM_N.FCM_UsrData5_PN_Info2 "" UBYTE NO_COMPU_METHOD 0 0 0 255 ECU_ADDRESS 0x340EF40D FORMAT "%.15" /end MEASUREMENT
/begin MEASUREMENT rtARID_DEF_CpApSbwRx10.PP_SG_mSbwPosition_VDP_SG_mSbwP.LeftStopLmt "" UBYTE NO_COMPU_METHOD 0 0 0 255 ECU_ADDRESS 0x340EFA6C FORMAT "%.15" /end MEASUREMENT
/begin MEASUREMENT rtARID_DEF_CpApSbwRx10.PP_SG_mSbwPosition_VDP_SG_mSbwP.MsgCntr "" UBYTE NO_COMPU_METHOD 0 0 0 255 ECU_ADDRESS 0x340EFA6D FORMAT "%.15" /end MEASUREMENT
/begin MEASUREMENT rtARID_DEF_CpApSbwRx10.PP_SG_mSbwPosition_VDP_SG_mSbwP.MsgCrc "" UBYTE NO_COMPU_METHOD 0 0 0 255 ECU_ADDRESS 0x340EFA6E FORMAT "%.15" /end MEASUREMENT
/begin MEASUREMENT rtARID_DEF_CpApSbwRx10.PP_SG_mSbwPosition_VDP_SG_mSbwP.Position "" FLOAT32_IEEE NO_COMPU_METHOD 0 0 -3.40282346639E+38 3.40282346639E+38 ECU_ADDRESS 0x340EFA70 FORMAT "%.15" /end MEASUREMENT
/begin MEASUREMENT rtARID_DEF_CpApSbwRx10.PP_SG_mSbwPosition_VDP_SG_mSbwP.RawPosition "" FLOAT32_IEEE NO_COMPU_METHOD 0 0 -3.40282346639E+38 3.40282346639E+38 ECU_ADDRESS 0x340EFA74 FORMAT "%.15" /end MEASUREMENT
/begin MEASUREMENT rtARID_DEF_CpApSbwRx10.PP_SG_mSbwPosition_VDP_SG_mSbwP.RightStopLmt "" UBYTE NO_COMPU_METHOD 0 0 0 255 ECU_ADDRESS 0x340EFA78 FORMAT "%.15" /end MEASUREMENT
/begin MEASUREMENT rtARID_DEF_CpApSbwRx10.PP_SG_mSbwStat2_VDP_SG_mSbwStat.FaultLight "" UBYTE NO_COMPU_METHOD 0 0 0 255 ECU_ADDRESS 0x340EFA5C FORMAT "%.15" /end MEASUREMENT
/begin MEASUREMENT rtARID_DEF_CpApSbwRx10.PP_SG_mSbwStat2_VDP_SG_mSbwStat.FltCode "" UBYTE NO_COMPU_METHOD 0 0 0 255 ECU_ADDRESS 0x340EFA5D FORMAT "%.15" /end MEASUREMENT
/begin MEASUREMENT rtARID_DEF_CpApSbwRx10.PP_SG_mSbwStat2_VDP_SG_mSbwStat.HostMode "" UBYTE NO_COMPU_METHOD 0 0 0 255 ECU_ADDRESS 0x340EFA5E FORMAT "%.15" /end MEASUREMENT
/begin MEASUREMENT rtARID_DEF_CpApSbwRx10.PP_SG_mSbwStat2_VDP_SG_mSbwStat.LeftStopLmt "" UBYTE NO_COMPU_METHOD 0 0 0 255 ECU_ADDRESS 0x340EFA5F FORMAT "%.15" /end MEASUREMENT
/begin MEASUREMENT rtARID_DEF_CpApSbwRx10.PP_SG_mSbwStat2_VDP_SG_mSbwStat.MtrAdjust "" UBYTE NO_COMPU_METHOD 0 0 0 255 ECU_ADDRESS 0x340EFA60 FORMAT "%.15" /end MEASUREMENT
/begin MEASUREMENT rtARID_DEF_CpApSbwRx10.PP_SG_mSbwStat2_VDP_SG_mSbwStat.OverTemp "" UBYTE NO_COMPU_METHOD 0 0 0 255 ECU_ADDRESS 0x340EFA61 FORMAT "%.15" /end MEASUREMENT
/begin MEASUREMENT rtARID_DEF_CpApSbwRx10.PP_SG_mSbwStat2_VDP_SG_mSbwStat.ProtectActive "" UBYTE NO_COMPU_METHOD 0 0 0 255 ECU_ADDRESS 0x340EFA62 FORMAT "%.15" /end MEASUREMENT
/begin MEASUREMENT rtARID_DEF_CpApSbwRx10.PP_SG_mSbwStat2_VDP_SG_mSbwStat.RS232Mode "" UBYTE NO_COMPU_METHOD 0 0 0 255 ECU_ADDRESS 0x340EFA65 FORMAT "%.15" /end MEASUREMENT
/begin MEASUREMENT rtARID_DEF_CpApSbwRx10.PP_SG_mSbwStat2_VDP_SG_mSbwStat.RemModeActive "" UBYTE NO_COMPU_METHOD 0 0 0 255 ECU_ADDRESS 0x340EFA63 FORMAT "%.15" /end MEASUREMENT
/begin MEASUREMENT rtARID_DEF_CpApSbwRx10.PP_SG_mSbwStat2_VDP_SG_mSbwStat.RightStopLmt "" UBYTE NO_COMPU_METHOD 0 0 0 255 ECU_ADDRESS 0x340EFA64 FORMAT "%.15" /end MEASUREMENT
/begin MEASUREMENT rtARID_DEF_CpApSbwRx10.PP_SG_mSbwStat2_VDP_SG_mSbwStat.SelectedMap "" UBYTE NO_COMPU_METHOD 0 0 0 255 ECU_ADDRESS 0x340EFA66 FORMAT "%.15" /end MEASUREMENT
/begin MEASUREMENT rtARID_DEF_CpApSbwRx10.PP_SG_mSbwStat2_VDP_SG_mSbwStat.SteerAngle "" UWORD NO_COMPU_METHOD 0 0 0 65535 ECU_ADDRESS 0x340EFA68 FORMAT "%.15" /end MEASUREMENT
/begin MEASUREMENT rtARID_DEF_CpApSbwRx10.PP_SG_mSbwStat2_VDP_SG_mSbwStat.SteerAngle8b "" UBYTE NO_COMPU_METHOD 0 0 0 255 ECU_ADDRESS 0x340EFA6A FORMAT "%.15" /end MEASUREMENT
/begin MEASUREMENT rtARID_DEF_CpApSbwRx10.PP_SG_mSbwStat_VDP_SG_mSbwStat.InvTmpr "" UBYTE NO_COMPU_METHOD 0 0 0 255 ECU_ADDRESS 0x340EFA44 FORMAT "%.15" /end MEASUREMENT
/begin MEASUREMENT rtARID_DEF_CpApSbwRx10.PP_SG_mSbwStat_VDP_SG_mSbwStat.LvVolt "" FLOAT32_IEEE NO_COMPU_METHOD 0 0 -3.40282346639E+38 3.40282346639E+38 ECU_ADDRESS 0x340EFA48 FORMAT "%.15" /end MEASUREMENT
/begin MEASUREMENT rtARID_DEF_CpApSbwRx10.PP_SG_mSbwStat_VDP_SG_mSbwStat.MtrCurr "" FLOAT32_IEEE NO_COMPU_METHOD 0 0 -3.40282346639E+38 3.40282346639E+38 ECU_ADDRESS 0x340EFA4C FORMAT "%.15" /end MEASUREMENT
/begin MEASUREMENT rtARID_DEF_CpApSbwRx10.PP_SG_mSbwStat_VDP_SG_mSbwStat.MtrDcStat "" SBYTE NO_COMPU_METHOD 0 0 -128 127 ECU_ADDRESS 0x340EFA50 FORMAT "%.15" /end MEASUREMENT
/begin MEASUREMENT rtARID_DEF_CpApSbwRx10.PP_SG_mSbwStat_VDP_SG_mSbwStat.MtrTrqEst "" FLOAT32_IEEE NO_COMPU_METHOD 0 0 -3.40282346639E+38 3.40282346639E+38 ECU_ADDRESS 0x340EFA54 FORMAT "%.15" /end MEASUREMENT
/begin MEASUREMENT rtARID_DEF_CpApSbwRx10.PP_SG_mSbwStat_VDP_SG_mSbwStat.SwitchStat "" UBYTE NO_COMPU_METHOD 0 0 0 255 ECU_ADDRESS 0x340EFA58 FORMAT "%.15" /end MEASUREMENT
/begin MEASUREMENT rtARID_DEF_CpApSbwRx10.PP_SG_mSbwStat_VDP_SG_mSbwStat.TrqSnsIn "" SBYTE NO_COMPU_METHOD 0 0 -128 127 ECU_ADDRESS 0x340EFA59 FORMAT "%.15" /end MEASUREMENT
/begin MEASUREMENT rtARID_DEF_CpApSbwRx10.PP_SG_mSbwStat_VDP_SG_mSbwStat.TrqSnsIn_1C "" UBYTE NO_COMPU_METHOD 0 0 0 255 ECU_ADDRESS 0x340EFA5A FORMAT "%.15" /end MEASUREMENT
/begin CHARACTERISTIC rtARID_DEF_CpApSbwRx100.PP_SG_mSbwFaults_VDP_SG_mSbwFau.FLT_Temp "" VALUE 0x340EFA9C __UBYTE_S 0 NO_COMPU_METHOD 0 255 FORMAT "%.15" /end CHARACTERISTIC
/begin CHARACTERISTIC rtARID_DEF_CpApSbwRx100.PP_SG_mSbwFaults_VDP_SG_mSbwFau.FltBattLow "" VALUE 0x340EFAA0 __UBYTE_S 0 NO_COMPU_METHOD 0 255 FORMAT "%.15" /end CHARACTERISTIC
/begin CHARACTERISTIC rtARID_DEF_CpApSbwRx100.PP_SG_mSbwFaults_VDP_SG_mSbwFau.Flt_AppCRC "" VALUE 0x340EFA8C __UBYTE_S 0 NO_COMPU_METHOD 0 255 FORMAT "%.15" /end CHARACTERISTIC
/begin CHARACTERISTIC rtARID_DEF_CpApSbwRx100.PP_SG_mSbwFaults_VDP_SG_mSbwFau.Flt_BattHigh "" VALUE 0x340EFA8D __UBYTE_S 0 NO_COMPU_METHOD 0 255 FORMAT "%.15" /end CHARACTERISTIC
/begin CHARACTERISTIC rtARID_DEF_CpApSbwRx100.PP_SG_mSbwFaults_VDP_SG_mSbwFau.Flt_BlockData "" VALUE 0x340EFA8E __UBYTE_S 0 NO_COMPU_METHOD 0 255 FORMAT "%.15" /end CHARACTERISTIC
/begin CHARACTERISTIC rtARID_DEF_CpApSbwRx100.PP_SG_mSbwFaults_VDP_SG_mSbwFau.Flt_BootCnt "" VALUE 0x340EFA8F __UBYTE_S 0 NO_COMPU_METHOD 0 255 FORMAT "%.15" /end CHARACTERISTIC
/begin CHARACTERISTIC rtARID_DEF_CpApSbwRx100.PP_SG_mSbwFaults_VDP_SG_mSbwFau.Flt_CfgCRC "" VALUE 0x340EFA90 __UBYTE_S 0 NO_COMPU_METHOD 0 255 FORMAT "%.15" /end CHARACTERISTIC
/begin CHARACTERISTIC rtARID_DEF_CpApSbwRx100.PP_SG_mSbwFaults_VDP_SG_mSbwFau.Flt_DrvSPI "" VALUE 0x340EFA91 __UBYTE_S 0 NO_COMPU_METHOD 0 255 FORMAT "%.15" /end CHARACTERISTIC
/begin CHARACTERISTIC rtARID_DEF_CpApSbwRx100.PP_SG_mSbwFaults_VDP_SG_mSbwFau.Flt_DrvWtch "" VALUE 0x340EFA92 __UBYTE_S 0 NO_COMPU_METHOD 0 255 FORMAT "%.15" /end CHARACTERISTIC
/begin CHARACTERISTIC rtARID_DEF_CpApSbwRx100.PP_SG_mSbwFaults_VDP_SG_mSbwFau.Flt_EEPROM "" VALUE 0x340EFA93 __UBYTE_S 0 NO_COMPU_METHOD 0 255 FORMAT "%.15" /end CHARACTERISTIC
/begin CHARACTERISTIC rtARID_DEF_CpApSbwRx100.PP_SG_mSbwFaults_VDP_SG_mSbwFau.Flt_ErrorCurrent "" VALUE 0x340EFA94 __UBYTE_S 0 NO_COMPU_METHOD 0 255 FORMAT "%.15" /end CHARACTERISTIC
/begin CHARACTERISTIC rtARID_DEF_CpApSbwRx100.PP_SG_mSbwFaults_VDP_SG_mSbwFau.Flt_GateDrv "" VALUE 0x340EFA95 __UBYTE_S 0 NO_COMPU_METHOD 0 255 FORMAT "%.15" /end CHARACTERISTIC
/begin CHARACTERISTIC rtARID_DEF_CpApSbwRx100.PP_SG_mSbwFaults_VDP_SG_mSbwFau.Flt_MfgCRC "" VALUE 0x340EFA96 __UBYTE_S 0 NO_COMPU_METHOD 0 255 FORMAT "%.15" /end CHARACTERISTIC
/begin CHARACTERISTIC rtARID_DEF_CpApSbwRx100.PP_SG_mSbwFaults_VDP_SG_mSbwFau.Flt_RotEnc "" VALUE 0x340EFA98 __UBYTE_S 0 NO_COMPU_METHOD 0 255 FORMAT "%.15" /end CHARACTERISTIC
/begin CHARACTERISTIC rtARID_DEF_CpApSbwRx100.PP_SG_mSbwFaults_VDP_SG_mSbwFau.Flt_RotEncBits "" VALUE 0x340EFA99 __UBYTE_S 0 NO_COMPU_METHOD 0 255 FORMAT "%.15" /end CHARACTERISTIC
/begin CHARACTERISTIC rtARID_DEF_CpApSbwRx100.PP_SG_mSbwFaults_VDP_SG_mSbwFau.Flt_RotEncVar "" VALUE 0x340EFA9A __UBYTE_S 0 NO_COMPU_METHOD 0 255 FORMAT "%.15" /end CHARACTERISTIC
/begin CHARACTERISTIC rtARID_DEF_CpApSbwRx100.PP_SG_mSbwFaults_VDP_SG_mSbwFau.Flt_SASRng "" VALUE 0x340EFA9B __UBYTE_S 0 NO_COMPU_METHOD 0 255 FORMAT "%.15" /end CHARACTERISTIC
/begin CHARACTERISTIC rtARID_DEF_CpApSbwRx100.PP_SG_mSbwFaults_VDP_SG_mSbwFau.Flt_TrqLinearity "" VALUE 0x340EFA9D __UBYTE_S 0 NO_COMPU_METHOD 0 255 FORMAT "%.15" /end CHARACTERISTIC
/begin CHARACTERISTIC rtARID_DEF_CpApSbwRx100.PP_SG_mSbwFaults_VDP_SG_mSbwFau.Flt_TrqRange "" VALUE 0x340EFA9E __UBYTE_S 0 NO_COMPU_METHOD 0 255 FORMAT "%.15" /end CHARACTERISTIC
/begin CHARACTERISTIC rtARID_DEF_CpApSbwRx100.PP_SG_mSbwFaults_VDP_SG_mSbwFau.Flt_VehicleSpd "" VALUE 0x340EFA9F __UBYTE_S 0 NO_COMPU_METHOD 0 255 FORMAT "%.15" /end CHARACTERISTIC
/begin CHARACTERISTIC rtARID_DEF_CpApSbwRx100.PP_SG_mSbwFaults_VDP_SG_mSbwFau.Flt_mSbwCtrl "" VALUE 0x340EFA97 __UBYTE_S 0 NO_COMPU_METHOD 0 255 FORMAT "%.15" /end CHARACTERISTIC
/begin CHARACTERISTIC rtARID_DEF_CpApSbwRx100.PP_SG_mSbwFaults_VDP_SG_mSbwFau.MsgCntr "" VALUE 0x340EFAA1 __UBYTE_S 0 NO_COMPU_METHOD 0 255 FORMAT "%.15" /end CHARACTERISTIC
/begin CHARACTERISTIC rtARID_DEF_CpApSbwRx100.PP_SG_mSbwFaults_VDP_SG_mSbwFau.MsgCrc "" VALUE 0x340EFAA2 __UBYTE_S 0 NO_COMPU_METHOD 0 255 FORMAT "%.15" /end CHARACTERISTIC
/begin CHARACTERISTIC rtARID_DEF_CpApSbwRx100.PP_SG_mSbwFaults_VDP_SG_mSbwFau.Warn_Temp "" VALUE 0x340EFAA3 __UBYTE_S 0 NO_COMPU_METHOD 0 255 FORMAT "%.15" /end CHARACTERISTIC
/begin MEASUREMENT rtARID_DEF_CpApSbwRx100.PP_SG_mSbwStat_Allied_VDP_SG_mS.BoardTemp "" UBYTE NO_COMPU_METHOD 0 0 0 255 ECU_ADDRESS 0x340EFA7C FORMAT "%.15" /end MEASUREMENT
/begin MEASUREMENT rtARID_DEF_CpApSbwRx100.PP_SG_mSbwStat_Allied_VDP_SG_mS.LvVolt "" FLOAT32_IEEE NO_COMPU_METHOD 0 0 -3.40282346639E+38 3.40282346639E+38 ECU_ADDRESS 0x340EFA80 FORMAT "%.15" /end MEASUREMENT
/begin MEASUREMENT rtARID_DEF_CpApSbwRx100.PP_SG_mSbwStat_Allied_VDP_SG_mS.MotorTemp "" UBYTE NO_COMPU_METHOD 0 0 0 255 ECU_ADDRESS 0x340EFA84 FORMAT "%.15" /end MEASUREMENT
/begin MEASUREMENT rtARID_DEF_CpApSbwRx100.PP_SG_mSbwStat_Allied_VDP_SG_mS.MsgCntr "" UBYTE NO_COMPU_METHOD 0 0 0 255 ECU_ADDRESS 0x340EFA85 FORMAT "%.15" /end MEASUREMENT
/begin MEASUREMENT rtARID_DEF_CpApSbwRx100.PP_SG_mSbwStat_Allied_VDP_SG_mS.MsgCrc "" UBYTE NO_COMPU_METHOD 0 0 0 255 ECU_ADDRESS 0x340EFA86 FORMAT "%.15" /end MEASUREMENT
/begin MEASUREMENT rtARID_DEF_CpApSbwRx100.PP_SG_mSbwStat_Allied_VDP_SG_mS.MtrCurr "" FLOAT32_IEEE NO_COMPU_METHOD 0 0 -3.40282346639E+38 3.40282346639E+38 ECU_ADDRESS 0x340EFA88 FORMAT "%.15" /end MEASUREMENT
/begin MEASUREMENT rtARID_DEF_CpApSbwRx10000.PP_SG_mSbwSys_Allied_VDP_SG_mSb.LeftEndStopValue "" UWORD NO_COMPU_METHOD 0 0 0 65535 ECU_ADDRESS 0x340EFAFC FORMAT "%.15" /end MEASUREMENT
/begin MEASUREMENT rtARID_DEF_CpApSbwRx10000.PP_SG_mSbwSys_Allied_VDP_SG_mSb.MsgCntr "" UBYTE NO_COMPU_METHOD 0 0 0 255 ECU_ADDRESS 0x340EFAFE FORMAT "%.15" /end MEASUREMENT
/begin MEASUREMENT rtARID_DEF_CpApSbwRx10000.PP_SG_mSbwSys_Allied_VDP_SG_mSb.MsgCrc "" UBYTE NO_COMPU_METHOD 0 0 0 255 ECU_ADDRESS 0x340EFAFF FORMAT "%.15" /end MEASUREMENT
/begin MEASUREMENT rtARID_DEF_CpApSbwRx10000.PP_SG_mSbwSys_Allied_VDP_SG_mSb.ProgOffset "" FLOAT32_IEEE NO_COMPU_METHOD 0 0 -3.40282346639E+38 3.40282346639E+38 ECU_ADDRESS 0x340EFB00 FORMAT "%.15" /end MEASUREMENT
/begin MEASUREMENT rtARID_DEF_CpApSbwRx10000.PP_SG_mSbwSys_Allied_VDP_SG_mSb.SwVerMaj "" UBYTE NO_COMPU_METHOD 0 0 0 255 ECU_ADDRESS 0x340EFB04 FORMAT "%.15" /end MEASUREMENT
/begin MEASUREMENT rtARID_DEF_CpApSbwRx10000.PP_SG_mSbwSys_Allied_VDP_SG_mSb.SwVerMin "" UBYTE NO_COMPU_METHOD 0 0 0 255 ECU_ADDRESS 0x340EFB05 FORMAT "%.15" /end MEASUREMENT
/begin MEASUREMENT rtARID_DEF_CpApSbwRx10000.PP_SG_mSbwSys_Allied_VDP_SG_mSb.SwVerRev "" UBYTE NO_COMPU_METHOD 0 0 0 255 ECU_ADDRESS 0x340EFB06 FORMAT "%.15" /end MEASUREMENT
/begin MEASUREMENT rtARID_DEF_CpApTcRx100.PP_SG_mTCLeftJoyStat_VDP_SG_mTC.Btn_Dwn "" UBYTE NO_COMPU_METHOD 0 0 0 255 ECU_ADDRESS 0x340EFB14 FORMAT "%.15" /end MEASUREMENT
/begin MEASUREMENT rtARID_DEF_CpApTcRx100.PP_SG_mTCLeftJoyStat_VDP_SG_mTC.Btn_Left "" UBYTE NO_COMPU_METHOD 0 0 0 255 ECU_ADDRESS 0x340EFB15 FORMAT "%.15" /end MEASUREMENT
/begin MEASUREMENT rtARID_DEF_CpApTcRx100.PP_SG_mTCLeftJoyStat_VDP_SG_mTC.Btn_Right "" UBYTE NO_COMPU_METHOD 0 0 0 255 ECU_ADDRESS 0x340EFB16 FORMAT "%.15" /end MEASUREMENT
/begin MEASUREMENT rtARID_DEF_CpApTcRx100.PP_SG_mTCLeftJoyStat_VDP_SG_mTC.Btn_Up "" UBYTE NO_COMPU_METHOD 0 0 0 255 ECU_ADDRESS 0x340EFB17 FORMAT "%.15" /end MEASUREMENT
/begin MEASUREMENT rtARID_DEF_CpApTcRx100.PP_SG_mTCLeftJoyStat_VDP_SG_mTC.LeftX_Neg "" UBYTE NO_COMPU_METHOD 0 0 0 255 ECU_ADDRESS 0x340EFB19 FORMAT "%.15" /end MEASUREMENT
/begin MEASUREMENT rtARID_DEF_CpApTcRx100.PP_SG_mTCLeftJoyStat_VDP_SG_mTC.LeftX_Ntrl "" UBYTE NO_COMPU_METHOD 0 0 0 255 ECU_ADDRESS 0x340EFB1A FORMAT "%.15" /end MEASUREMENT
/begin MEASUREMENT rtARID_DEF_CpApTcRx100.PP_SG_mTCLeftJoyStat_VDP_SG_mTC.LeftX_Pos "" UBYTE NO_COMPU_METHOD 0 0 0 255 ECU_ADDRESS 0x340EFB1B FORMAT "%.15" /end MEASUREMENT
/begin MEASUREMENT rtARID_DEF_CpApTcRx100.PP_SG_mTCLeftJoyStat_VDP_SG_mTC.LeftX_Value "" UWORD NO_COMPU_METHOD 0 0 0 65535 ECU_ADDRESS 0x340EFB1C FORMAT "%.15" /end MEASUREMENT
/begin MEASUREMENT rtARID_DEF_CpApTcRx100.PP_SG_mTCLeftJoyStat_VDP_SG_mTC.LeftY_Neg "" UBYTE NO_COMPU_METHOD 0 0 0 255 ECU_ADDRESS 0x340EFB1E FORMAT "%.15" /end MEASUREMENT
/begin MEASUREMENT rtARID_DEF_CpApTcRx100.PP_SG_mTCLeftJoyStat_VDP_SG_mTC.LeftY_Ntrl "" UBYTE NO_COMPU_METHOD 0 0 0 255 ECU_ADDRESS 0x340EFB1F FORMAT "%.15" /end MEASUREMENT
/begin MEASUREMENT rtARID_DEF_CpApTcRx100.PP_SG_mTCLeftJoyStat_VDP_SG_mTC.LeftY_Pos "" UBYTE NO_COMPU_METHOD 0 0 0 255 ECU_ADDRESS 0x340EFB20 FORMAT "%.15" /end MEASUREMENT
/begin MEASUREMENT rtARID_DEF_CpApTcRx100.PP_SG_mTCLeftJoyStat_VDP_SG_mTC.LeftY_Value "" UWORD NO_COMPU_METHOD 0 0 0 65535 ECU_ADDRESS 0x340EFB22 FORMAT "%.15" /end MEASUREMENT
/begin MEASUREMENT rtARID_DEF_CpApTcRx100.PP_SG_mTCLeftJoyStat_VDP_SG_mTC.Left_Trigger "" UBYTE NO_COMPU_METHOD 0 0 0 255 ECU_ADDRESS 0x340EFB18 FORMAT "%.15" /end MEASUREMENT
/begin MEASUREMENT rtARID_DEF_CpApTcRx100.PP_SG_mTCLeftJoyStat_VDP_SG_mTC.MsgCntr "" UBYTE NO_COMPU_METHOD 0 0 0 255 ECU_ADDRESS 0x340EFB24 FORMAT "%.15" /end MEASUREMENT
/begin MEASUREMENT rtARID_DEF_CpApTcRx100.PP_SG_mTCLeftJoyStat_VDP_SG_mTC.MsgCrc "" UBYTE NO_COMPU_METHOD 0 0 0 255 ECU_ADDRESS 0x340EFB25 FORMAT "%.15" /end MEASUREMENT
/begin MEASUREMENT rtARID_DEF_CpApTcRx100.PP_SG_mTCRightJoyStat_VDP_SG_mT.Btn_1 "" UBYTE NO_COMPU_METHOD 0 0 0 255 ECU_ADDRESS 0x340EFB26 FORMAT "%.15" /end MEASUREMENT
/begin MEASUREMENT rtARID_DEF_CpApTcRx100.PP_SG_mTCRightJoyStat_VDP_SG_mT.Btn_2 "" UBYTE NO_COMPU_METHOD 0 0 0 255 ECU_ADDRESS 0x340EFB27 FORMAT "%.15" /end MEASUREMENT
/begin MEASUREMENT rtARID_DEF_CpApTcRx100.PP_SG_mTCRightJoyStat_VDP_SG_mT.Btn_3 "" UBYTE NO_COMPU_METHOD 0 0 0 255 ECU_ADDRESS 0x340EFB28 FORMAT "%.15" /end MEASUREMENT
/begin MEASUREMENT rtARID_DEF_CpApTcRx100.PP_SG_mTCRightJoyStat_VDP_SG_mT.Btn_4 "" UBYTE NO_COMPU_METHOD 0 0 0 255 ECU_ADDRESS 0x340EFB29 FORMAT "%.15" /end MEASUREMENT
/begin MEASUREMENT rtARID_DEF_CpApTcRx100.PP_SG_mTCRightJoyStat_VDP_SG_mT.MsgCntr "" UBYTE NO_COMPU_METHOD 0 0 0 255 ECU_ADDRESS 0x340EFB2A FORMAT "%.15" /end MEASUREMENT
/begin MEASUREMENT rtARID_DEF_CpApTcRx100.PP_SG_mTCRightJoyStat_VDP_SG_mT.MsgCrc "" UBYTE NO_COMPU_METHOD 0 0 0 255 ECU_ADDRESS 0x340EFB2B FORMAT "%.15" /end MEASUREMENT
/begin MEASUREMENT rtARID_DEF_CpApTcRx100.PP_SG_mTCRightJoyStat_VDP_SG_mT.RightX_Neg "" UBYTE NO_COMPU_METHOD 0 0 0 255 ECU_ADDRESS 0x340EFB2D FORMAT "%.15" /end MEASUREMENT
/begin MEASUREMENT rtARID_DEF_CpApTcRx100.PP_SG_mTCRightJoyStat_VDP_SG_mT.RightX_Ntrl "" UBYTE NO_COMPU_METHOD 0 0 0 255 ECU_ADDRESS 0x340EFB2E FORMAT "%.15" /end MEASUREMENT
/begin MEASUREMENT rtARID_DEF_CpApTcRx100.PP_SG_mTCRightJoyStat_VDP_SG_mT.RightX_Pos "" UBYTE NO_COMPU_METHOD 0 0 0 255 ECU_ADDRESS 0x340EFB2F FORMAT "%.15" /end MEASUREMENT
/begin MEASUREMENT rtARID_DEF_CpApTcRx100.PP_SG_mTCRightJoyStat_VDP_SG_mT.RightX_Value "" UWORD NO_COMPU_METHOD 0 0 0 65535 ECU_ADDRESS 0x340EFB30 FORMAT "%.15" /end MEASUREMENT
/begin MEASUREMENT rtARID_DEF_CpApTcRx100.PP_SG_mTCRightJoyStat_VDP_SG_mT.RightY_Neg "" UBYTE NO_COMPU_METHOD 0 0 0 255 ECU_ADDRESS 0x340EFB32 FORMAT "%.15" /end MEASUREMENT
/begin MEASUREMENT rtARID_DEF_CpApTcRx100.PP_SG_mTCRightJoyStat_VDP_SG_mT.RightY_Ntrl "" UBYTE NO_COMPU_METHOD 0 0 0 255 ECU_ADDRESS 0x340EFB33 FORMAT "%.15" /end MEASUREMENT
/begin MEASUREMENT rtARID_DEF_CpApTcRx100.PP_SG_mTCRightJoyStat_VDP_SG_mT.RightY_Pos "" UBYTE NO_COMPU_METHOD 0 0 0 255 ECU_ADDRESS 0x340EFB34 FORMAT "%.15" /end MEASUREMENT
/begin MEASUREMENT rtARID_DEF_CpApTcRx100.PP_SG_mTCRightJoyStat_VDP_SG_mT.RightY_Value "" UWORD NO_COMPU_METHOD 0 0 0 65535 ECU_ADDRESS 0x340EFB36 FORMAT "%.15" /end MEASUREMENT
/begin MEASUREMENT rtARID_DEF_CpApTcRx100.PP_SG_mTCRightJoyStat_VDP_SG_mT.Right_Trigger "" UBYTE NO_COMPU_METHOD 0 0 0 255 ECU_ADDRESS 0x340EFB2C FORMAT "%.15" /end MEASUREMENT
/begin MEASUREMENT rtARID_DEF_CpApTcRx1000.PP_SG_mTcSwVer_VDP_SG_mTcSwVer.HwMaj "" UBYTE NO_COMPU_METHOD 0 0 0 255 ECU_ADDRESS 0x340EFB5A FORMAT "%.15" /end MEASUREMENT
/begin MEASUREMENT rtARID_DEF_CpApTcRx1000.PP_SG_mTcSwVer_VDP_SG_mTcSwVer.HwMin "" UBYTE NO_COMPU_METHOD 0 0 0 255 ECU_ADDRESS 0x340EFB5B FORMAT "%.15" /end MEASUREMENT
/begin MEASUREMENT rtARID_DEF_CpApTcRx1000.PP_SG_mTcSwVer_VDP_SG_mTcSwVer.SwMaj "" UBYTE NO_COMPU_METHOD 0 0 0 255 ECU_ADDRESS 0x340EFB5C FORMAT "%.15" /end MEASUREMENT
/begin MEASUREMENT rtARID_DEF_CpApTcRx1000.PP_SG_mTcSwVer_VDP_SG_mTcSwVer.SwMin "" UBYTE NO_COMPU_METHOD 0 0 0 255 ECU_ADDRESS 0x340EFB5D FORMAT "%.15" /end MEASUREMENT
/begin MEASUREMENT rtARID_DEF_CpApVcuTx10000_2.PP_SG_mSbwSys_Allied_VDP_SG_mSb "" UBYTE NO_COMPU_METHOD 0 0 0 255 ECU_ADDRESS 0x340EFD80 FORMAT "%.15" /end MEASUREMENT
/begin MEASUREMENT rtARID_DEF_CpApVcuTx10000_2.PP_SG_mSbwSys_Allied_VDP_SG_mSb.LeftEndStopValue "" UWORD NO_COMPU_METHOD 0 0 0 65535 ECU_ADDRESS 0x340EFD80 FORMAT "%.15" /end MEASUREMENT
/begin MEASUREMENT rtARID_DEF_CpApVcuTx10000_2.PP_SG_mSbwSys_Allied_VDP_SG_mSb.MsgCntr "" UBYTE NO_COMPU_METHOD 0 0 0 255 ECU_ADDRESS 0x340EFD82 FORMAT "%.15" /end MEASUREMENT
/begin MEASUREMENT rtARID_DEF_CpApVcuTx10000_2.PP_SG_mSbwSys_Allied_VDP_SG_mSb.MsgCrc "" UBYTE NO_COMPU_METHOD 0 0 0 255 ECU_ADDRESS 0x340EFD83 FORMAT "%.15" /end MEASUREMENT
/begin MEASUREMENT rtARID_DEF_CpApVcuTx10000_2.PP_SG_mSbwSys_Allied_VDP_SG_mSb.ProgOffset "" FLOAT32_IEEE NO_COMPU_METHOD 0 0 -3.40282346639E+38 3.40282346639E+38 ECU_ADDRESS 0x340EFD84 FORMAT "%.15" /end MEASUREMENT
/begin MEASUREMENT rtARID_DEF_CpApVcuTx10000_2.PP_SG_mSbwSys_Allied_VDP_SG_mSb.SwVerMaj "" UBYTE NO_COMPU_METHOD 0 0 0 255 ECU_ADDRESS 0x340EFD88 FORMAT "%.15" /end MEASUREMENT
/begin MEASUREMENT rtARID_DEF_CpApVcuTx10000_2.PP_SG_mSbwSys_Allied_VDP_SG_mSb.SwVerMin "" UBYTE NO_COMPU_METHOD 0 0 0 255 ECU_ADDRESS 0x340EFD89 FORMAT "%.15" /end MEASUREMENT
/begin MEASUREMENT rtARID_DEF_CpApVcuTx10000_2.PP_SG_mSbwSys_Allied_VDP_SG_mSb.SwVerRev "" UBYTE NO_COMPU_METHOD 0 0 0 255 ECU_ADDRESS 0x340EFD8A FORMAT "%.15" /end MEASUREMENT
/begin MEASUREMENT rtARID_DEF_CpApVcuTx10000_3.PP_SG_mAdcuSwVer_VDP_SG_mAdcuSw "" UBYTE NO_COMPU_METHOD 0 0 0 255 ECU_ADDRESS 0x340EFDB5 FORMAT "%.15" /end MEASUREMENT
/begin MEASUREMENT rtARID_DEF_CpApVcuTx10000_3.PP_SG_mAdcuSwVer_VDP_SG_mAdcuSw.SwMaj "" UBYTE NO_COMPU_METHOD 0 0 0 255 ECU_ADDRESS 0x340EFDB5 FORMAT "%.15" /end MEASUREMENT
/begin MEASUREMENT rtARID_DEF_CpApVcuTx10000_3.PP_SG_mAdcuSwVer_VDP_SG_mAdcuSw.SwMin "" UBYTE NO_COMPU_METHOD 0 0 0 255 ECU_ADDRESS 0x340EFDB6 FORMAT "%.15" /end MEASUREMENT
/begin MEASUREMENT rtARID_DEF_CpApVcuTx10000_3.PP_SG_mAdcuSwVer_VDP_SG_mAdcuSw.SwRev "" UBYTE NO_COMPU_METHOD 0 0 0 255 ECU_ADDRESS 0x340EFDB7 FORMAT "%.15" /end MEASUREMENT
/begin MEASUREMENT rtARID_DEF_CpApVcuTx10000_3.PP_SG_mAdcuSwVer_VDP_SG_mAdcuSw.SwStat "" UBYTE NO_COMPU_METHOD 0 0 0 255 ECU_ADDRESS 0x340EFDB8 FORMAT "%.15" /end MEASUREMENT
/begin MEASUREMENT rtARID_DEF_CpApVcuTx1000_1.PP_SG_mFMS_PTT_Sched_FB_VDP_SG_ "" UBYTE NO_COMPU_METHOD 0 0 0 255 ECU_ADDRESS 0x340EFDDA FORMAT "%.15" /end MEASUREMENT
/begin MEASUREMENT rtARID_DEF_CpApVcuTx1000_1.PP_SG_mFMS_PTT_Sched_FB_VDP_SG_.PTT_48VSysChkSts "" UBYTE NO_COMPU_METHOD 0 0 0 255 ECU_ADDRESS 0x340EFDDA FORMAT "%.15" /end MEASUREMENT
/begin MEASUREMENT rtARID_DEF_CpApVcuTx1000_1.PP_SG_mFMS_PTT_Sched_FB_VDP_SG_.PTT_AudioAlertsSts "" UBYTE NO_COMPU_METHOD 0 0 0 255 ECU_ADDRESS 0x340EFDDB FORMAT "%.15" /end MEASUREMENT
/begin MEASUREMENT rtARID_DEF_CpApVcuTx1000_1.PP_SG_mFMS_PTT_Sched_FB_VDP_SG_.PTT_BrkChkSts "" UBYTE NO_COMPU_METHOD 0 0 0 255 ECU_ADDRESS 0x340EFDDC FORMAT "%.15" /end MEASUREMENT
/begin MEASUREMENT rtARID_DEF_CpApVcuTx1000_1.PP_SG_mFMS_PTT_Sched_FB_VDP_SG_.PTT_EpbChkSts "" UBYTE NO_COMPU_METHOD 0 0 0 255 ECU_ADDRESS 0x340EFDDD FORMAT "%.15" /end MEASUREMENT
/begin MEASUREMENT rtARID_DEF_CpApVcuTx1000_1.PP_SG_mFMS_PTT_Sched_FB_VDP_SG_.PTT_ExtLightChkSts "" UBYTE NO_COMPU_METHOD 0 0 0 255 ECU_ADDRESS 0x340EFDDE FORMAT "%.15" /end MEASUREMENT
/begin MEASUREMENT rtARID_DEF_CpApVcuTx1000_1.PP_SG_mFMS_PTT_Sched_FB_VDP_SG_.PTT_SteerSysChkSts "" UBYTE NO_COMPU_METHOD 0 0 0 255 ECU_ADDRESS 0x340EFDDF FORMAT "%.15" /end MEASUREMENT
/begin MEASUREMENT rtARID_DEF_CpApVcuTx100_5.PP_SG_mVscStat_VDP_SG_mVscStat "" UBYTE NO_COMPU_METHOD 0 0 0 255 ECU_ADDRESS 0x340F007C FORMAT "%.15" /end MEASUREMENT
/begin MEASUREMENT rtARID_DEF_CpApVcuTx100_5.PP_SG_mVscStat_VDP_SG_mVscStat.CtrlMode "" UBYTE NO_COMPU_METHOD 0 0 0 255 ECU_ADDRESS 0x340F007C FORMAT "%.15" /end MEASUREMENT
/begin MEASUREMENT rtARID_DEF_CpApVcuTx100_5.PP_SG_mVscStat_VDP_SG_mVscStat.VscEstop "" ULONG NO_COMPU_METHOD 0 0 0 4294967295 ECU_ADDRESS 0x340F0080 FORMAT "%.15" /end MEASUREMENT
/begin MEASUREMENT rtARID_DEF_CpApVcuTx100_5.PP_SG_mVscStat_VDP_SG_mVscStat.VscMode "" UBYTE NO_COMPU_METHOD 0 0 0 255 ECU_ADDRESS 0x340F0084 FORMAT "%.15" /end MEASUREMENT
/begin MEASUREMENT rtARID_DEF_CpApVcuTx10_3.PP_SG_mSbwStat2_VDP_SG_mSbwStat "" UBYTE NO_COMPU_METHOD 0 0 0 255 ECU_ADDRESS 0x340F0320 FORMAT "%.15" /end MEASUREMENT
/begin MEASUREMENT rtARID_DEF_CpApVcuTx10_3.PP_SG_mSbwStat2_VDP_SG_mSbwStat.FaultLight "" UBYTE NO_COMPU_METHOD 0 0 0 255 ECU_ADDRESS 0x340F0320 FORMAT "%.15" /end MEASUREMENT
/begin MEASUREMENT rtARID_DEF_CpApVcuTx10_3.PP_SG_mSbwStat2_VDP_SG_mSbwStat.FltCode "" UBYTE NO_COMPU_METHOD 0 0 0 255 ECU_ADDRESS 0x340F0321 FORMAT "%.15" /end MEASUREMENT
/begin MEASUREMENT rtARID_DEF_CpApVcuTx10_3.PP_SG_mSbwStat2_VDP_SG_mSbwStat.HostMode "" UBYTE NO_COMPU_METHOD 0 0 0 255 ECU_ADDRESS 0x340F0322 FORMAT "%.15" /end MEASUREMENT
/begin MEASUREMENT rtARID_DEF_CpApVcuTx10_3.PP_SG_mSbwStat2_VDP_SG_mSbwStat.LeftStopLmt "" UBYTE NO_COMPU_METHOD 0 0 0 255 ECU_ADDRESS 0x340F0323 FORMAT "%.15" /end MEASUREMENT
/begin MEASUREMENT rtARID_DEF_CpApVcuTx10_3.PP_SG_mSbwStat2_VDP_SG_mSbwStat.MtrAdjust "" UBYTE NO_COMPU_METHOD 0 0 0 255 ECU_ADDRESS 0x340F0324 FORMAT "%.15" /end MEASUREMENT
/begin MEASUREMENT rtARID_DEF_CpApVcuTx10_3.PP_SG_mSbwStat2_VDP_SG_mSbwStat.OverTemp "" UBYTE NO_COMPU_METHOD 0 0 0 255 ECU_ADDRESS 0x340F0325 FORMAT "%.15" /end MEASUREMENT
/begin MEASUREMENT rtARID_DEF_CpApVcuTx10_3.PP_SG_mSbwStat2_VDP_SG_mSbwStat.ProtectActive "" UBYTE NO_COMPU_METHOD 0 0 0 255 ECU_ADDRESS 0x340F0326 FORMAT "%.15" /end MEASUREMENT
/begin MEASUREMENT rtARID_DEF_CpApVcuTx10_3.PP_SG_mSbwStat2_VDP_SG_mSbwStat.RS232Mode "" UBYTE NO_COMPU_METHOD 0 0 0 255 ECU_ADDRESS 0x340F0329 FORMAT "%.15" /end MEASUREMENT
/begin MEASUREMENT rtARID_DEF_CpApVcuTx10_3.PP_SG_mSbwStat2_VDP_SG_mSbwStat.RemModeActive "" UBYTE NO_COMPU_METHOD 0 0 0 255 ECU_ADDRESS 0x340F0327 FORMAT "%.15" /end MEASUREMENT
/begin MEASUREMENT rtARID_DEF_CpApVcuTx10_3.PP_SG_mSbwStat2_VDP_SG_mSbwStat.RightStopLmt "" UBYTE NO_COMPU_METHOD 0 0 0 255 ECU_ADDRESS 0x340F0328 FORMAT "%.15" /end MEASUREMENT
/begin MEASUREMENT rtARID_DEF_CpApVcuTx10_3.PP_SG_mSbwStat2_VDP_SG_mSbwStat.SelectedMap "" UBYTE NO_COMPU_METHOD 0 0 0 255 ECU_ADDRESS 0x340F032A FORMAT "%.15" /end MEASUREMENT
/begin MEASUREMENT rtARID_DEF_CpApVcuTx10_3.PP_SG_mSbwStat2_VDP_SG_mSbwStat.SteerAngle "" UWORD NO_COMPU_METHOD 0 0 0 65535 ECU_ADDRESS 0x340F032C FORMAT "%.15" /end MEASUREMENT
/begin MEASUREMENT rtARID_DEF_CpApVcuTx10_3.PP_SG_mSbwStat2_VDP_SG_mSbwStat.SteerAngle8b "" UBYTE NO_COMPU_METHOD 0 0 0 255 ECU_ADDRESS 0x340F032E FORMAT "%.15" /end MEASUREMENT
/begin MEASUREMENT rtARID_DEF_CpApVcuTx10_4.PP_SG_mEbcm2L_WhlCnt_VDP_SG_mEb "" UBYTE NO_COMPU_METHOD 0 0 0 255 ECU_ADDRESS 0x340F0368 FORMAT "%.15" /end MEASUREMENT
/begin MEASUREMENT rtARID_DEF_CpApVcuTx10_4.PP_SG_mEbcm2L_WhlCnt_VDP_SG_mEb.WhlCntFL "" UWORD NO_COMPU_METHOD 0 0 0 65535 ECU_ADDRESS 0x340F0368 FORMAT "%.15" /end MEASUREMENT
/begin MEASUREMENT rtARID_DEF_CpApVcuTx10_4.PP_SG_mEbcm2L_WhlCnt_VDP_SG_mEb.WhlCntFR "" UWORD NO_COMPU_METHOD 0 0 0 65535 ECU_ADDRESS 0x340F036A FORMAT "%.15" /end MEASUREMENT
/begin MEASUREMENT rtARID_DEF_CpApVcuTx10_4.PP_SG_mEbcm2L_WhlCnt_VDP_SG_mEb.WhlCntR "" UWORD NO_COMPU_METHOD 0 0 0 65535 ECU_ADDRESS 0x340F036C FORMAT "%.15" /end MEASUREMENT
/begin MEASUREMENT rtARID_DEF_CpApVcuTx20_3.PP_SG_mEbcm2L_WhlSlip_VDP_SG_mE "" UBYTE NO_COMPU_METHOD 0 0 0 255 ECU_ADDRESS 0x340F0558 FORMAT "%.15" /end MEASUREMENT
/begin MEASUREMENT rtARID_DEF_CpApVcuTx20_3.PP_SG_mEbcm2L_WhlSlip_VDP_SG_mE.MsgCntr "" UBYTE NO_COMPU_METHOD 0 0 0 255 ECU_ADDRESS 0x340F0558 FORMAT "%.15" /end MEASUREMENT
/begin MEASUREMENT rtARID_DEF_CpApVcuTx20_3.PP_SG_mEbcm2L_WhlSlip_VDP_SG_mE.MsgCrc "" UBYTE NO_COMPU_METHOD 0 0 0 255 ECU_ADDRESS 0x340F0559 FORMAT "%.15" /end MEASUREMENT
/begin MEASUREMENT rtARID_DEF_CpApVcuTx20_3.PP_SG_mEbcm2L_WhlSlip_VDP_SG_mE.WhlSlipFL "" FLOAT32_IEEE NO_COMPU_METHOD 0 0 -3.40282346639E+38 3.40282346639E+38 ECU_ADDRESS 0x340F055C FORMAT "%.15" /end MEASUREMENT
/begin MEASUREMENT rtARID_DEF_CpApVcuTx20_3.PP_SG_mEbcm2L_WhlSlip_VDP_SG_mE.WhlSlipFR "" FLOAT32_IEEE NO_COMPU_METHOD 0 0 -3.40282346639E+38 3.40282346639E+38 ECU_ADDRESS 0x340F0560 FORMAT "%.15" /end MEASUREMENT
/begin MEASUREMENT rtARID_DEF_CpApVcuTx20_3.PP_SG_mEbcm2L_WhlSlip_VDP_SG_mE.WhlSlipR "" FLOAT32_IEEE NO_COMPU_METHOD 0 0 -3.40282346639E+38 3.40282346639E+38 ECU_ADDRESS 0x340F0564 FORMAT "%.15" /end MEASUREMENT
/begin MEASUREMENT rtARID_DEF_CpApVcuTx20_3.PP_SG_mVehCtrlTORq_VDP_SG_mVehC "" UBYTE NO_COMPU_METHOD 0 0 0 255 ECU_ADDRESS 0x340F0574 FORMAT "%.15" /end MEASUREMENT
/begin MEASUREMENT rtARID_DEF_CpApVcuTx20_3.PP_SG_mVehCtrlTORq_VDP_SG_mVehC.MsgCntr "" UBYTE NO_COMPU_METHOD 0 0 0 255 ECU_ADDRESS 0x340F0574 FORMAT "%.15" /end MEASUREMENT
/begin MEASUREMENT rtARID_DEF_CpApVcuTx20_3.PP_SG_mVehCtrlTORq_VDP_SG_mVehC.MsgCrc "" UBYTE NO_COMPU_METHOD 0 0 0 255 ECU_ADDRESS 0x340F0575 FORMAT "%.15" /end MEASUREMENT
/begin MEASUREMENT rtARID_DEF_CpApVcuTx20_3.PP_SG_mVehCtrlTORq_VDP_SG_mVehC.TO_Accel_Cmd "" FLOAT32_IEEE NO_COMPU_METHOD 0 0 -3.40282346639E+38 3.40282346639E+38 ECU_ADDRESS 0x340F0578 FORMAT "%.15" /end MEASUREMENT
/begin MEASUREMENT rtARID_DEF_CpApVcuTx20_3.PP_SG_mVehCtrlTORq_VDP_SG_mVehC.TO_EstopRq "" UBYTE NO_COMPU_METHOD 0 0 0 255 ECU_ADDRESS 0x340F057C FORMAT "%.15" /end MEASUREMENT
/begin MEASUREMENT rtARID_DEF_CpApVcuTx20_3.PP_SG_mVehCtrlTORq_VDP_SG_mVehC.TO_Steer_Cmd "" FLOAT32_IEEE NO_COMPU_METHOD 0 0 -3.40282346639E+38 3.40282346639E+38 ECU_ADDRESS 0x340F0580 FORMAT "%.15" /end MEASUREMENT
/begin MEASUREMENT rtARID_DEF_CpApVcuTx20_4.PP_SG_mAdcuStat_VDP_SG_mAdcuSta "" UBYTE NO_COMPU_METHOD 0 0 0 255 ECU_ADDRESS 0x340F05AC FORMAT "%.15" /end MEASUREMENT
/begin MEASUREMENT rtARID_DEF_CpApVcuTx20_4.PP_SG_mAdcuStat_VDP_SG_mAdcuSta.AD_Mission_Cmplt "" UBYTE NO_COMPU_METHOD 0 0 0 255 ECU_ADDRESS 0x340F05AC FORMAT "%.15" /end MEASUREMENT
/begin MEASUREMENT rtARID_DEF_CpApVcuTx20_4.PP_SG_mAdcuStat_VDP_SG_mAdcuSta.AD_Ready "" UBYTE NO_COMPU_METHOD 0 0 0 255 ECU_ADDRESS 0x340F05AD FORMAT "%.15" /end MEASUREMENT
/begin MEASUREMENT rtARID_DEF_CpApVcuTx20_4.PP_SG_mAdcuStat_VDP_SG_mAdcuSta.AdcuEstopRq "" UBYTE NO_COMPU_METHOD 0 0 0 255 ECU_ADDRESS 0x340F05AE FORMAT "%.15" /end MEASUREMENT
/begin MEASUREMENT rtARID_DEF_CpApVcuTx20_4.PP_SG_mAdcuStat_VDP_SG_mAdcuSta.AdcuShtdwnRdy "" UBYTE NO_COMPU_METHOD 0 0 0 255 ECU_ADDRESS 0x340F05AF FORMAT "%.15" /end MEASUREMENT
/begin MEASUREMENT rtARID_DEF_CpApVcuTx20_4.PP_SG_mAdcuStat_VDP_SG_mAdcuSta.AdcuStatus "" UBYTE NO_COMPU_METHOD 0 0 0 255 ECU_ADDRESS 0x340F05B0 FORMAT "%.15" /end MEASUREMENT
/begin MEASUREMENT rtARID_DEF_CpApVcuTx20_4.PP_SG_mAdcuStat_VDP_SG_mAdcuSta.MsgCntr "" UBYTE NO_COMPU_METHOD 0 0 0 255 ECU_ADDRESS 0x340F05B1 FORMAT "%.15" /end MEASUREMENT
/begin MEASUREMENT rtARID_DEF_CpApVcuTx20_4.PP_SG_mAdcuStat_VDP_SG_mAdcuSta.MsgCrc "" UBYTE NO_COMPU_METHOD 0 0 0 255 ECU_ADDRESS 0x340F05B2 FORMAT "%.15" /end MEASUREMENT
/begin MEASUREMENT rtARID_DEF_CpApVcuTx20_4.PP_SG_mAdcuStat_VDP_SG_mAdcuSta.TO_Assistance_Rq "" UBYTE NO_COMPU_METHOD 0 0 0 255 ECU_ADDRESS 0x340F05B3 FORMAT "%.15" /end MEASUREMENT
/begin MEASUREMENT rtARID_DEF_CpApVcuTx500_1.PP_SG_mTOStat_VDP_SG_mTOStat "" UBYTE NO_COMPU_METHOD 0 0 0 255 ECU_ADDRESS 0x340F06A8 FORMAT "%.15" /end MEASUREMENT
/begin MEASUREMENT rtARID_DEF_CpApVcuTx500_1.PP_SG_mTOStat_VDP_SG_mTOStat.MsgCntr "" UBYTE NO_COMPU_METHOD 0 0 0 255 ECU_ADDRESS 0x340F06A8 FORMAT "%.15" /end MEASUREMENT
/begin MEASUREMENT rtARID_DEF_CpApVcuTx500_1.PP_SG_mTOStat_VDP_SG_mTOStat.MsgCrc "" UBYTE NO_COMPU_METHOD 0 0 0 255 ECU_ADDRESS 0x340F06A9 FORMAT "%.15" /end MEASUREMENT
/begin MEASUREMENT rtARID_DEF_CpApVcuTx500_1.PP_SG_mTOStat_VDP_SG_mTOStat.TO_ConnectionStat "" UBYTE NO_COMPU_METHOD 0 0 0 255 ECU_ADDRESS 0x340F06AB FORMAT "%.15" /end MEASUREMENT
/begin MEASUREMENT rtARID_DEF_CpApVcuTx500_1.PP_SG_mTOStat_VDP_SG_mTOStat.TO_cmd_veh_mode "" UBYTE NO_COMPU_METHOD 0 0 0 255 ECU_ADDRESS 0x340F06AA FORMAT "%.15" /end MEASUREMENT
/begin MEASUREMENT rtARID_DEF_CpApVcuTx500_1.PP_SG_mTOStat_VDP_SG_mTOStat.TO_dlg_resp_code "" UBYTE NO_COMPU_METHOD 0 0 0 255 ECU_ADDRESS 0x340F06AC FORMAT "%.15" /end MEASUREMENT
/begin MEASUREMENT rtARID_DEF_CpApVcuTx500_1.PP_SG_mTOStat_VDP_SG_mTOStat.TO_dlg_resp_id "" UBYTE NO_COMPU_METHOD 0 0 0 255 ECU_ADDRESS 0x340F06AD FORMAT "%.15" /end MEASUREMENT
/begin MEASUREMENT rtARID_DEF_CpApVcuTx500_1.PP_SG_mTOStat_VDP_SG_mTOStat.VehDirCmd "" UBYTE NO_COMPU_METHOD 0 0 0 255 ECU_ADDRESS 0x340F06AE FORMAT "%.15" /end MEASUREMENT
/begin MEASUREMENT rtARID_DEF_CpApVcuTx60_1.PP_SG_mLeftJoyStat2_VDP_SG_mLef "" UBYTE NO_COMPU_METHOD 0 0 0 255 ECU_ADDRESS 0x340F080C FORMAT "%.15" /end MEASUREMENT
/begin MEASUREMENT rtARID_DEF_CpApVcuTx60_1.PP_SG_mLeftJoyStat2_VDP_SG_mLef.LeftZ_Neg "" UBYTE NO_COMPU_METHOD 0 0 0 255 ECU_ADDRESS 0x340F080C FORMAT "%.15" /end MEASUREMENT
/begin MEASUREMENT rtARID_DEF_CpApVcuTx60_1.PP_SG_mLeftJoyStat2_VDP_SG_mLef.LeftZ_Ntrl "" UBYTE NO_COMPU_METHOD 0 0 0 255 ECU_ADDRESS 0x340F080D FORMAT "%.15" /end MEASUREMENT
/begin MEASUREMENT rtARID_DEF_CpApVcuTx60_1.PP_SG_mLeftJoyStat2_VDP_SG_mLef.LeftZ_Pos "" UBYTE NO_COMPU_METHOD 0 0 0 255 ECU_ADDRESS 0x340F080E FORMAT "%.15" /end MEASUREMENT
/begin MEASUREMENT rtARID_DEF_CpApVcuTx60_1.PP_SG_mLeftJoyStat2_VDP_SG_mLef.LeftZ_Value "" UWORD NO_COMPU_METHOD 0 0 0 65535 ECU_ADDRESS 0x340F0810 FORMAT "%.15" /end MEASUREMENT
/begin MEASUREMENT rtARID_DEF_CpApVcuTx60_1.PP_SG_mLeftJoyStat_VDP_SG_mLeft "" UBYTE NO_COMPU_METHOD 0 0 0 255 ECU_ADDRESS 0x340F07EC FORMAT "%.15" /end MEASUREMENT
/begin MEASUREMENT rtARID_DEF_CpApVcuTx60_1.PP_SG_mLeftJoyStat_VDP_SG_mLeft.Btn_Dwn "" UBYTE NO_COMPU_METHOD 0 0 0 255 ECU_ADDRESS 0x340F07EC FORMAT "%.15" /end MEASUREMENT
/begin MEASUREMENT rtARID_DEF_CpApVcuTx60_1.PP_SG_mLeftJoyStat_VDP_SG_mLeft.Btn_Left "" UBYTE NO_COMPU_METHOD 0 0 0 255 ECU_ADDRESS 0x340F07ED FORMAT "%.15" /end MEASUREMENT
/begin MEASUREMENT rtARID_DEF_CpApVcuTx60_1.PP_SG_mLeftJoyStat_VDP_SG_mLeft.Btn_Right "" UBYTE NO_COMPU_METHOD 0 0 0 255 ECU_ADDRESS 0x340F07EE FORMAT "%.15" /end MEASUREMENT
/begin MEASUREMENT rtARID_DEF_CpApVcuTx60_1.PP_SG_mLeftJoyStat_VDP_SG_mLeft.Btn_Up "" UBYTE NO_COMPU_METHOD 0 0 0 255 ECU_ADDRESS 0x340F07EF FORMAT "%.15" /end MEASUREMENT
/begin MEASUREMENT rtARID_DEF_CpApVcuTx60_1.PP_SG_mLeftJoyStat_VDP_SG_mLeft.LeftX_Neg "" UBYTE NO_COMPU_METHOD 0 0 0 255 ECU_ADDRESS 0x340F07F0 FORMAT "%.15" /end MEASUREMENT
/begin MEASUREMENT rtARID_DEF_CpApVcuTx60_1.PP_SG_mLeftJoyStat_VDP_SG_mLeft.LeftX_Ntrl "" UBYTE NO_COMPU_METHOD 0 0 0 255 ECU_ADDRESS 0x340F07F1 FORMAT "%.15" /end MEASUREMENT
/begin MEASUREMENT rtARID_DEF_CpApVcuTx60_1.PP_SG_mLeftJoyStat_VDP_SG_mLeft.LeftX_Pos "" UBYTE NO_COMPU_METHOD 0 0 0 255 ECU_ADDRESS 0x340F07F2 FORMAT "%.15" /end MEASUREMENT
/begin MEASUREMENT rtARID_DEF_CpApVcuTx60_1.PP_SG_mLeftJoyStat_VDP_SG_mLeft.LeftX_Value "" UWORD NO_COMPU_METHOD 0 0 0 65535 ECU_ADDRESS 0x340F07F4 FORMAT "%.15" /end MEASUREMENT
/begin MEASUREMENT rtARID_DEF_CpApVcuTx60_1.PP_SG_mLeftJoyStat_VDP_SG_mLeft.LeftY_Neg "" UBYTE NO_COMPU_METHOD 0 0 0 255 ECU_ADDRESS 0x340F07F6 FORMAT "%.15" /end MEASUREMENT
/begin MEASUREMENT rtARID_DEF_CpApVcuTx60_1.PP_SG_mLeftJoyStat_VDP_SG_mLeft.LeftY_Ntrl "" UBYTE NO_COMPU_METHOD 0 0 0 255 ECU_ADDRESS 0x340F07F7 FORMAT "%.15" /end MEASUREMENT
/begin MEASUREMENT rtARID_DEF_CpApVcuTx60_1.PP_SG_mLeftJoyStat_VDP_SG_mLeft.LeftY_Pos "" UBYTE NO_COMPU_METHOD 0 0 0 255 ECU_ADDRESS 0x340F07F8 FORMAT "%.15" /end MEASUREMENT
/begin MEASUREMENT rtARID_DEF_CpApVcuTx60_1.PP_SG_mLeftJoyStat_VDP_SG_mLeft.LeftY_Value "" UWORD NO_COMPU_METHOD 0 0 0 65535 ECU_ADDRESS 0x340F07FA FORMAT "%.15" /end MEASUREMENT
/begin MEASUREMENT rtARID_DEF_CpApVcuTx60_1.PP_SG_mRightJoyStat2_VDP_SG_mRi "" UBYTE NO_COMPU_METHOD 0 0 0 255 ECU_ADDRESS 0x340F0812 FORMAT "%.15" /end MEASUREMENT
/begin MEASUREMENT rtARID_DEF_CpApVcuTx60_1.PP_SG_mRightJoyStat2_VDP_SG_mRi.RightZ_Neg "" UBYTE NO_COMPU_METHOD 0 0 0 255 ECU_ADDRESS 0x340F0812 FORMAT "%.15" /end MEASUREMENT
/begin MEASUREMENT rtARID_DEF_CpApVcuTx60_1.PP_SG_mRightJoyStat2_VDP_SG_mRi.RightZ_Ntrl "" UBYTE NO_COMPU_METHOD 0 0 0 255 ECU_ADDRESS 0x340F0813 FORMAT "%.15" /end MEASUREMENT
/begin MEASUREMENT rtARID_DEF_CpApVcuTx60_1.PP_SG_mRightJoyStat2_VDP_SG_mRi.RightZ_Pos "" UBYTE NO_COMPU_METHOD 0 0 0 255 ECU_ADDRESS 0x340F0814 FORMAT "%.15" /end MEASUREMENT
/begin MEASUREMENT rtARID_DEF_CpApVcuTx60_1.PP_SG_mRightJoyStat2_VDP_SG_mRi.RightZ_Value "" UWORD NO_COMPU_METHOD 0 0 0 65535 ECU_ADDRESS 0x340F0816 FORMAT "%.15" /end MEASUREMENT
/begin MEASUREMENT rtARID_DEF_CpApVcuTx60_1.PP_SG_mRightJoyStat_VDP_SG_mRig.Btn_1 "" UBYTE NO_COMPU_METHOD 0 0 0 255 ECU_ADDRESS 0x340F07FC FORMAT "%.15" /end MEASUREMENT
/begin MEASUREMENT rtARID_DEF_CpApVcuTx60_1.PP_SG_mRightJoyStat_VDP_SG_mRig.Btn_2 "" UBYTE NO_COMPU_METHOD 0 0 0 255 ECU_ADDRESS 0x340F07FD FORMAT "%.15" /end MEASUREMENT
/begin MEASUREMENT rtARID_DEF_CpApVcuTx60_1.PP_SG_mRightJoyStat_VDP_SG_mRig.Btn_3 "" UBYTE NO_COMPU_METHOD 0 0 0 255 ECU_ADDRESS 0x340F07FE FORMAT "%.15" /end MEASUREMENT
/begin MEASUREMENT rtARID_DEF_CpApVcuTx60_1.PP_SG_mRightJoyStat_VDP_SG_mRig.Btn_4 "" UBYTE NO_COMPU_METHOD 0 0 0 255 ECU_ADDRESS 0x340F07FF FORMAT "%.15" /end MEASUREMENT
/begin MEASUREMENT rtARID_DEF_CpApVcuTx60_1.PP_SG_mRightJoyStat_VDP_SG_mRig.RightX_Neg "" UBYTE NO_COMPU_METHOD 0 0 0 255 ECU_ADDRESS 0x340F0800 FORMAT "%.15" /end MEASUREMENT
/begin MEASUREMENT rtARID_DEF_CpApVcuTx60_1.PP_SG_mRightJoyStat_VDP_SG_mRig.RightX_Ntrl "" UBYTE NO_COMPU_METHOD 0 0 0 255 ECU_ADDRESS 0x340F0801 FORMAT "%.15" /end MEASUREMENT
/begin MEASUREMENT rtARID_DEF_CpApVcuTx60_1.PP_SG_mRightJoyStat_VDP_SG_mRig.RightX_Pos "" UBYTE NO_COMPU_METHOD 0 0 0 255 ECU_ADDRESS 0x340F0802 FORMAT "%.15" /end MEASUREMENT
/begin MEASUREMENT rtARID_DEF_CpApVcuTx60_1.PP_SG_mRightJoyStat_VDP_SG_mRig.RightX_Value "" UWORD NO_COMPU_METHOD 0 0 0 65535 ECU_ADDRESS 0x340F0804 FORMAT "%.15" /end MEASUREMENT
/begin MEASUREMENT rtARID_DEF_CpApVcuTx60_1.PP_SG_mRightJoyStat_VDP_SG_mRig.RightY_Neg "" UBYTE NO_COMPU_METHOD 0 0 0 255 ECU_ADDRESS 0x340F0806 FORMAT "%.15" /end MEASUREMENT
/begin MEASUREMENT rtARID_DEF_CpApVcuTx60_1.PP_SG_mRightJoyStat_VDP_SG_mRig.RightY_Ntrl "" UBYTE NO_COMPU_METHOD 0 0 0 255 ECU_ADDRESS 0x340F0807 FORMAT "%.15" /end MEASUREMENT
/begin MEASUREMENT rtARID_DEF_CpApVcuTx60_1.PP_SG_mRightJoyStat_VDP_SG_mRig.RightY_Pos "" UBYTE NO_COMPU_METHOD 0 0 0 255 ECU_ADDRESS 0x340F0808 FORMAT "%.15" /end MEASUREMENT
/begin MEASUREMENT rtARID_DEF_CpApVcuTx60_1.PP_SG_mRightJoyStat_VDP_SG_mRig.RightY_Value "" UWORD NO_COMPU_METHOD 0 0 0 65535 ECU_ADDRESS 0x340F080A FORMAT "%.15" /end MEASUREMENT
/begin MEASUREMENT rtARID_DEF_CpApVscRx100.PP_SG_mVscStat_VDP_SG_mVscStat.CtrlMode "" UBYTE NO_COMPU_METHOD 0 0 0 255 ECU_ADDRESS 0x340EFB74 FORMAT "%.15" /end MEASUREMENT
/begin MEASUREMENT rtARID_DEF_CpApVscRx100.PP_SG_mVscStat_VDP_SG_mVscStat.VscEstop "" ULONG NO_COMPU_METHOD 0 0 0 4294967295 ECU_ADDRESS 0x340EFB78 FORMAT "%.15" /end MEASUREMENT
/begin MEASUREMENT rtARID_DEF_CpApVscRx100.PP_SG_mVscStat_VDP_SG_mVscStat.VscMode "" UBYTE NO_COMPU_METHOD 0 0 0 255 ECU_ADDRESS 0x340EFB7C FORMAT "%.15" /end MEASUREMENT
/begin MEASUREMENT rtARID_DEF_CpApVscRx60.PP_SG_mLeftJoyStat2_VDP_SG_mLef "" UBYTE NO_COMPU_METHOD 0 0 0 255 ECU_ADDRESS 0x340EFBA8 FORMAT "%.15" /end MEASUREMENT
/begin MEASUREMENT rtARID_DEF_CpApVscRx60.PP_SG_mLeftJoyStat2_VDP_SG_mLef.LeftZ_Neg "" UBYTE NO_COMPU_METHOD 0 0 0 255 ECU_ADDRESS 0x340EFBA8 FORMAT "%.15" /end MEASUREMENT
/begin MEASUREMENT rtARID_DEF_CpApVscRx60.PP_SG_mLeftJoyStat2_VDP_SG_mLef.LeftZ_Ntrl "" UBYTE NO_COMPU_METHOD 0 0 0 255 ECU_ADDRESS 0x340EFBA9 FORMAT "%.15" /end MEASUREMENT
/begin MEASUREMENT rtARID_DEF_CpApVscRx60.PP_SG_mLeftJoyStat2_VDP_SG_mLef.LeftZ_Pos "" UBYTE NO_COMPU_METHOD 0 0 0 255 ECU_ADDRESS 0x340EFBAA FORMAT "%.15" /end MEASUREMENT
/begin MEASUREMENT rtARID_DEF_CpApVscRx60.PP_SG_mLeftJoyStat2_VDP_SG_mLef.LeftZ_Value "" UWORD NO_COMPU_METHOD 0 0 0 65535 ECU_ADDRESS 0x340EFBAC FORMAT "%.15" /end MEASUREMENT
/begin MEASUREMENT rtARID_DEF_CpApVscRx60.PP_SG_mLeftJoyStat_VDP_SG_mLeft.Btn_Dwn "" UBYTE NO_COMPU_METHOD 0 0 0 255 ECU_ADDRESS 0x340EFB88 FORMAT "%.15" /end MEASUREMENT
/begin MEASUREMENT rtARID_DEF_CpApVscRx60.PP_SG_mLeftJoyStat_VDP_SG_mLeft.Btn_Left "" UBYTE NO_COMPU_METHOD 0 0 0 255 ECU_ADDRESS 0x340EFB89 FORMAT "%.15" /end MEASUREMENT
/begin MEASUREMENT rtARID_DEF_CpApVscRx60.PP_SG_mLeftJoyStat_VDP_SG_mLeft.Btn_Right "" UBYTE NO_COMPU_METHOD 0 0 0 255 ECU_ADDRESS 0x340EFB8A FORMAT "%.15" /end MEASUREMENT
/begin MEASUREMENT rtARID_DEF_CpApVscRx60.PP_SG_mLeftJoyStat_VDP_SG_mLeft.Btn_Up "" UBYTE NO_COMPU_METHOD 0 0 0 255 ECU_ADDRESS 0x340EFB8B FORMAT "%.15" /end MEASUREMENT
/begin MEASUREMENT rtARID_DEF_CpApVscRx60.PP_SG_mLeftJoyStat_VDP_SG_mLeft.LeftX_Neg "" UBYTE NO_COMPU_METHOD 0 0 0 255 ECU_ADDRESS 0x340EFB8C FORMAT "%.15" /end MEASUREMENT
/begin MEASUREMENT rtARID_DEF_CpApVscRx60.PP_SG_mLeftJoyStat_VDP_SG_mLeft.LeftX_Ntrl "" UBYTE NO_COMPU_METHOD 0 0 0 255 ECU_ADDRESS 0x340EFB8D FORMAT "%.15" /end MEASUREMENT
/begin MEASUREMENT rtARID_DEF_CpApVscRx60.PP_SG_mLeftJoyStat_VDP_SG_mLeft.LeftX_Pos "" UBYTE NO_COMPU_METHOD 0 0 0 255 ECU_ADDRESS 0x340EFB8E FORMAT "%.15" /end MEASUREMENT
/begin MEASUREMENT rtARID_DEF_CpApVscRx60.PP_SG_mLeftJoyStat_VDP_SG_mLeft.LeftX_Value "" UWORD NO_COMPU_METHOD 0 0 0 65535 ECU_ADDRESS 0x340EFB90 FORMAT "%.15" /end MEASUREMENT
/begin MEASUREMENT rtARID_DEF_CpApVscRx60.PP_SG_mLeftJoyStat_VDP_SG_mLeft.LeftY_Neg "" UBYTE NO_COMPU_METHOD 0 0 0 255 ECU_ADDRESS 0x340EFB92 FORMAT "%.15" /end MEASUREMENT
/begin MEASUREMENT rtARID_DEF_CpApVscRx60.PP_SG_mLeftJoyStat_VDP_SG_mLeft.LeftY_Ntrl "" UBYTE NO_COMPU_METHOD 0 0 0 255 ECU_ADDRESS 0x340EFB93 FORMAT "%.15" /end MEASUREMENT
/begin MEASUREMENT rtARID_DEF_CpApVscRx60.PP_SG_mLeftJoyStat_VDP_SG_mLeft.LeftY_Pos "" UBYTE NO_COMPU_METHOD 0 0 0 255 ECU_ADDRESS 0x340EFB94 FORMAT "%.15" /end MEASUREMENT
/begin MEASUREMENT rtARID_DEF_CpApVscRx60.PP_SG_mLeftJoyStat_VDP_SG_mLeft.LeftY_Value "" UWORD NO_COMPU_METHOD 0 0 0 65535 ECU_ADDRESS 0x340EFB96 FORMAT "%.15" /end MEASUREMENT
/begin MEASUREMENT rtARID_DEF_CpApVscRx60.PP_SG_mRightJoyStat2_VDP_SG_mRi "" UBYTE NO_COMPU_METHOD 0 0 0 255 ECU_ADDRESS 0x340EFBAE FORMAT "%.15" /end MEASUREMENT
/begin MEASUREMENT rtARID_DEF_CpApVscRx60.PP_SG_mRightJoyStat2_VDP_SG_mRi.RightZ_Neg "" UBYTE NO_COMPU_METHOD 0 0 0 255 ECU_ADDRESS 0x340EFBAE FORMAT "%.15" /end MEASUREMENT
/begin MEASUREMENT rtARID_DEF_CpApVscRx60.PP_SG_mRightJoyStat2_VDP_SG_mRi.RightZ_Ntrl "" UBYTE NO_COMPU_METHOD 0 0 0 255 ECU_ADDRESS 0x340EFBAF FORMAT "%.15" /end MEASUREMENT
/begin MEASUREMENT rtARID_DEF_CpApVscRx60.PP_SG_mRightJoyStat2_VDP_SG_mRi.RightZ_Pos "" UBYTE NO_COMPU_METHOD 0 0 0 255 ECU_ADDRESS 0x340EFBB0 FORMAT "%.15" /end MEASUREMENT
/begin MEASUREMENT rtARID_DEF_CpApVscRx60.PP_SG_mRightJoyStat2_VDP_SG_mRi.RightZ_Value "" UWORD NO_COMPU_METHOD 0 0 0 65535 ECU_ADDRESS 0x340EFBB2 FORMAT "%.15" /end MEASUREMENT
/begin MEASUREMENT rtARID_DEF_CpApVscRx60.PP_SG_mRightJoyStat_VDP_SG_mRig.Btn_1 "" UBYTE NO_COMPU_METHOD 0 0 0 255 ECU_ADDRESS 0x340EFB98 FORMAT "%.15" /end MEASUREMENT
/begin MEASUREMENT rtARID_DEF_CpApVscRx60.PP_SG_mRightJoyStat_VDP_SG_mRig.Btn_2 "" UBYTE NO_COMPU_METHOD 0 0 0 255 ECU_ADDRESS 0x340EFB99 FORMAT "%.15" /end MEASUREMENT
/begin MEASUREMENT rtARID_DEF_CpApVscRx60.PP_SG_mRightJoyStat_VDP_SG_mRig.Btn_3 "" UBYTE NO_COMPU_METHOD 0 0 0 255 ECU_ADDRESS 0x340EFB9A FORMAT "%.15" /end MEASUREMENT
/begin MEASUREMENT rtARID_DEF_CpApVscRx60.PP_SG_mRightJoyStat_VDP_SG_mRig.Btn_4 "" UBYTE NO_COMPU_METHOD 0 0 0 255 ECU_ADDRESS 0x340EFB9B FORMAT "%.15" /end MEASUREMENT
/begin MEASUREMENT rtARID_DEF_CpApVscRx60.PP_SG_mRightJoyStat_VDP_SG_mRig.RightX_Neg "" UBYTE NO_COMPU_METHOD 0 0 0 255 ECU_ADDRESS 0x340EFB9C FORMAT "%.15" /end MEASUREMENT
/begin MEASUREMENT rtARID_DEF_CpApVscRx60.PP_SG_mRightJoyStat_VDP_SG_mRig.RightX_Ntrl "" UBYTE NO_COMPU_METHOD 0 0 0 255 ECU_ADDRESS 0x340EFB9D FORMAT "%.15" /end MEASUREMENT
/begin MEASUREMENT rtARID_DEF_CpApVscRx60.PP_SG_mRightJoyStat_VDP_SG_mRig.RightX_Pos "" UBYTE NO_COMPU_METHOD 0 0 0 255 ECU_ADDRESS 0x340EFB9E FORMAT "%.15" /end MEASUREMENT
/begin MEASUREMENT rtARID_DEF_CpApVscRx60.PP_SG_mRightJoyStat_VDP_SG_mRig.RightX_Value "" UWORD NO_COMPU_METHOD 0 0 0 65535 ECU_ADDRESS 0x340EFBA0 FORMAT "%.15" /end MEASUREMENT
/begin MEASUREMENT rtARID_DEF_CpApVscRx60.PP_SG_mRightJoyStat_VDP_SG_mRig.RightY_Neg "" UBYTE NO_COMPU_METHOD 0 0 0 255 ECU_ADDRESS 0x340EFBA2 FORMAT "%.15" /end MEASUREMENT
/begin MEASUREMENT rtARID_DEF_CpApVscRx60.PP_SG_mRightJoyStat_VDP_SG_mRig.RightY_Ntrl "" UBYTE NO_COMPU_METHOD 0 0 0 255 ECU_ADDRESS 0x340EFBA3 FORMAT "%.15" /end MEASUREMENT
/begin MEASUREMENT rtARID_DEF_CpApVscRx60.PP_SG_mRightJoyStat_VDP_SG_mRig.RightY_Pos "" UBYTE NO_COMPU_METHOD 0 0 0 255 ECU_ADDRESS 0x340EFBA4 FORMAT "%.15" /end MEASUREMENT
/begin MEASUREMENT rtARID_DEF_CpApVscRx60.PP_SG_mRightJoyStat_VDP_SG_mRig.RightY_Value "" UWORD NO_COMPU_METHOD 0 0 0 65535 ECU_ADDRESS 0x340EFBA6 FORMAT "%.15" /end MEASUREMENT
/begin MEASUREMENT rtARID_DEF_CpApWhdRx20_1.PP_SG_mWhdFaults_VDP_SG_mWhdFau.E_CAN_OVERFLOW "" UBYTE NO_COMPU_METHOD 0 0 0 255 ECU_ADDRESS 0x340EFBDC FORMAT "%.15" /end MEASUREMENT
/begin MEASUREMENT rtARID_DEF_CpApWhdRx20_1.PP_SG_mWhdFaults_VDP_SG_mWhdFau.E_CAN_SAME_ID "" UBYTE NO_COMPU_METHOD 0 0 0 255 ECU_ADDRESS 0x340EFBDD FORMAT "%.15" /end MEASUREMENT
/begin MEASUREMENT rtARID_DEF_CpApWhdRx20_1.PP_SG_mWhdFaults_VDP_SG_mWhdFau.E_CAN_SEND_ERR "" UBYTE NO_COMPU_METHOD 0 0 0 255 ECU_ADDRESS 0x340EFBDE FORMAT "%.15" /end MEASUREMENT
/begin MEASUREMENT rtARID_DEF_CpApWhdRx20_1.PP_SG_mWhdFaults_VDP_SG_mWhdFau.E_CAN_TIMEOUT "" UBYTE NO_COMPU_METHOD 0 0 0 255 ECU_ADDRESS 0x340EFBDF FORMAT "%.15" /end MEASUREMENT
/begin MEASUREMENT rtARID_DEF_CpApWhdRx20_1.PP_SG_mWhdFaults_VDP_SG_mWhdFau.E_CAN_mWhdCtrl "" UBYTE NO_COMPU_METHOD 0 0 0 255 ECU_ADDRESS 0x340EFBDA FORMAT "%.15" /end MEASUREMENT
/begin MEASUREMENT rtARID_DEF_CpApWhdRx20_1.PP_SG_mWhdFaults_VDP_SG_mWhdFau.E_CAN_mWhdCtrl2 "" UBYTE NO_COMPU_METHOD 0 0 0 255 ECU_ADDRESS 0x340EFBDB FORMAT "%.15" /end MEASUREMENT
/begin MEASUREMENT rtARID_DEF_CpApWhdRx20_1.PP_SG_mWhdFaults_VDP_SG_mWhdFau.E_CPU_FAULT "" UBYTE NO_COMPU_METHOD 0 0 0 255 ECU_ADDRESS 0x340EFBE0 FORMAT "%.15" /end MEASUREMENT
/begin MEASUREMENT rtARID_DEF_CpApWhdRx20_1.PP_SG_mWhdFaults_VDP_SG_mWhdFau.E_CPU_TEMP "" UBYTE NO_COMPU_METHOD 0 0 0 255 ECU_ADDRESS 0x340EFBE1 FORMAT "%.15" /end MEASUREMENT
/begin MEASUREMENT rtARID_DEF_CpApWhdRx20_1.PP_SG_mWhdFaults_VDP_SG_mWhdFau.E_DCLINK_COMM "" UBYTE NO_COMPU_METHOD 0 0 0 255 ECU_ADDRESS 0x340EFBE2 FORMAT "%.15" /end MEASUREMENT
/begin MEASUREMENT rtARID_DEF_CpApWhdRx20_1.PP_SG_mWhdFaults_VDP_SG_mWhdFau.E_DCLINK_TEMP "" UBYTE NO_COMPU_METHOD 0 0 0 255 ECU_ADDRESS 0x340EFBE3 FORMAT "%.15" /end MEASUREMENT
/begin MEASUREMENT rtARID_DEF_CpApWhdRx20_1.PP_SG_mWhdFaults_VDP_SG_mWhdFau.E_ENCODER "" UBYTE NO_COMPU_METHOD 0 0 0 255 ECU_ADDRESS 0x340EFBE4 FORMAT "%.15" /end MEASUREMENT
/begin MEASUREMENT rtARID_DEF_CpApWhdRx20_1.PP_SG_mWhdFaults_VDP_SG_mWhdFau.E_HALL_SECTOR "" UBYTE NO_COMPU_METHOD 0 0 0 255 ECU_ADDRESS 0x340EFBE5 FORMAT "%.15" /end MEASUREMENT
/begin MEASUREMENT rtARID_DEF_CpApWhdRx20_1.PP_SG_mWhdFaults_VDP_SG_mWhdFau.E_HALL_SEQUENCE "" UBYTE NO_COMPU_METHOD 0 0 0 255 ECU_ADDRESS 0x340EFBE6 FORMAT "%.15" /end MEASUREMENT
/begin MEASUREMENT rtARID_DEF_CpApWhdRx20_1.PP_SG_mWhdFaults_VDP_SG_mWhdFau.E_HW_ENABLE "" UBYTE NO_COMPU_METHOD 0 0 0 255 ECU_ADDRESS 0x340EFBE7 FORMAT "%.15" /end MEASUREMENT
/begin MEASUREMENT rtARID_DEF_CpApWhdRx20_1.PP_SG_mWhdFaults_VDP_SG_mWhdFau.E_INIT_ERROR "" UBYTE NO_COMPU_METHOD 0 0 0 255 ECU_ADDRESS 0x340EFBE8 FORMAT "%.15" /end MEASUREMENT
/begin MEASUREMENT rtARID_DEF_CpApWhdRx20_1.PP_SG_mWhdFaults_VDP_SG_mWhdFau.E_INV01_FAULT "" UBYTE NO_COMPU_METHOD 0 0 0 255 ECU_ADDRESS 0x340EFBE9 FORMAT "%.15" /end MEASUREMENT
/begin MEASUREMENT rtARID_DEF_CpApWhdRx20_1.PP_SG_mWhdFaults_VDP_SG_mWhdFau.E_INV01_OVERCURRENT "" UBYTE NO_COMPU_METHOD 0 0 0 255 ECU_ADDRESS 0x340EFBEA FORMAT "%.15" /end MEASUREMENT
/begin MEASUREMENT rtARID_DEF_CpApWhdRx20_1.PP_SG_mWhdFaults_VDP_SG_mWhdFau.E_INV01_TEMP "" UBYTE NO_COMPU_METHOD 0 0 0 255 ECU_ADDRESS 0x340EFBEB FORMAT "%.15" /end MEASUREMENT
/begin MEASUREMENT rtARID_DEF_CpApWhdRx20_1.PP_SG_mWhdFaults_VDP_SG_mWhdFau.E_INV02_FAULT "" UBYTE NO_COMPU_METHOD 0 0 0 255 ECU_ADDRESS 0x340EFBEC FORMAT "%.15" /end MEASUREMENT
/begin MEASUREMENT rtARID_DEF_CpApWhdRx20_1.PP_SG_mWhdFaults_VDP_SG_mWhdFau.E_INV02_OVERCURRENT "" UBYTE NO_COMPU_METHOD 0 0 0 255 ECU_ADDRESS 0x340EFBED FORMAT "%.15" /end MEASUREMENT
/begin MEASUREMENT rtARID_DEF_CpApWhdRx20_1.PP_SG_mWhdFaults_VDP_SG_mWhdFau.E_INV02_TEMP "" UBYTE NO_COMPU_METHOD 0 0 0 255 ECU_ADDRESS 0x340EFBEE FORMAT "%.15" /end MEASUREMENT
/begin MEASUREMENT rtARID_DEF_CpApWhdRx20_1.PP_SG_mWhdFaults_VDP_SG_mWhdFau.E_INV03_FAULT "" UBYTE NO_COMPU_METHOD 0 0 0 255 ECU_ADDRESS 0x340EFBEF FORMAT "%.15" /end MEASUREMENT
/begin MEASUREMENT rtARID_DEF_CpApWhdRx20_1.PP_SG_mWhdFaults_VDP_SG_mWhdFau.E_INV03_OVERCURRENT "" UBYTE NO_COMPU_METHOD 0 0 0 255 ECU_ADDRESS 0x340EFBF0 FORMAT "%.15" /end MEASUREMENT
/begin MEASUREMENT rtARID_DEF_CpApWhdRx20_1.PP_SG_mWhdFaults_VDP_SG_mWhdFau.E_INV03_TEMP "" UBYTE NO_COMPU_METHOD 0 0 0 255 ECU_ADDRESS 0x340EFBF1 FORMAT "%.15" /end MEASUREMENT
/begin MEASUREMENT rtARID_DEF_CpApWhdRx20_1.PP_SG_mWhdFaults_VDP_SG_mWhdFau.E_INV04_FAULT "" UBYTE NO_COMPU_METHOD 0 0 0 255 ECU_ADDRESS 0x340EFBF2 FORMAT "%.15" /end MEASUREMENT
/begin MEASUREMENT rtARID_DEF_CpApWhdRx20_1.PP_SG_mWhdFaults_VDP_SG_mWhdFau.E_INV04_OVERCURRENT "" UBYTE NO_COMPU_METHOD 0 0 0 255 ECU_ADDRESS 0x340EFBF3 FORMAT "%.15" /end MEASUREMENT
/begin MEASUREMENT rtARID_DEF_CpApWhdRx20_1.PP_SG_mWhdFaults_VDP_SG_mWhdFau.E_INV04_TEMP "" UBYTE NO_COMPU_METHOD 0 0 0 255 ECU_ADDRESS 0x340EFBF4 FORMAT "%.15" /end MEASUREMENT
/begin MEASUREMENT rtARID_DEF_CpApWhdRx20_1.PP_SG_mWhdFaults_VDP_SG_mWhdFau.E_INV05_FAULT "" UBYTE NO_COMPU_METHOD 0 0 0 255 ECU_ADDRESS 0x340EFBF5 FORMAT "%.15" /end MEASUREMENT
/begin MEASUREMENT rtARID_DEF_CpApWhdRx20_1.PP_SG_mWhdFaults_VDP_SG_mWhdFau.E_INV05_OVERCURRENT "" UBYTE NO_COMPU_METHOD 0 0 0 255 ECU_ADDRESS 0x340EFBF6 FORMAT "%.15" /end MEASUREMENT
/begin MEASUREMENT rtARID_DEF_CpApWhdRx20_1.PP_SG_mWhdFaults_VDP_SG_mWhdFau.E_INV05_TEMP "" UBYTE NO_COMPU_METHOD 0 0 0 255 ECU_ADDRESS 0x340EFBF7 FORMAT "%.15" /end MEASUREMENT
/begin MEASUREMENT rtARID_DEF_CpApWhdRx20_1.PP_SG_mWhdFaults_VDP_SG_mWhdFau.E_INV06_FAULT "" UBYTE NO_COMPU_METHOD 0 0 0 255 ECU_ADDRESS 0x340EFBF8 FORMAT "%.15" /end MEASUREMENT
/begin MEASUREMENT rtARID_DEF_CpApWhdRx20_1.PP_SG_mWhdFaults_VDP_SG_mWhdFau.E_INV06_OVERCURRENT "" UBYTE NO_COMPU_METHOD 0 0 0 255 ECU_ADDRESS 0x340EFBF9 FORMAT "%.15" /end MEASUREMENT
/begin MEASUREMENT rtARID_DEF_CpApWhdRx20_1.PP_SG_mWhdFaults_VDP_SG_mWhdFau.E_INV06_TEMP "" UBYTE NO_COMPU_METHOD 0 0 0 255 ECU_ADDRESS 0x340EFBFA FORMAT "%.15" /end MEASUREMENT
/begin MEASUREMENT rtARID_DEF_CpApWhdRx20_1.PP_SG_mWhdFaults_VDP_SG_mWhdFau.E_INV07_FAULT "" UBYTE NO_COMPU_METHOD 0 0 0 255 ECU_ADDRESS 0x340EFBFB FORMAT "%.15" /end MEASUREMENT
/begin MEASUREMENT rtARID_DEF_CpApWhdRx20_1.PP_SG_mWhdFaults_VDP_SG_mWhdFau.E_INV07_OVERCURRENT "" UBYTE NO_COMPU_METHOD 0 0 0 255 ECU_ADDRESS 0x340EFBFC FORMAT "%.15" /end MEASUREMENT
/begin MEASUREMENT rtARID_DEF_CpApWhdRx20_1.PP_SG_mWhdFaults_VDP_SG_mWhdFau.E_INV07_TEMP "" UBYTE NO_COMPU_METHOD 0 0 0 255 ECU_ADDRESS 0x340EFBFD FORMAT "%.15" /end MEASUREMENT
/begin MEASUREMENT rtARID_DEF_CpApWhdRx20_1.PP_SG_mWhdFaults_VDP_SG_mWhdFau.E_INV08_FAULT "" UBYTE NO_COMPU_METHOD 0 0 0 255 ECU_ADDRESS 0x340EFBFE FORMAT "%.15" /end MEASUREMENT
/begin MEASUREMENT rtARID_DEF_CpApWhdRx20_1.PP_SG_mWhdFaults_VDP_SG_mWhdFau.E_INV08_OVERCURRENT "" UBYTE NO_COMPU_METHOD 0 0 0 255 ECU_ADDRESS 0x340EFBFF FORMAT "%.15" /end MEASUREMENT
/begin MEASUREMENT rtARID_DEF_CpApWhdRx20_1.PP_SG_mWhdFaults_VDP_SG_mWhdFau.E_INV08_TEMP "" UBYTE NO_COMPU_METHOD 0 0 0 255 ECU_ADDRESS 0x340EFC00 FORMAT "%.15" /end MEASUREMENT
/begin MEASUREMENT rtARID_DEF_CpApWhdRx20_1.PP_SG_mWhdFaults_VDP_SG_mWhdFau.E_INVALID_SETTINGS "" UBYTE NO_COMPU_METHOD 0 0 0 255 ECU_ADDRESS 0x340EFC01 FORMAT "%.15" /end MEASUREMENT
/begin MEASUREMENT rtARID_DEF_CpApWhdRx20_1.PP_SG_mWhdFaults_VDP_SG_mWhdFau.E_MOTOR_OVERSPEED "" UBYTE NO_COMPU_METHOD 0 0 0 255 ECU_ADDRESS 0x340EFC02 FORMAT "%.15" /end MEASUREMENT
/begin MEASUREMENT rtARID_DEF_CpApWhdRx20_1.PP_SG_mWhdFaults_VDP_SG_mWhdFau.E_MOTOR_STALLED "" UBYTE NO_COMPU_METHOD 0 0 0 255 ECU_ADDRESS 0x340EFC03 FORMAT "%.15" /end MEASUREMENT
/begin MEASUREMENT rtARID_DEF_CpApWhdRx20_1.PP_SG_mWhdFaults_VDP_SG_mWhdFau.E_OVERVOLTAGE "" UBYTE NO_COMPU_METHOD 0 0 0 255 ECU_ADDRESS 0x340EFC04 FORMAT "%.15" /end MEASUREMENT
/begin MEASUREMENT rtARID_DEF_CpApWhdRx20_1.PP_SG_mWhdFaults_VDP_SG_mWhdFau.E_POSSENSOR "" UBYTE NO_COMPU_METHOD 0 0 0 255 ECU_ADDRESS 0x340EFC05 FORMAT "%.15" /end MEASUREMENT
/begin MEASUREMENT rtARID_DEF_CpApWhdRx20_1.PP_SG_mWhdFaults_VDP_SG_mWhdFau.E_READING_TIMEOUT "" UBYTE NO_COMPU_METHOD 0 0 0 255 ECU_ADDRESS 0x340EFC06 FORMAT "%.15" /end MEASUREMENT
/begin MEASUREMENT rtARID_DEF_CpApWhdRx20_1.PP_SG_mWhdFaults_VDP_SG_mWhdFau.E_TEMP_SENSOR "" UBYTE NO_COMPU_METHOD 0 0 0 255 ECU_ADDRESS 0x340EFC07 FORMAT "%.15" /end MEASUREMENT
/begin MEASUREMENT rtARID_DEF_CpApWhdRx20_1.PP_SG_mWhdFaults_VDP_SG_mWhdFau.E_UNDERVOLTAGE "" UBYTE NO_COMPU_METHOD 0 0 0 255 ECU_ADDRESS 0x340EFC08 FORMAT "%.15" /end MEASUREMENT
/begin MEASUREMENT rtARID_DEF_CpApWhdRx20_1.PP_SG_mWhdFaults_VDP_SG_mWhdFau.E_WINDING_TEMP "" UBYTE NO_COMPU_METHOD 0 0 0 255 ECU_ADDRESS 0x340EFC09 FORMAT "%.15" /end MEASUREMENT
/begin MEASUREMENT rtARID_DEF_CpApWhdRx20_1.PP_SG_mWhdFaults_VDP_SG_mWhdFau.E_ZERO_POSITION "" UBYTE NO_COMPU_METHOD 0 0 0 255 ECU_ADDRESS 0x340EFC0A FORMAT "%.15" /end MEASUREMENT
/begin MEASUREMENT rtARID_DEF_CpApWhdRx20_1.PP_SG_mWhdFaults_VDP_SG_mWhdFau.MsgCntr "" UBYTE NO_COMPU_METHOD 0 0 0 255 ECU_ADDRESS 0x340EFC0B FORMAT "%.15" /end MEASUREMENT
/begin MEASUREMENT rtARID_DEF_CpApWhdRx20_1.PP_SG_mWhdFaults_VDP_SG_mWhdFau.SwVerMaj "" UBYTE NO_COMPU_METHOD 0 0 0 255 ECU_ADDRESS 0x340EFC0C FORMAT "%.15" /end MEASUREMENT
/begin MEASUREMENT rtARID_DEF_CpApWhdRx20_1.PP_SG_mWhdFaults_VDP_SG_mWhdFau.SwVerMin "" UBYTE NO_COMPU_METHOD 0 0 0 255 ECU_ADDRESS 0x340EFC0D FORMAT "%.15" /end MEASUREMENT
/begin MEASUREMENT rtARID_DEF_CpApWhdRx20_2.PP_SG_mWhdStat2_VDP_SG_mWhdStat "" UBYTE NO_COMPU_METHOD 0 0 0 255 ECU_ADDRESS 0x340EFC44 FORMAT "%.15" /end MEASUREMENT
/begin MEASUREMENT rtARID_DEF_CpApWhdRx20_2.PP_SG_mWhdStat2_VDP_SG_mWhdStat.HwWakeStat "" UBYTE NO_COMPU_METHOD 0 0 0 255 ECU_ADDRESS 0x340EFC44 FORMAT "%.15" /end MEASUREMENT
/begin MEASUREMENT rtARID_DEF_CpApWhdRx20_2.PP_SG_mWhdStat2_VDP_SG_mWhdStat.InvTmpr "" UBYTE NO_COMPU_METHOD 0 0 0 255 ECU_ADDRESS 0x340EFC45 FORMAT "%.15" /end MEASUREMENT
/begin MEASUREMENT rtARID_DEF_CpApWhdRx20_2.PP_SG_mWhdStat2_VDP_SG_mWhdStat.LvVolt "" FLOAT32_IEEE NO_COMPU_METHOD 0 0 -3.40282346639E+38 3.40282346639E+38 ECU_ADDRESS 0x340EFC48 FORMAT "%.15" /end MEASUREMENT
/begin MEASUREMENT rtARID_DEF_CpApWhdRx20_2.PP_SG_mWhdStat2_VDP_SG_mWhdStat.MsgCntr "" UBYTE NO_COMPU_METHOD 0 0 0 255 ECU_ADDRESS 0x340EFC4C FORMAT "%.15" /end MEASUREMENT
/begin MEASUREMENT rtARID_DEF_CpApWhdRx20_2.PP_SG_mWhdStat2_VDP_SG_mWhdStat.MtrTmpr "" UBYTE NO_COMPU_METHOD 0 0 0 255 ECU_ADDRESS 0x340EFC4D FORMAT "%.15" /end MEASUREMENT
/begin MEASUREMENT rtARID_DEF_CpApWhdRx20_2.PP_SG_mWhdStat2_VDP_SG_mWhdStat.TrqAvailMtr "" UBYTE NO_COMPU_METHOD 0 0 0 255 ECU_ADDRESS 0x340EFC4E FORMAT "%.15" /end MEASUREMENT
/begin MEASUREMENT rtARID_DEF_CpApWhdRx20_2.PP_SG_mWhdStat2_VDP_SG_mWhdStat.TrqAvailRegen "" UBYTE NO_COMPU_METHOD 0 0 0 255 ECU_ADDRESS 0x340EFC4F FORMAT "%.15" /end MEASUREMENT
/begin MEASUREMENT rtARID_DEF_CpApWhdRx20_2.PP_SG_mWhdStat2_VDP_SG_mWhdStat.TrqLmt_Design "" UBYTE NO_COMPU_METHOD 0 0 0 255 ECU_ADDRESS 0x340EFC50 FORMAT "%.15" /end MEASUREMENT
/begin MEASUREMENT rtARID_DEF_CpApWhdRx20_2.PP_SG_mWhdStat2_VDP_SG_mWhdStat.TrqLmt_InvTmpr "" UBYTE NO_COMPU_METHOD 0 0 0 255 ECU_ADDRESS 0x340EFC51 FORMAT "%.15" /end MEASUREMENT
/begin MEASUREMENT rtARID_DEF_CpApWhdRx20_2.PP_SG_mWhdStat2_VDP_SG_mWhdStat.TrqLmt_MtrSpd "" UBYTE NO_COMPU_METHOD 0 0 0 255 ECU_ADDRESS 0x340EFC52 FORMAT "%.15" /end MEASUREMENT
/begin MEASUREMENT rtARID_DEF_CpApWhdRx20_2.PP_SG_mWhdStat2_VDP_SG_mWhdStat.TrqLmt_MtrTmpr "" UBYTE NO_COMPU_METHOD 0 0 0 255 ECU_ADDRESS 0x340EFC53 FORMAT "%.15" /end MEASUREMENT
/begin MEASUREMENT rtARID_DEF_CpApWhdRx20_2.PP_SG_mWhdStat2_VDP_SG_mWhdStat.TrqLmt_Pwr "" UBYTE NO_COMPU_METHOD 0 0 0 255 ECU_ADDRESS 0x340EFC54 FORMAT "%.15" /end MEASUREMENT
/begin MEASUREMENT rtARID_DEF_CpApWhdRx20_2.PP_SG_mWhdStat2_VDP_SG_mWhdStat.TrqLmt_SpdSlew "" UBYTE NO_COMPU_METHOD 0 0 0 255 ECU_ADDRESS 0x340EFC55 FORMAT "%.15" /end MEASUREMENT
/begin MEASUREMENT rtARID_DEF_CpApWhdRx20_2.PP_SG_mWhdStat2_VDP_SG_mWhdStat.TrqLmt_TrqSlew "" UBYTE NO_COMPU_METHOD 0 0 0 255 ECU_ADDRESS 0x340EFC56 FORMAT "%.15" /end MEASUREMENT
/begin MEASUREMENT rtARID_DEF_CpApWhdRx20_2.PP_SG_mWhdStat2_VDP_SG_mWhdStat.TrqLmt_Volt "" UBYTE NO_COMPU_METHOD 0 0 0 255 ECU_ADDRESS 0x340EFC57 FORMAT "%.15" /end MEASUREMENT
/begin MEASUREMENT rtARID_DEF_CpApWhdRx20_2.PP_SG_mWhdStat2_VDP_SG_mWhdStat.WhdRdy "" UBYTE NO_COMPU_METHOD 0 0 0 255 ECU_ADDRESS 0x340EFC58 FORMAT "%.15" /end MEASUREMENT
/begin MEASUREMENT rtARID_DEF_CpApWhdRx20_2.PP_SG_mWhdStat2_VDP_SG_mWhdStat.WhdShtdwnRdy "" UBYTE NO_COMPU_METHOD 0 0 0 255 ECU_ADDRESS 0x340EFC59 FORMAT "%.15" /end MEASUREMENT
/begin MEASUREMENT rtARID_DEF_CpApWhdRx20_2.PP_SG_mWhdStat2_VDP_SG_mWhdStat.WhdState "" UBYTE NO_COMPU_METHOD 0 0 0 255 ECU_ADDRESS 0x340EFC5A FORMAT "%.15" /end MEASUREMENT
/begin CHARACTERISTIC rtARID_DEF_CpApWhdRx20_2.PP_SG_mWhdStat3_VDP_SG_mWhdStat.WhdAngle "" VALUE 0x340EFC74 __FLOAT32_IEEE_S 0 NO_COMPU_METHOD -3.40282346639E+38 3.40282346639E+38 FORMAT "%.15" /end CHARACTERISTIC
/begin CHARACTERISTIC rtARID_DEF_CpApWhdRx20_2.PP_SG_mWhdStat3_VDP_SG_mWhdStat.WhdCurr_Ph1A "" VALUE 0x340EFC78 __UBYTE_S 0 NO_COMPU_METHOD 0 255 FORMAT "%.15" /end CHARACTERISTIC
/begin CHARACTERISTIC rtARID_DEF_CpApWhdRx20_2.PP_SG_mWhdStat3_VDP_SG_mWhdStat.WhdCurr_Ph1B "" VALUE 0x340EFC79 __UBYTE_S 0 NO_COMPU_METHOD 0 255 FORMAT "%.15" /end CHARACTERISTIC
/begin CHARACTERISTIC rtARID_DEF_CpApWhdRx20_2.PP_SG_mWhdStat3_VDP_SG_mWhdStat.WhdCurr_Ph1C "" VALUE 0x340EFC7A __UBYTE_S 0 NO_COMPU_METHOD 0 255 FORMAT "%.15" /end CHARACTERISTIC
/begin CHARACTERISTIC rtARID_DEF_CpApWhdRx20_2.PP_SG_mWhdStat3_VDP_SG_mWhdStat.WhdCurr_Ph2A "" VALUE 0x340EFC7B __UBYTE_S 0 NO_COMPU_METHOD 0 255 FORMAT "%.15" /end CHARACTERISTIC
/begin CHARACTERISTIC rtARID_DEF_CpApWhdRx20_2.PP_SG_mWhdStat3_VDP_SG_mWhdStat.WhdCurr_Ph2B "" VALUE 0x340EFC7C __UBYTE_S 0 NO_COMPU_METHOD 0 255 FORMAT "%.15" /end CHARACTERISTIC
/begin CHARACTERISTIC rtARID_DEF_CpApWhdRx20_2.PP_SG_mWhdStat3_VDP_SG_mWhdStat.WhdCurr_Ph2C "" VALUE 0x340EFC7D __UBYTE_S 0 NO_COMPU_METHOD 0 255 FORMAT "%.15" /end CHARACTERISTIC
/begin MEASUREMENT rtARID_DEF_CpApWhdRx20_2.PP_SG_mWhdStat_VDP_SG_mWhdStat "" UBYTE NO_COMPU_METHOD 0 0 0 255 ECU_ADDRESS 0x340EFC5C FORMAT "%.15" /end MEASUREMENT
/begin MEASUREMENT rtARID_DEF_CpApWhdRx20_2.PP_SG_mWhdStat_VDP_SG_mWhdStat.HwEnblStat "" UBYTE NO_COMPU_METHOD 0 0 0 255 ECU_ADDRESS 0x340EFC5C FORMAT "%.15" /end MEASUREMENT
/begin MEASUREMENT rtARID_DEF_CpApWhdRx20_2.PP_SG_mWhdStat_VDP_SG_mWhdStat.MsgCntr "" UBYTE NO_COMPU_METHOD 0 0 0 255 ECU_ADDRESS 0x340EFC5D FORMAT "%.15" /end MEASUREMENT
/begin MEASUREMENT rtARID_DEF_CpApWhdRx20_2.PP_SG_mWhdStat_VDP_SG_mWhdStat.MsgCrc "" UBYTE NO_COMPU_METHOD 0 0 0 255 ECU_ADDRESS 0x340EFC5E FORMAT "%.15" /end MEASUREMENT
/begin MEASUREMENT rtARID_DEF_CpApWhdRx20_2.PP_SG_mWhdStat_VDP_SG_mWhdStat.MtrSpd "" FLOAT32_IEEE NO_COMPU_METHOD 0 0 -3.40282346639E+38 3.40282346639E+38 ECU_ADDRESS 0x340EFC60 FORMAT "%.15" /end MEASUREMENT
/begin MEASUREMENT rtARID_DEF_CpApWhdRx20_2.PP_SG_mWhdStat_VDP_SG_mWhdStat.MtrTrqEst "" FLOAT32_IEEE NO_COMPU_METHOD 0 0 -3.40282346639E+38 3.40282346639E+38 ECU_ADDRESS 0x340EFC64 FORMAT "%.15" /end MEASUREMENT
/begin MEASUREMENT rtARID_DEF_CpApWhdRx20_2.PP_SG_mWhdStat_VDP_SG_mWhdStat.MvCurrEst "" FLOAT32_IEEE NO_COMPU_METHOD 0 0 -3.40282346639E+38 3.40282346639E+38 ECU_ADDRESS 0x340EFC68 FORMAT "%.15" /end MEASUREMENT
/begin MEASUREMENT rtARID_DEF_CpApWhdRx20_2.PP_SG_mWhdStat_VDP_SG_mWhdStat.MvVolt "" FLOAT32_IEEE NO_COMPU_METHOD 0 0 -3.40282346639E+38 3.40282346639E+38 ECU_ADDRESS 0x340EFC6C FORMAT "%.15" /end MEASUREMENT
/begin MEASUREMENT rtARID_DEF_CpApWhdRx20_2.PP_SG_mWhdStat_VDP_SG_mWhdStat.TrqEnblStat "" UBYTE NO_COMPU_METHOD 0 0 0 255 ECU_ADDRESS 0x340EFC70 FORMAT "%.15" /end MEASUREMENT
/begin MEASUREMENT rtARID_DEF_CpApWhdRx20_3.PP_SG_mWhdWarn_VDP_SG_mWhdWarn.MsgCntr "" UBYTE NO_COMPU_METHOD 0 0 0 255 ECU_ADDRESS 0x340EFCB4 FORMAT "%.15" /end MEASUREMENT
/begin MEASUREMENT rtARID_DEF_CpApWhdRx20_3.PP_SG_mWhdWarn_VDP_SG_mWhdWarn.W_CAN_OVERFLOW "" UBYTE NO_COMPU_METHOD 0 0 0 255 ECU_ADDRESS 0x340EFCB5 FORMAT "%.15" /end MEASUREMENT
/begin MEASUREMENT rtARID_DEF_CpApWhdRx20_3.PP_SG_mWhdWarn_VDP_SG_mWhdWarn.W_CAN_SEND_ERROR "" UBYTE NO_COMPU_METHOD 0 0 0 255 ECU_ADDRESS 0x340EFCB6 FORMAT "%.15" /end MEASUREMENT
/begin MEASUREMENT rtARID_DEF_CpApWhdRx20_3.PP_SG_mWhdWarn_VDP_SG_mWhdWarn.W_CPU_FAULT "" UBYTE NO_COMPU_METHOD 0 0 0 255 ECU_ADDRESS 0x340EFCB7 FORMAT "%.15" /end MEASUREMENT
/begin MEASUREMENT rtARID_DEF_CpApWhdRx20_3.PP_SG_mWhdWarn_VDP_SG_mWhdWarn.W_CPU_TEMP "" UBYTE NO_COMPU_METHOD 0 0 0 255 ECU_ADDRESS 0x340EFCB8 FORMAT "%.15" /end MEASUREMENT
/begin MEASUREMENT rtARID_DEF_CpApWhdRx20_3.PP_SG_mWhdWarn_VDP_SG_mWhdWarn.W_DCLINK_COMM "" UBYTE NO_COMPU_METHOD 0 0 0 255 ECU_ADDRESS 0x340EFCB9 FORMAT "%.15" /end MEASUREMENT
/begin MEASUREMENT rtARID_DEF_CpApWhdRx20_3.PP_SG_mWhdWarn_VDP_SG_mWhdWarn.W_DCLINK_TEMP "" UBYTE NO_COMPU_METHOD 0 0 0 255 ECU_ADDRESS 0x340EFCBA FORMAT "%.15" /end MEASUREMENT
/begin MEASUREMENT rtARID_DEF_CpApWhdRx20_3.PP_SG_mWhdWarn_VDP_SG_mWhdWarn.W_FLYING_START "" UBYTE NO_COMPU_METHOD 0 0 0 255 ECU_ADDRESS 0x340EFCBB FORMAT "%.15" /end MEASUREMENT
/begin MEASUREMENT rtARID_DEF_CpApWhdRx20_3.PP_SG_mWhdWarn_VDP_SG_mWhdWarn.W_INV01_FAULT "" UBYTE NO_COMPU_METHOD 0 0 0 255 ECU_ADDRESS 0x340EFCBC FORMAT "%.15" /end MEASUREMENT
/begin MEASUREMENT rtARID_DEF_CpApWhdRx20_3.PP_SG_mWhdWarn_VDP_SG_mWhdWarn.W_INV01_OVERCURRENT "" UBYTE NO_COMPU_METHOD 0 0 0 255 ECU_ADDRESS 0x340EFCBD FORMAT "%.15" /end MEASUREMENT
/begin MEASUREMENT rtARID_DEF_CpApWhdRx20_3.PP_SG_mWhdWarn_VDP_SG_mWhdWarn.W_INV01_TEMP "" UBYTE NO_COMPU_METHOD 0 0 0 255 ECU_ADDRESS 0x340EFCBE FORMAT "%.15" /end MEASUREMENT
/begin MEASUREMENT rtARID_DEF_CpApWhdRx20_3.PP_SG_mWhdWarn_VDP_SG_mWhdWarn.W_INV02_FAULT "" UBYTE NO_COMPU_METHOD 0 0 0 255 ECU_ADDRESS 0x340EFCBF FORMAT "%.15" /end MEASUREMENT
/begin MEASUREMENT rtARID_DEF_CpApWhdRx20_3.PP_SG_mWhdWarn_VDP_SG_mWhdWarn.W_INV02_OVERCURRENT "" UBYTE NO_COMPU_METHOD 0 0 0 255 ECU_ADDRESS 0x340EFCC0 FORMAT "%.15" /end MEASUREMENT
/begin MEASUREMENT rtARID_DEF_CpApWhdRx20_3.PP_SG_mWhdWarn_VDP_SG_mWhdWarn.W_INV02_TEMP "" UBYTE NO_COMPU_METHOD 0 0 0 255 ECU_ADDRESS 0x340EFCC1 FORMAT "%.15" /end MEASUREMENT
/begin MEASUREMENT rtARID_DEF_CpApWhdRx20_3.PP_SG_mWhdWarn_VDP_SG_mWhdWarn.W_INV03_FAULT "" UBYTE NO_COMPU_METHOD 0 0 0 255 ECU_ADDRESS 0x340EFCC2 FORMAT "%.15" /end MEASUREMENT
/begin MEASUREMENT rtARID_DEF_CpApWhdRx20_3.PP_SG_mWhdWarn_VDP_SG_mWhdWarn.W_INV03_OVERCURRENT "" UBYTE NO_COMPU_METHOD 0 0 0 255 ECU_ADDRESS 0x340EFCC3 FORMAT "%.15" /end MEASUREMENT
/begin MEASUREMENT rtARID_DEF_CpApWhdRx20_3.PP_SG_mWhdWarn_VDP_SG_mWhdWarn.W_INV03_TEMP "" UBYTE NO_COMPU_METHOD 0 0 0 255 ECU_ADDRESS 0x340EFCC4 FORMAT "%.15" /end MEASUREMENT
/begin MEASUREMENT rtARID_DEF_CpApWhdRx20_3.PP_SG_mWhdWarn_VDP_SG_mWhdWarn.W_INV04_FAULT "" UBYTE NO_COMPU_METHOD 0 0 0 255 ECU_ADDRESS 0x340EFCC5 FORMAT "%.15" /end MEASUREMENT
/begin MEASUREMENT rtARID_DEF_CpApWhdRx20_3.PP_SG_mWhdWarn_VDP_SG_mWhdWarn.W_INV04_OVERCURRENT "" UBYTE NO_COMPU_METHOD 0 0 0 255 ECU_ADDRESS 0x340EFCC6 FORMAT "%.15" /end MEASUREMENT
/begin MEASUREMENT rtARID_DEF_CpApWhdRx20_3.PP_SG_mWhdWarn_VDP_SG_mWhdWarn.W_INV04_TEMP "" UBYTE NO_COMPU_METHOD 0 0 0 255 ECU_ADDRESS 0x340EFCC7 FORMAT "%.15" /end MEASUREMENT
/begin MEASUREMENT rtARID_DEF_CpApWhdRx20_3.PP_SG_mWhdWarn_VDP_SG_mWhdWarn.W_INV05_FAULT "" UBYTE NO_COMPU_METHOD 0 0 0 255 ECU_ADDRESS 0x340EFCC8 FORMAT "%.15" /end MEASUREMENT
/begin MEASUREMENT rtARID_DEF_CpApWhdRx20_3.PP_SG_mWhdWarn_VDP_SG_mWhdWarn.W_INV05_OVERCURRENT "" UBYTE NO_COMPU_METHOD 0 0 0 255 ECU_ADDRESS 0x340EFCC9 FORMAT "%.15" /end MEASUREMENT
/begin MEASUREMENT rtARID_DEF_CpApWhdRx20_3.PP_SG_mWhdWarn_VDP_SG_mWhdWarn.W_INV05_TEMP "" UBYTE NO_COMPU_METHOD 0 0 0 255 ECU_ADDRESS 0x340EFCCA FORMAT "%.15" /end MEASUREMENT
/begin MEASUREMENT rtARID_DEF_CpApWhdRx20_3.PP_SG_mWhdWarn_VDP_SG_mWhdWarn.W_INV06_FAULT "" UBYTE NO_COMPU_METHOD 0 0 0 255 ECU_ADDRESS 0x340EFCCB FORMAT "%.15" /end MEASUREMENT
/begin MEASUREMENT rtARID_DEF_CpApWhdRx20_3.PP_SG_mWhdWarn_VDP_SG_mWhdWarn.W_INV06_OVERCURRENT "" UBYTE NO_COMPU_METHOD 0 0 0 255 ECU_ADDRESS 0x340EFCCC FORMAT "%.15" /end MEASUREMENT
/begin MEASUREMENT rtARID_DEF_CpApWhdRx20_3.PP_SG_mWhdWarn_VDP_SG_mWhdWarn.W_INV06_TEMP "" UBYTE NO_COMPU_METHOD 0 0 0 255 ECU_ADDRESS 0x340EFCCD FORMAT "%.15" /end MEASUREMENT
/begin MEASUREMENT rtARID_DEF_CpApWhdRx20_3.PP_SG_mWhdWarn_VDP_SG_mWhdWarn.W_MOTOR_OVERSPEED "" UBYTE NO_COMPU_METHOD 0 0 0 255 ECU_ADDRESS 0x340EFCCE FORMAT "%.15" /end MEASUREMENT
/begin MEASUREMENT rtARID_DEF_CpApWhdRx20_3.PP_SG_mWhdWarn_VDP_SG_mWhdWarn.W_MOTOR_STALLED "" UBYTE NO_COMPU_METHOD 0 0 0 255 ECU_ADDRESS 0x340EFCCF FORMAT "%.15" /end MEASUREMENT
/begin MEASUREMENT rtARID_DEF_CpApWhdRx20_3.PP_SG_mWhdWarn_VDP_SG_mWhdWarn.W_OVERVOLTAGE "" UBYTE NO_COMPU_METHOD 0 0 0 255 ECU_ADDRESS 0x340EFCD0 FORMAT "%.15" /end MEASUREMENT
/begin MEASUREMENT rtARID_DEF_CpApWhdRx20_3.PP_SG_mWhdWarn_VDP_SG_mWhdWarn.W_POSSENSOR "" UBYTE NO_COMPU_METHOD 0 0 0 255 ECU_ADDRESS 0x340EFCD1 FORMAT "%.15" /end MEASUREMENT
/begin MEASUREMENT rtARID_DEF_CpApWhdRx20_3.PP_SG_mWhdWarn_VDP_SG_mWhdWarn.W_TEMP_SENSOR "" UBYTE NO_COMPU_METHOD 0 0 0 255 ECU_ADDRESS 0x340EFCD2 FORMAT "%.15" /end MEASUREMENT
/begin MEASUREMENT rtARID_DEF_CpApWhdRx20_3.PP_SG_mWhdWarn_VDP_SG_mWhdWarn.W_TORQUE_LIMIT "" UBYTE NO_COMPU_METHOD 0 0 0 255 ECU_ADDRESS 0x340EFCD3 FORMAT "%.15" /end MEASUREMENT
/begin MEASUREMENT rtARID_DEF_CpApWhdRx20_3.PP_SG_mWhdWarn_VDP_SG_mWhdWarn.W_UNDERVOLTAGE "" UBYTE NO_COMPU_METHOD 0 0 0 255 ECU_ADDRESS 0x340EFCD4 FORMAT "%.15" /end MEASUREMENT
/begin MEASUREMENT rtARID_DEF_CpApWhdRx20_3.PP_SG_mWhdWarn_VDP_SG_mWhdWarn.W_WINDING_TEMP "" UBYTE NO_COMPU_METHOD 0 0 0 255 ECU_ADDRESS 0x340EFCD5 FORMAT "%.15" /end MEASUREMENT
/begin RECORD_LAYOUT SSV__A_INT64_S AXIS_PTS_X 1 A_INT64 INDEX_INCR DIRECT /end RECORD_LAYOUT
/begin RECORD_LAYOUT SSV__A_UINT64_S AXIS_PTS_X 1 A_UINT64 INDEX_INCR DIRECT /end RECORD_LAYOUT
/begin RECORD_LAYOUT SSV__FLOAT32_IEEE_S AXIS_PTS_X 1 FLOAT32_IEEE INDEX_INCR DIRECT /end RECORD_LAYOUT
/begin RECORD_LAYOUT SSV__FLOAT64_IEEE_S AXIS_PTS_X 1 FLOAT64_IEEE INDEX_INCR DIRECT /end RECORD_LAYOUT
/begin RECORD_LAYOUT SSV__SBYTE_S AXIS_PTS_X 1 SBYTE INDEX_INCR DIRECT /end RECORD_LAYOUT
/begin RECORD_LAYOUT SSV__SLONG_S AXIS_PTS_X 1 SLONG INDEX_INCR DIRECT /end RECORD_LAYOUT
/begin RECORD_LAYOUT SSV__SWORD_S AXIS_PTS_X 1 SWORD INDEX_INCR DIRECT /end RECORD_LAYOUT
/begin RECORD_LAYOUT SSV__UBYTE_S AXIS_PTS_X 1 UBYTE INDEX_INCR DIRECT /end RECORD_LAYOUT
/begin RECORD_LAYOUT SSV__ULONG_S AXIS_PTS_X 1 ULONG INDEX_INCR DIRECT /end RECORD_LAYOUT
/begin RECORD_LAYOUT SSV__UWORD_S AXIS_PTS_X 1 UWORD INDEX_INCR DIRECT /end RECORD_LAYOUT
/begin RECORD_LAYOUT __A_INT64_S FNC_VALUES 1 A_INT64 COLUMN_DIR DIRECT /end RECORD_LAYOUT
/begin RECORD_LAYOUT __A_INT64_Z FNC_VALUES 1 A_INT64 ROW_DIR DIRECT /end RECORD_LAYOUT
/begin RECORD_LAYOUT __A_UINT64_S FNC_VALUES 1 A_UINT64 COLUMN_DIR DIRECT /end RECORD_LAYOUT
/begin RECORD_LAYOUT __A_UINT64_Z FNC_VALUES 1 A_UINT64 ROW_DIR DIRECT /end RECORD_LAYOUT
/begin RECORD_LAYOUT __FLOAT32_IEEE_S FNC_VALUES 1 FLOAT32_IEEE COLUMN_DIR DIRECT /end RECORD_LAYOUT
/begin RECORD_LAYOUT __FLOAT32_IEEE_Z FNC_VALUES 1 FLOAT32_IEEE ROW_DIR DIRECT /end RECORD_LAYOUT
/begin RECORD_LAYOUT __FLOAT64_IEEE_S FNC_VALUES 1 FLOAT64_IEEE COLUMN_DIR DIRECT /end RECORD_LAYOUT
/begin RECORD_LAYOUT __FLOAT64_IEEE_Z FNC_VALUES 1 FLOAT64_IEEE ROW_DIR DIRECT /end RECORD_LAYOUT
/begin RECORD_LAYOUT __SBYTE_S FNC_VALUES 1 SBYTE COLUMN_DIR DIRECT /end RECORD_LAYOUT
/begin RECORD_LAYOUT __SBYTE_Z FNC_VALUES 1 SBYTE ROW_DIR DIRECT /end RECORD_LAYOUT
/begin RECORD_LAYOUT __SLONG_S FNC_VALUES 1 SLONG COLUMN_DIR DIRECT /end RECORD_LAYOUT
/begin RECORD_LAYOUT __SLONG_Z FNC_VALUES 1 SLONG ROW_DIR DIRECT /end RECORD_LAYOUT
/begin RECORD_LAYOUT __SWORD_S FNC_VALUES 1 SWORD COLUMN_DIR DIRECT /end RECORD_LAYOUT
/begin RECORD_LAYOUT __SWORD_Z FNC_VALUES 1 SWORD ROW_DIR DIRECT /end RECORD_LAYOUT
/begin RECORD_LAYOUT __UBYTE_S FNC_VALUES 1 UBYTE COLUMN_DIR DIRECT /end RECORD_LAYOUT
/begin RECORD_LAYOUT __UBYTE_Z FNC_VALUES 1 UBYTE ROW_DIR DIRECT /end RECORD_LAYOUT
/begin RECORD_LAYOUT __ULONG_S FNC_VALUES 1 ULONG COLUMN_DIR DIRECT /end RECORD_LAYOUT
/begin RECORD_LAYOUT __ULONG_Z FNC_VALUES 1 ULONG ROW_DIR DIRECT /end RECORD_LAYOUT
/begin RECORD_LAYOUT __UWORD_S FNC_VALUES 1 UWORD COLUMN_DIR DIRECT /end RECORD_LAYOUT
/begin RECORD_LAYOUT __UWORD_Z FNC_VALUES 1 UWORD ROW_DIR DIRECT /end RECORD_LAYOUT
/end MODULE
/end PROJECT
