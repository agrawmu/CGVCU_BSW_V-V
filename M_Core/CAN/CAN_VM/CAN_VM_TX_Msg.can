/*@!Encoding:1252*/
includes
{
  
}

variables
{
  dword gCyccheckId;                                                   // Variable to store the cycle check ID  
  long Cycle_time = 0;                                                 // Variables to store the cycle time
  char Polarian_ID[15];                                                // Array to store the Polarion test case ID                                            
  long kTIMEOUT = 0;                                                   // General timeout value
  const long WAIT_TIMEOUT = 11000;
  byte DLC_Value = 0;                                                  // Variable to store the Data Length Code (DLC)
  byte flag = 0;                                                       // Flag for status tracking
  
  // Declared the message names and corresponding message objects
  message mAVASCmd Msg_0x301;
  message mBrkCtrl Msg_0x74;
  message mHmiPadStat Msg_0x510;
  message mHVESSC1 Msg_0xC1BF3F9;
  message mHVESSC1_BMS2 Msg_0xC1BA6F9;
  message mSbwCtrl Msg_0x29A;
  message mSbwCtrl_Allied Msg_0x29B;
  message mVcuEcuStat Msg_0x660;
  message mVcuFaults Msg_0x204;
  message mVcuGitSHA Msg_0x1CFFCACC;
  message mVcuGyroAngle Msg_0x20D;
  message mVcuImuAngVel Msg_0x206;
  message mVcuImuAngVel_Filt Msg_0x20C;
  message mVcuImuLinAccel Msg_0x205;
  message mVcuImuLinAccel_Filt Msg_0x20B;
  message mVcuSwVer Msg_0x1CFFCCCC;
  message mVcuSys Msg_0x302;
  message mVcuVehID Msg_0x1CFFBACC;
  message mVehState Msg_0x202;
  message mVehState2 Msg_0x208;
  message mVehState3 Msg_0x209;
  message mWhdCtrl Msg_0x12;
  message mWhdCtrl2 Msg_0x13;
  message VcuTask1msStat Msg_0x666;
  message VehDiagPort Msg_0x661;
  
  // Variables of mAVASCmd 0x301 Message: 100 ms  
  const long kMIN_Cycle_Time_mAVASCmd_0x301 = 90;
  const long kMAX_Cycle_Time_mAVASCmd_0x301 = 110;
  
  // Variables of mBrkCtrl 0x74 Message: 6 ms  
  const long kMIN_Cycle_Time_mBrkCtrl_0x74 = 5;
  const long kMAX_Cycle_Time_mBrkCtrl_0x74 = 7;
  
  // Variables of mHmiPadStat 0x510 Message: 20 ms  
  const long kMIN_Cycle_Time_mHmiPadStat_0x510 = 18;
  const long kMAX_Cycle_Time_mHmiPadStat_0x510 = 22;

  // Variables of mHVESSC1 0xC1BF3F9 Message: 20 ms  
  const long kMIN_Cycle_Time_mHVESSC1_0xC1BF3F9 = 18;
  const long kMAX_Cycle_Time_mHVESSC1_0xC1BF3F9 = 22;
  
  // Variables of mHVESSC1_BMS2 0xC1BA6F9 Message: 20 ms  
  const long kMIN_Cycle_Time_mHVESSC1_BMS2_0xC1BA6F9 = 18;
  const long kMAX_Cycle_Time_mHVESSC1_BMS2_0xC1BA6F9 = 22;
  
  // Variables of mSbwCtrl 0x29A Message: 20 ms  
  const long kMIN_Cycle_Time_mSbwCtrl_0x29A = 18;
  const long kMAX_Cycle_Time_mSbwCtrl_0x29A = 22;
  
  // Variables of mSbwCtrl_Allied 0x29B Message: 10 ms  
  const long kMIN_Cycle_Time_mSbwCtrl_Allied_0x29B = 9;
  const long kMAX_Cycle_Time_mSbwCtrl_Allied_0x29B = 11;
  
  // Variables of mVcuEcuStat 0x660 Message: 100 ms  
  const long kMIN_Cycle_Time_mVcuEcuStat_0x660 = 90;
  const long kMAX_Cycle_Time_mVcuEcuStat_0x660 = 110;
  
  // Variables of mVcuFaults 0x204 Message: 100 ms  
  const long kMIN_Cycle_Time_mVcuFaults_0x204 = 90;
  const long kMAX_Cycle_Time_mVcuFaults_0x204 = 110;
  
  // Variables of mVcuGitSHA 0x1CFFCACC Message: 10000 ms  
  const long kMIN_Cycle_Time_mVcuGitSHA_0x1CFFCACC = 9000;
  const long kMAX_Cycle_Time_mVcuGitSHA_0x1CFFCACC = 11000;
  
  // Variables of mVcuGyroAngle 0x20D Message: 20 ms  
  const long kMIN_Cycle_Time_mVcuGyroAngle_0x20D = 18;
  const long kMAX_Cycle_Time_mVcuGyroAngle_0x20D = 22;
  
  // Variables of mVcuImuAngVel 0x206 Message: 10 ms  
  const long kMIN_Cycle_Time_mVcuImuAngVel_0x206 = 9;
  const long kMAX_Cycle_Time_mVcuImuAngVel_0x206 = 11;
  
  // Variables of mVcuImuAngVel_Filt 0x20C Message: 100 ms  
  const long kMIN_Cycle_Time_mVcuImuAngVel_Filt_0x20C = 90;
  const long kMAX_Cycle_Time_mVcuImuAngVel_Filt_0x20C = 110;
  
  // Variables of mVcuImuLinAccel 0x205 Message: 10 ms  
  const long kMIN_Cycle_Time_mVcuImuLinAccel_0x205 = 9;
  const long kMAX_Cycle_Time_mVcuImuLinAccel_0x205 = 11;
  
  // Variables of mVcuImuLinAccel_Filt 0x20B Message: 100 ms  
  const long kMIN_Cycle_Time_mVcuImuLinAccel_Filt_0x20B = 90;
  const long kMAX_Cycle_Time_mVcuImuLinAccel_Filt_0x20B = 110;
  
  // Variables of mVcuSwVer 0x1CFFCCCC Message: 10000 ms  
  const long kMIN_Cycle_Time_mVcuSwVer_0x1CFFCCCC = 9000;
  const long kMAX_Cycle_Time_mVcuSwVer_0x1CFFCCCC = 11000;
  
   // Variables of mVcuSys 0x302 Message: 50 ms  
  const long kMIN_Cycle_Time_mVcuSys_0x302 = 45;
  const long kMAX_Cycle_Time_mVcuSys_0x302 = 55;
  
   // Variables of mVcuVehID 0x1CFFBACC Message: 10000 ms  
  const long kMIN_Cycle_Time_mVcuVehID_0x1CFFBACC = 9000;
  const long kMAX_Cycle_Time_mVcuVehID_0x1CFFBACC = 11000;
  
   // Variables of mVehState 0x202 Message: 50 ms  
  const long kMIN_Cycle_Time_mVehState_0x202 = 45;
  const long kMAX_Cycle_Time_mVehState_0x202 = 55;
  
  // Variables of mVehState2 0x208 Message: 20 ms  
  const long kMIN_Cycle_Time_mVehState2_0x208 = 18;
  const long kMAX_Cycle_Time_mVehState2_0x208 = 22;
  
  // Variables of mVehState3 0x209 Message: 50 ms  
  const long kMIN_Cycle_Time_mVehState3_0x209 = 45;
  const long kMAX_Cycle_Time_mVehState3_0x209 = 55;
  
  // Variables of mWhdCtrl 0x12 Message: 10 ms  
  const long kMIN_Cycle_Time_mWhdCtrl_0x12 = 9;
  const long kMAX_Cycle_Time_mWhdCtrl_0x12 = 11;
  
  // Variables of mWhdCtrl2 0x13 Message: 100 ms  
  const long kMIN_Cycle_Time_mWhdCtrl2_0x13 = 90;
  const long kMAX_Cycle_Time_mWhdCtrl2_0x13 = 110;
  
  // Variables of VcuTask1msStat 0x666 Message: 10 ms  
  const long kMIN_Cycle_Time_VcuTask1msStat_0x666 = 9;
  const long kMAX_Cycle_Time_VcuTask1msStat_0x666 = 11;

  // Variables of VehDiagPort 0x661 Message: 10 ms  
  const long kMIN_Cycle_Time_VehDiagPort_0x661 = 9;
  const long kMAX_Cycle_Time_VehDiagPort_0x661 = 11;
   
}

void Maintest()
{
  char time_buf[100];
  testReportFileName("CAN_VM_v3.7.1_REPORT");                               // Set the report file name for logging the test results
  testModuleTitle("CAN_VM_TX_DBC");                                         // Set the title of the test module
  TestModuleDescription("Test Author: Chaithra C\n"); 
  getLocalTimeString(time_buf);  
  TestModuleDescription("Test Execution Date: ");
  TestModuleDescription(time_buf);
  testModuleDescription("\n\nDescription:Test cases to check the initial values, DLC and cycle time of the Tx CAN signals"); // Provide a brief description of the test module's purpose
  @TestAutomation::TestDone = 0;
//  Execute individual test cases sequentially for initial values, DLC and cycle time
  Tx_Msg_Sig_Init_mAVASCmd_0x301();
  Tx_Msg_DLC_mAVASCmd_0x301();
  Tx_Msg_Periodicity_mAVASCmd_0x301();
  
  Tx_Msg_Sig_Init_mBrkCtrl_0x74();
  Tx_Msg_DLC_mBrkCtrl_0x74();
  Tx_Msg_Periodicity_mBrkCtrl_0x74();
  
  Tx_Msg_Sig_Init_mHmiPadStat_0x510();
  Tx_Msg_DLC_mHmiPadStat_0x510();
  Tx_Msg_Periodicity_mHmiPadStat_0x510();
  
  Tx_Msg_Sig_Init_mHVESSC1_0xC1BF3F9();
  Tx_Msg_DLC_mHVESSC1_0xC1BF3F9();
  Tx_Msg_Periodicity_mHVESSC1_0xC1BF3F9();
 
  Tx_Msg_Sig_Init_mHVESSC1_BMS2_0xC1BA6F9();
  Tx_Msg_DLC_mHVESSC1_BMS2_0xC1BA6F9();
  Tx_Msg_Periodicity_mHVESSC1_BMS2_0xC1BA6F9(); 
  
  Tx_Msg_Sig_Init_mSbwCtrl_0x29A();
  Tx_Msg_DLC_mSbwCtrl_0x29A();
  Tx_Msg_Periodicity_mSbwCtrl_0x29A();
  
  Tx_Msg_Sig_Init_mSbwCtrl_Allied_0x29B();
  Tx_Msg_DLC_mSbwCtrl_Allied_0x29B();
  Tx_Msg_Periodicity_mSbwCtrl_Allied_0x29B();
  
  Tx_Msg_Sig_Init_mVcuEcuStat_0x660();
  Tx_Msg_DLC_mVcuEcuStat_0x660();
  Tx_Msg_Periodicity_mVcuEcuStat_0x660();
  
  Tx_Msg_Sig_Init_mVcuFaults_0x204();
  Tx_Msg_DLC_mVcuFaults_0x204();
  Tx_Msg_Periodicity_mVcuFaults_0x204();
  
  Tx_Msg_Sig_Init_mVcuGitSHA_0x1CFFCACC();
  Tx_Msg_DLC_mVcuGitSHA_0x1CFFCACC();
  Tx_Msg_Periodicity_mVcuGitSHA_0x1CFFCACC();
  
  Tx_Msg_Sig_Init_mVcuGyroAngle_0x20D();
  Tx_Msg_DLC_mVcuGyroAngle_0x20D();
  Tx_Msg_Periodicity_mVcuGyroAngle_0x20D();
  
  Tx_Msg_Sig_Init_mVcuImuAngVel_0x206();
  Tx_Msg_DLC_mVcuImuAngVel_0x206();
  Tx_Msg_Periodicity_mVcuImuAngVel_0x206();
  
  Tx_Msg_Sig_Init_mVcuImuAngVel_Filt_0x20C();
  Tx_Msg_DLC_mVcuImuAngVel_Filt_0x20C();
  Tx_Msg_Periodicity_mVcuImuAngVel_Filt_0x20C();
  
  Tx_Msg_Sig_Init_mVcuImuLinAccel_0x205();
  Tx_Msg_DLC_mVcuImuLinAccel_0x205();
  Tx_Msg_Periodicity_mVcuImuLinAccel_0x205();
  
  Tx_Msg_Sig_Init_mVcuImuLinAccel_Filt_0x20B();
  Tx_Msg_DLC_mVcuImuLinAccel_Filt_0x20B();
  Tx_Msg_Periodicity_mVcuImuLinAccel_Filt_0x20B();
  
  Tx_Msg_Sig_Init_mVcuSwVer_0x1CFFCCCC();
  Tx_Msg_DLC_mVcuSwVer_0x1CFFCCCC();
  Tx_Msg_Periodicity_mVcuSwVer_0x1CFFCCCC();
  
  Tx_Msg_Sig_Init_mVcuSys_0x302();
  Tx_Msg_DLC_mVcuSys_0x302();
  Tx_Msg_Periodicity_mVcuSys_0x302();
  
  Tx_Msg_Sig_Init_mVcuVehID_0x1CFFBACC();
  Tx_Msg_DLC_mVcuVehID_0x1CFFBACC();
  Tx_Msg_Periodicity_mVcuVehID_0x1CFFBACC();
  
  Tx_Msg_Sig_Init_mVehState_0x202();
  Tx_Msg_DLC_mVehState_0x202();
  Tx_Msg_Periodicity_mVehState_0x202();
  
  Tx_Msg_Sig_Init_mVehState2_0x208();
  Tx_Msg_DLC_mVehState2_0x208();
  Tx_Msg_Periodicity_mVehState2_0x208();
  
  Tx_Msg_Sig_Init_mVehState3_0x209();
  Tx_Msg_DLC_mVehState3_0x209();
  Tx_Msg_Periodicity_mVehState3_0x209();
  
  Tx_Msg_Sig_Init_mWhdCtrl_0x12();
  Tx_Msg_DLC_mWhdCtrl_0x12();
  Tx_Msg_Periodicity_mWhdCtrl_0x12();
  
  Tx_Msg_Sig_Init_mWhdCtrl2_0x13();
  Tx_Msg_DLC_mWhdCtrl2_0x13();
  Tx_Msg_Periodicity_mWhdCtrl2_0x13();
  
  Tx_Msg_Sig_Init_VcuTask1msStat_0x666();
  Tx_Msg_DLC_VcuTask1msStat_0x666();
  Tx_Msg_Periodicity_VcuTask1msStat_0x666();
  
  Tx_Msg_Sig_Init_VehDiagPort_0x661();
  Tx_Msg_DLC_VehDiagPort_0x661();
  Tx_Msg_Periodicity_VehDiagPort_0x661();
  @TestAutomation::TestDone = 1;
}

// Check initial values of individual signals within the message
testcase Tx_Msg_Sig_Init_mAVASCmd_0x301()
{
  char Description[100] = "To check the initial values of signals in the [mAVASCmd_0x301] message ";
  flag = 1;
  snprintf(Polarian_ID, elCount(Polarian_ID), "CGMN-14914");
  TestCaseTitle(Polarian_ID,"Tx_Msg_Sig_Init_mAVASCmd_0x301" );
  TestCaseDescription(Description);
  signalintialvaluecheck(mAVASCmd,AVAS_TestMode,0,"AVAS_TestMode");
  signalintialvaluecheck(mAVASCmd,GearRq_AVAS,0,"GearRq_AVAS");
  signalintialvaluecheck(mAVASCmd,MsgCntr,0,"MsgCntr");
  signalintialvaluecheck(mAVASCmd,MsgCrc,0,"MsgCrc");
  signalintialvaluecheck(mAVASCmd,VehSpdAVAS,0,"VehSpdAVAS");
 }

//Check Data Lengh Code of the message
testcase Tx_Msg_DLC_mAVASCmd_0x301() 
{
  char Description[100] = "To check the Data Length Code of the [mAVASCmd_0x301] message ";
  snprintf(Polarian_ID, elCount(Polarian_ID), "CGMN-14913");
  TestCaseTitle(Polarian_ID,"Tx_Msg_DLC_mAVASCmd_0x301");
  TestCaseDescription(Description);
  DLC_Value = 8;
  Check_DLC(mAVASCmd, Msg_0x301);
}

//Check the Periodicity of the message
testcase Tx_Msg_Periodicity_mAVASCmd_0x301()
{
  char Description[100] = "To check the Periodicity of the [mAVASCmd_0x301] message ";
  float CycMinCycleTime, CycMaxCycleTime;
  Cycle_time = 100; 
  kTIMEOUT = 1000; 
  CycMinCycleTime = kMIN_Cycle_Time_mAVASCmd_0x301;
  CycMaxCycleTime = kMAX_Cycle_Time_mAVASCmd_0x301;
  snprintf(Polarian_ID, elCount(Polarian_ID), "CGMN-14912");
  TestCaseTitle(Polarian_ID,"Tx_Msg_Periodicity_mAVASCmd_0x301");
  TestCaseDescription(Description);
  gCyccheckId = ChkStart_MsgAbsCycleTimeViolation(mAVASCmd, CycMinCycleTime, CycMaxCycleTime);
  CheckMsg(mAVASCmd,CycMinCycleTime, CycMaxCycleTime);  
}

// Check initial values of individual signals within the message
testcase Tx_Msg_Sig_Init_mBrkCtrl_0x74()
{
  char Description[100] = "To check the initial values of signals in the [mBrkCtrl_0x74] message ";
  flag = 1;
  snprintf(Polarian_ID, elCount(Polarian_ID), "CGMN-14917");
  TestCaseTitle(Polarian_ID,"Tx_Msg_Sig_Init_mBrkCtrl_0x74" );
  TestCaseDescription(Description);
  signalintialvaluecheck(mBrkCtrl,BrkEnbl_EBCM1U,0,"BrkEnbl_EBCM1U");
  signalintialvaluecheck(mBrkCtrl,BrkEnbl_EBCM2L,0,"BrkEnbl_EBCM2L");
  signalintialvaluecheck(mBrkCtrl,BrkTrqRq,0,"BrkTrqRq");
  signalintialvaluecheck(mBrkCtrl,ClearFltRq,0,"ClearFltRq");
  signalintialvaluecheck(mBrkCtrl,DsblTCS,0,"DsblTCS");
  signalintialvaluecheck(mBrkCtrl,EbcmMaintModeRq,0,"EbcmMaintModeRq");
  signalintialvaluecheck(mBrkCtrl,EbcmShtdwnRq,0,"EbcmShtdwnRq");
  signalintialvaluecheck(mBrkCtrl,EpbCalCmd,0,"EpbCalCmd");
  signalintialvaluecheck(mBrkCtrl,EPBCmd,0,"EPBCmd");
  signalintialvaluecheck(mBrkCtrl,HoldRq,0,"HoldRq");
  signalintialvaluecheck(mBrkCtrl,MsgCntr,0,"MsgCntr");
  signalintialvaluecheck(mBrkCtrl,MsgCrc,0,"MsgCrc");
  signalintialvaluecheck(mBrkCtrl,RegBrkAvail,0,"RegBrkAvail");
  
 }

//Check Data Lengh Code of the message
testcase Tx_Msg_DLC_mBrkCtrl_0x74() 
{
  char Description[100] = "To check the Data Length Code of the [mBrkCtrl_0x74] message ";
  snprintf(Polarian_ID, elCount(Polarian_ID), "CGMN-14916");
  TestCaseTitle(Polarian_ID,"Tx_Msg_DLC_mBrkCtrl_0x74");
  TestCaseDescription(Description);
  DLC_Value = 8;
  Check_DLC(mBrkCtrl, Msg_0x74);
}

//Check the Periodicity of the message
testcase Tx_Msg_Periodicity_mBrkCtrl_0x74()
{
	char Description[100] = "To check the Periodicity of the [mBrkCtrl_0x74] message ";
  float CycMinCycleTime, CycMaxCycleTime;
  Cycle_time = 6; 
  kTIMEOUT = 60; 
  CycMinCycleTime = kMIN_Cycle_Time_mBrkCtrl_0x74;
  CycMaxCycleTime = kMAX_Cycle_Time_mBrkCtrl_0x74;
  snprintf(Polarian_ID, elCount(Polarian_ID), "CGMN-14915");
  TestCaseTitle(Polarian_ID,"Tx_Msg_Periodicity_mBrkCtrl_0x74");
  TestCaseDescription(Description);
  gCyccheckId = ChkStart_MsgAbsCycleTimeViolation(mBrkCtrl,CycMinCycleTime, CycMaxCycleTime);
  CheckMsg(mBrkCtrl,CycMinCycleTime, CycMaxCycleTime);  
}

// Check initial values of individual signals within the message
testcase Tx_Msg_Sig_Init_mHmiPadStat_0x510()
{
  char Description[100] = "To check the initial values of signals in the [mHmiPadStat_0x510] message ";
  flag = 1;
  snprintf(Polarian_ID, elCount(Polarian_ID), "CGMN-14923");
  TestCaseTitle(Polarian_ID,"Tx_Msg_Sig_Init_mHmiPadStat_0x510" );
  TestCaseDescription(Description);
  signalintialvaluecheck(mHmiPadStat,AudioMp3,0,"AudioMp3");
  signalintialvaluecheck(mHmiPadStat,AudioVoice,0,"AudioVoice");
  signalintialvaluecheck(mHmiPadStat,Keypad1,0,"Keypad1");
  signalintialvaluecheck(mHmiPadStat,Keypad2,0,"Keypad2");
  signalintialvaluecheck(mHmiPadStat,Keypad3,0,"Keypad3");
  signalintialvaluecheck(mHmiPadStat,Keypad4,0,"Keypad4");
  signalintialvaluecheck(mHmiPadStat,KeypadC,0,"KeypadC");
  signalintialvaluecheck(mHmiPadStat,KeypadO,0,"KeypadO");
  signalintialvaluecheck(mHmiPadStat,PadActive,0,"PadActive");
  signalintialvaluecheck(mHmiPadStat,PadCodeState,0,"PadCodeState");
  signalintialvaluecheck(mHmiPadStat,PadLight,0,"PadLight");
  signalintialvaluecheck(mHmiPadStat,VolMp3,0,"VolMp3");
  signalintialvaluecheck(mHmiPadStat,VolVoice,0,"VolVoice");
 }

//Check Data Lengh Code of the message
testcase Tx_Msg_DLC_mHmiPadStat_0x510() 
{
  char Description[100] = "To check the Data Length Code of the [mHmiPadStat_0x510] message ";
  snprintf(Polarian_ID, elCount(Polarian_ID), "CGMN-14922");
  TestCaseTitle(Polarian_ID,"Tx_Msg_DLC_mHmiPadStat_0x510");
  TestCaseDescription(Description);
  DLC_Value = 8;
  Check_DLC(mHmiPadStat, Msg_0x510);
}

//Check the Periodicity of the message
testcase Tx_Msg_Periodicity_mHmiPadStat_0x510()
{
  char Description[100] = "To check the Periodicity of the [mHmiPadStat_0x510] message ";
  float CycMinCycleTime, CycMaxCycleTime;
  Cycle_time = 20; 
  kTIMEOUT = 200; 
  CycMinCycleTime = kMIN_Cycle_Time_mHmiPadStat_0x510;
  CycMaxCycleTime = kMAX_Cycle_Time_mHmiPadStat_0x510;
  snprintf(Polarian_ID, elCount(Polarian_ID), "CGMN-14921");
  TestCaseTitle(Polarian_ID,"Tx_Msg_Periodicity_mHmiPadStat_0x510");
  TestCaseDescription(Description);
  gCyccheckId = ChkStart_MsgAbsCycleTimeViolation(mHmiPadStat, CycMinCycleTime, CycMaxCycleTime);
  CheckMsg(mHmiPadStat,CycMinCycleTime, CycMaxCycleTime);  
}

// Check initial values of individual signals within the message
testcase Tx_Msg_Sig_Init_mHVESSC1_0xC1BF3F9()
{
  char Description[100] = "To check the initial values of signals in the [mHVESSC1_0xC1BF3F9] message ";
  flag = 1;
  snprintf(Polarian_ID, elCount(Polarian_ID), "CGMN-14926");
  TestCaseTitle(Polarian_ID,"Tx_Msg_Sig_Init_mHVESSC1_0xC1BF3F9" );
  TestCaseDescription(Description);
  signalintialvaluecheck(mHVESSC1,CellBalRq,0,"CellBalRq");
  signalintialvaluecheck(mHVESSC1,EnblConsent,0,"EnblConsent");
  signalintialvaluecheck(mHVESSC1,EnblIntChrgrRq,0,"EnblIntChrgrRq");
  signalintialvaluecheck(mHVESSC1,EnblRq,0,"EnblRq");
  signalintialvaluecheck(mHVESSC1,HvIsoActiveRq,0,"HvIsoActiveRq");
  signalintialvaluecheck(mHVESSC1,HvIsoPassiveRq,0,"HvIsoPassiveRq");
  signalintialvaluecheck(mHVESSC1,HvResistHighRq,0,"HvResistHighRq");
  signalintialvaluecheck(mHVESSC1,HvResistLowRq,0,"HvResistLowRq");
  signalintialvaluecheck(mHVESSC1,MsgCntr,0,"MsgCntr");
  signalintialvaluecheck(mHVESSC1,MsgCrc,0,"MsgCrc");
  signalintialvaluecheck(mHVESSC1,PwrDownCmd,0,"PwrDownCmd");
  signalintialvaluecheck(mHVESSC1,ThrmlMgmtRq,0,"ThrmlMgmtRq");
  
 }

//Check Data Lengh Code of the message
testcase Tx_Msg_DLC_mHVESSC1_0xC1BF3F9() 
{
  char Description[100] = "To check the Data Length Code of the [mHVESSC1_0xC1BF3F9] message ";
  snprintf(Polarian_ID, elCount(Polarian_ID), "CGMN-14925");
  TestCaseTitle(Polarian_ID,"Tx_Msg_DLC_mHVESSC1_0xC1BF3F9");
  TestCaseDescription(Description);
  DLC_Value = 8;
  Check_DLC(mHVESSC1, Msg_0xC1BF3F9);
}

//Check the Periodicity of the message
testcase Tx_Msg_Periodicity_mHVESSC1_0xC1BF3F9()
{
	char Description[100] = "To check the Periodicity of the [mHVESSC1_0xC1BF3F9] message ";
  float CycMinCycleTime, CycMaxCycleTime;
  Cycle_time = 20; 
  kTIMEOUT = 200; 
  CycMinCycleTime = kMIN_Cycle_Time_mHVESSC1_0xC1BF3F9;
  CycMaxCycleTime = kMAX_Cycle_Time_mHVESSC1_0xC1BF3F9;
  snprintf(Polarian_ID, elCount(Polarian_ID), "CGMN-14924");
  TestCaseTitle(Polarian_ID,"Tx_Msg_Periodicity_mHVESSC1_0xC1BF3F9");
  TestCaseDescription(Description);
  gCyccheckId = ChkStart_MsgAbsCycleTimeViolation(mHVESSC1, CycMinCycleTime, CycMaxCycleTime);
  CheckMsg(mHVESSC1,CycMinCycleTime, CycMaxCycleTime);  
}

// Check initial values of individual signals within the message
testcase Tx_Msg_Sig_Init_mHVESSC1_BMS2_0xC1BA6F9()
{
  char Description[100] = "To check the initial values of signals in the [mHVESSC1_BMS2_0xC1BA6F9] message ";
  flag = 1;
  snprintf(Polarian_ID, elCount(Polarian_ID), "CGMN-29578");
  TestCaseTitle(Polarian_ID,"Tx_Msg_Sig_Init_mHVESSC1_BMS2_0xC1BA6F9" );
  TestCaseDescription(Description);
  signalintialvaluecheck(mHVESSC1_BMS2,CellBalRq,0,"CellBalRq");
  signalintialvaluecheck(mHVESSC1_BMS2,EnblConsent,0,"EnblConsent");
  signalintialvaluecheck(mHVESSC1_BMS2,EnblIntChrgrRq,0,"EnblIntChrgrRq");
  signalintialvaluecheck(mHVESSC1_BMS2,EnblRq,0,"EnblRq");
  signalintialvaluecheck(mHVESSC1_BMS2,HvIsoActiveRq,0,"HvIsoActiveRq");
  signalintialvaluecheck(mHVESSC1_BMS2,HvIsoPassiveRq,0,"HvIsoPassiveRq");
  signalintialvaluecheck(mHVESSC1_BMS2,HvResistHighRq,0,"HvResistHighRq");
  signalintialvaluecheck(mHVESSC1_BMS2,HvResistLowRq,0,"HvResistLowRq");
  signalintialvaluecheck(mHVESSC1_BMS2,MsgCntr,0,"MsgCntr");
  signalintialvaluecheck(mHVESSC1_BMS2,MsgCrc,0,"MsgCrc");
  signalintialvaluecheck(mHVESSC1_BMS2,PwrDownCmd,0,"PwrDownCmd");
  signalintialvaluecheck(mHVESSC1_BMS2,ThrmlMgmtRq,0,"ThrmlMgmtRq");
  
}

//Check Data Lengh Code of the message
testcase Tx_Msg_DLC_mHVESSC1_BMS2_0xC1BA6F9() 
{
  char Description[100] = "To check the Data Length Code of the [mHVESSC1_BMS2_0xC1BA6F9] message ";
  snprintf(Polarian_ID, elCount(Polarian_ID), "CGMN-29577");
  TestCaseTitle(Polarian_ID,"Tx_Msg_DLC_mHVESSC1_BMS2_0xC1BA6F9");
  TestCaseDescription(Description);
  DLC_Value = 8;
  Check_DLC(mHVESSC1_BMS2, Msg_0xC1BA6F9);
}

//Check the Periodicity of the message
testcase Tx_Msg_Periodicity_mHVESSC1_BMS2_0xC1BA6F9()
{
  char Description[100] = "To check the Periodicity of the [mHVESSC1_BMS2_0xC1BA6F9] message ";
  float CycMinCycleTime, CycMaxCycleTime;
  Cycle_time = 20; 
  kTIMEOUT = 200; 
  CycMinCycleTime = kMIN_Cycle_Time_mHVESSC1_BMS2_0xC1BA6F9;
  CycMaxCycleTime = kMAX_Cycle_Time_mHVESSC1_BMS2_0xC1BA6F9;
  snprintf(Polarian_ID, elCount(Polarian_ID), "CGMN-29576");
  TestCaseTitle(Polarian_ID,"Tx_Msg_Periodicity_mHVESSC1_BMS2_0xC1BA6F9");
  TestCaseDescription(Description);
  gCyccheckId = ChkStart_MsgAbsCycleTimeViolation(mHVESSC1_BMS2, CycMinCycleTime, CycMaxCycleTime);
  CheckMsg(mHVESSC1_BMS2,CycMinCycleTime, CycMaxCycleTime);  
}

// Check initial values of individual signals within the message
testcase Tx_Msg_Sig_Init_mSbwCtrl_0x29A()
{
  char Description[100] = "To check the initial values of signals in the [mSbwCtrl_0x29A] message ";
  flag = 1;
  snprintf(Polarian_ID, elCount(Polarian_ID), "CGMN-14927");
  TestCaseTitle(Polarian_ID,"Tx_Msg_Sig_Init_mSbwCtrl_0x29A" );
  TestCaseDescription(Description);
  signalintialvaluecheck(mSbwCtrl,AngleCmd,0,"AngleCmd");
  signalintialvaluecheck(mSbwCtrl,CtrlMode,0,"CtrlMode");
  signalintialvaluecheck(mSbwCtrl,MsgCntr,0,"MsgCntr");
  signalintialvaluecheck(mSbwCtrl,MsgCrc,0,"MsgCrc");
  signalintialvaluecheck(mSbwCtrl,MtrDcCmd,0,"MtrDcCmd");
 }

//Check Data Lengh Code of the message
testcase Tx_Msg_DLC_mSbwCtrl_0x29A() 
{
  char Description[100] = "To check the Data Length Code of the [mSbwCtrl_0x29A] message ";
  snprintf(Polarian_ID, elCount(Polarian_ID), "CGMN-14928");
  TestCaseTitle(Polarian_ID,"Tx_Msg_DLC_mSbwCtrl_0x29A");
  TestCaseDescription(Description);
  DLC_Value = 8;
  Check_DLC(mSbwCtrl, Msg_0x29A);
}

//Check the Periodicity of the message
testcase Tx_Msg_Periodicity_mSbwCtrl_0x29A()
{
  char Description[100] = "To check the Periodicity of the [mSbwCtrl_0x29A] message ";
  float CycMinCycleTime, CycMaxCycleTime;
  Cycle_time = 20; 
  kTIMEOUT = 200; 
  CycMinCycleTime = kMIN_Cycle_Time_mSbwCtrl_0x29A;
  CycMaxCycleTime = kMAX_Cycle_Time_mSbwCtrl_0x29A;
  snprintf(Polarian_ID, elCount(Polarian_ID), "CGMN-14929");
  TestCaseTitle(Polarian_ID,"Tx_Msg_Periodicity_mSbwCtrl_0x29A");
  TestCaseDescription(Description);
  gCyccheckId = ChkStart_MsgAbsCycleTimeViolation(mSbwCtrl, CycMinCycleTime, CycMaxCycleTime);
  CheckMsg(mSbwCtrl,CycMinCycleTime, CycMaxCycleTime);  
}

// Check initial values of individual signals within the message
testcase Tx_Msg_Sig_Init_mSbwCtrl_Allied_0x29B()
{
  char Description[100] = "To check the initial values of signals in the [mSbwCtrl_Allied_0x29B] message ";
  flag = 1;
  snprintf(Polarian_ID, elCount(Polarian_ID), "CGMN-29583");
  TestCaseTitle(Polarian_ID,"Tx_Msg_Sig_Init_mSbwCtrl_Allied_0x29B" );
  TestCaseDescription(Description);
  signalintialvaluecheck(mSbwCtrl_Allied,ClearFaults,0,"ClearFaults");
  signalintialvaluecheck(mSbwCtrl_Allied,CommandMode,0,"CommandMode");
  signalintialvaluecheck(mSbwCtrl_Allied,CommandVariable1,0,"CommandVariable1");
  signalintialvaluecheck(mSbwCtrl_Allied,CommandVariable2,0,"CommandVariable2");
  signalintialvaluecheck(mSbwCtrl_Allied,EstopReq,0,"EstopReq");
  signalintialvaluecheck(mSbwCtrl_Allied,MsgCntr,0,"MsgCntr");
  signalintialvaluecheck(mSbwCtrl_Allied,MsgCrc,0,"MsgCrc");
  
 }

//Check Data Lengh Code of the message
testcase Tx_Msg_DLC_mSbwCtrl_Allied_0x29B() 
{
  char Description[100] = "To check the Data Length Code of the [mSbwCtrl_Allied_0x29B] message ";
  snprintf(Polarian_ID, elCount(Polarian_ID), "CGMN-29580");
  TestCaseTitle(Polarian_ID,"Tx_Msg_DLC_mSbwCtrl_Allied_0x29B");
  TestCaseDescription(Description);
  DLC_Value = 8;
  Check_DLC(mSbwCtrl_Allied, Msg_0x29B);
}

//Check the Periodicity of the message
testcase Tx_Msg_Periodicity_mSbwCtrl_Allied_0x29B()
{
  char Description[100] = "To check the Periodicity of the [mSbwCtrl_Allied_0x29B] message ";
  float CycMinCycleTime, CycMaxCycleTime;
  Cycle_time = 10; 
  kTIMEOUT = 100; 
  CycMinCycleTime = kMIN_Cycle_Time_mSbwCtrl_Allied_0x29B;
  CycMaxCycleTime = kMAX_Cycle_Time_mSbwCtrl_Allied_0x29B;
  snprintf(Polarian_ID, elCount(Polarian_ID), "CGMN-29579");
  TestCaseTitle(Polarian_ID,"Tx_Msg_Periodicity_mSbwCtrl_Allied_0x29B");
  TestCaseDescription(Description);
  gCyccheckId = ChkStart_MsgAbsCycleTimeViolation(mSbwCtrl_Allied, CycMinCycleTime, CycMaxCycleTime);
  CheckMsg(mSbwCtrl_Allied,CycMinCycleTime, CycMaxCycleTime);  
}

// Check initial values of individual signals within the message
testcase Tx_Msg_Sig_Init_mVcuEcuStat_0x660()
{
  char Description[100] = "To check the initial values of signals in the [mVcuEcuStat_0x660] message ";
  flag = 1;
  snprintf(Polarian_ID, elCount(Polarian_ID), "CGMN-14932");
  TestCaseTitle(Polarian_ID,"Tx_Msg_Sig_Init_mVcuEcuStat_0x660" );
  TestCaseDescription(Description);
  signalintialvaluecheck(mVcuEcuStat,CanChk,0,"CanChk");
  signalintialvaluecheck(mVcuEcuStat,DrvpOk,0,"DrvpOk");
  signalintialvaluecheck(mVcuEcuStat,EcuModingStat,0,"EcuModingStat");
  signalintialvaluecheck(mVcuEcuStat,EcuWakeSource,0,"EcuWakeSource");
  signalintialvaluecheck(mVcuEcuStat,EthChk,0,"EthChk");
  signalintialvaluecheck(mVcuEcuStat,FlashChk,0,"FlashChk");
  signalintialvaluecheck(mVcuEcuStat,Hso16Status,0,"Hso16Status");
  signalintialvaluecheck(mVcuEcuStat,Hso16WakeHoldOutCmd,0,"Hso16WakeHoldOutCmd");
  signalintialvaluecheck(mVcuEcuStat,IdleTmr,0,"IdleTmr");
  signalintialvaluecheck(mVcuEcuStat,LinChk,0,"LinChk");
  signalintialvaluecheck(mVcuEcuStat,MomSwInRaw,0,"MomSwInRaw");
  signalintialvaluecheck(mVcuEcuStat,MomSwPress,0,"MomSwPress");
  signalintialvaluecheck(mVcuEcuStat,MprdEnCmd,0,"MprdEnCmd");
  signalintialvaluecheck(mVcuEcuStat,NvmOk,0,"NvmOk");
  signalintialvaluecheck(mVcuEcuStat,RaptorWakeSource,0,"RaptorWakeSource");
  signalintialvaluecheck(mVcuEcuStat,SnsrPwrOk,0,"SnsrPwrOk");
  signalintialvaluecheck(mVcuEcuStat,VcuLvOk,0,"VcuLvOk");
  signalintialvaluecheck(mVcuEcuStat,WakeHoldStat,0,"WakeHoldStat");
 }

//Check Data Lengh Code of the message
testcase Tx_Msg_DLC_mVcuEcuStat_0x660() 
{
  char Description[100] = "To check the Data Length Code of the [mVcuEcuStat_0x660] message ";
  snprintf(Polarian_ID, elCount(Polarian_ID), "CGMN-14931");
  TestCaseTitle(Polarian_ID,"Tx_Msg_DLC_mVcuEcuStat_0x660");
  TestCaseDescription(Description);
  DLC_Value = 8;
  Check_DLC(mVcuEcuStat, Msg_0x660);
}

//Check the Periodicity of the message
testcase Tx_Msg_Periodicity_mVcuEcuStat_0x660()
{
  char Description[100] = "To check the Periodicity of the [mVcuEcuStat_0x660] message ";
  float CycMinCycleTime, CycMaxCycleTime;
  Cycle_time = 100; 
  kTIMEOUT = 1000; 
  CycMinCycleTime = kMIN_Cycle_Time_mVcuEcuStat_0x660;
  CycMaxCycleTime = kMAX_Cycle_Time_mVcuEcuStat_0x660;
  snprintf(Polarian_ID, elCount(Polarian_ID), "CGMN-14930");
  TestCaseTitle(Polarian_ID,"Tx_Msg_Periodicity_mVcuEcuStat_0x660");
  TestCaseDescription(Description);
  gCyccheckId = ChkStart_MsgAbsCycleTimeViolation(mVcuEcuStat, CycMinCycleTime, CycMaxCycleTime);
  CheckMsg(mVcuEcuStat,CycMinCycleTime, CycMaxCycleTime);  
}

// Check initial values of individual signals within the message
testcase Tx_Msg_Sig_Init_mVcuFaults_0x204()
{
  char Description[100] = "To check the initial values of signals in the [mVcuFaults_0x204] message ";
  flag = 1;
  snprintf(Polarian_ID, elCount(Polarian_ID), "CGMN-14935");
  TestCaseTitle(Polarian_ID,"Tx_Msg_Sig_Init_mVcuFaults_0x204" );
  TestCaseDescription(Description);
  signalintialvaluecheck(mVcuFaults,Flt_12Volt,0,"Flt_12Volt");
  signalintialvaluecheck(mVcuFaults,Flt_12vSys,0,"Flt_12vSys");
  signalintialvaluecheck(mVcuFaults,Flt_48Volt,0,"Flt_48Volt");
  signalintialvaluecheck(mVcuFaults,Flt_Bay1BeltSns,0,"Flt_Bay1BeltSns");
  signalintialvaluecheck(mVcuFaults,Flt_Bay1Mtr,0,"Flt_Bay1Mtr");
  signalintialvaluecheck(mVcuFaults,Flt_Bay1MtrPos,0,"Flt_Bay1MtrPos");
  signalintialvaluecheck(mVcuFaults,Flt_Bay1Pwr12v,0,"Flt_Bay1Pwr12v");
  signalintialvaluecheck(mVcuFaults,Flt_Bay2BeltSns,0,"Flt_Bay2BeltSns");
  signalintialvaluecheck(mVcuFaults,Flt_Bay2Mtr,0,"Flt_Bay2Mtr");
  signalintialvaluecheck(mVcuFaults,Flt_Bay2MtrPos,0,"Flt_Bay2MtrPos");
  signalintialvaluecheck(mVcuFaults,Flt_Bay2Pwr12v,0,"Flt_Bay2Pwr12v");
  signalintialvaluecheck(mVcuFaults,Flt_BrkPrsr,0,"Flt_BrkPrsr");
  signalintialvaluecheck(mVcuFaults,Flt_BrkSafeSys,0,"Flt_BrkSafeSys");
  signalintialvaluecheck(mVcuFaults,Flt_CntctrStat,0,"Flt_CntctrStat");
  signalintialvaluecheck(mVcuFaults,Flt_DcdcEnbl,0,"Flt_DcdcEnbl");
  signalintialvaluecheck(mVcuFaults,Flt_EpbSys,0,"Flt_EpbSys");
  signalintialvaluecheck(mVcuFaults,Flt_ImuRst,0,"Flt_ImuRst");
  signalintialvaluecheck(mVcuFaults,Flt_ImuSns,0,"Flt_ImuSns");
  signalintialvaluecheck(mVcuFaults,Flt_InvalidGearRq,0,"Flt_InvalidGearRq");
  signalintialvaluecheck(mVcuFaults,Flt_Keypad4,0,"Flt_Keypad4");
  signalintialvaluecheck(mVcuFaults,Flt_KeypadC,0,"Flt_KeypadC");
  signalintialvaluecheck(mVcuFaults,Flt_KeypadLight,0,"Flt_KeypadLight");
  signalintialvaluecheck(mVcuFaults,Flt_LocAdcu,0,"Flt_LocAdcu");
  signalintialvaluecheck(mVcuFaults,Flt_LocAVAS,0,"Flt_LocAVAS");
  signalintialvaluecheck(mVcuFaults,Flt_LocBe,0,"Flt_LocBe");
  signalintialvaluecheck(mVcuFaults,Flt_LocEbcm1,0,"Flt_LocEbcm1");
  signalintialvaluecheck(mVcuFaults,Flt_LocEbcm2,0,"Flt_LocEbcm2");
  signalintialvaluecheck(mVcuFaults,Flt_LocEpb,0,"Flt_LocEpb");
  signalintialvaluecheck(mVcuFaults,Flt_LocEss,0,"Flt_LocEss");
  signalintialvaluecheck(mVcuFaults,Flt_LocFcmCan,0,"Flt_LocFcmCan");
  signalintialvaluecheck(mVcuFaults,Flt_LocLrr,0,"Flt_LocLrr");
  signalintialvaluecheck(mVcuFaults,Flt_LocSbw,0,"Flt_LocSbw");
  signalintialvaluecheck(mVcuFaults,Flt_LocTc,0,"Flt_LocTc");
  signalintialvaluecheck(mVcuFaults,Flt_LocTo,0,"Flt_LocTo");
  signalintialvaluecheck(mVcuFaults,Flt_LocVsc,0,"Flt_LocVsc");
  signalintialvaluecheck(mVcuFaults,Flt_LocWhd,0,"Flt_LocWhd");
  signalintialvaluecheck(mVcuFaults,Flt_MstrSwitch,0,"Flt_MstrSwitch");
  signalintialvaluecheck(mVcuFaults,Flt_ReadEeprom,0,"Flt_ReadEeprom");
  signalintialvaluecheck(mVcuFaults,Flt_SafeCircuit,0,"Flt_SafeCircuit");
  signalintialvaluecheck(mVcuFaults,Flt_SafeExtLight,0,"Flt_SafeExtLight");
  signalintialvaluecheck(mVcuFaults,Flt_SafeProp,0,"Flt_SafeProp");
  signalintialvaluecheck(mVcuFaults,Flt_SafeSteer,0,"Flt_SafeSteer");
  signalintialvaluecheck(mVcuFaults,Flt_SbwEnbl,0,"Flt_SbwEnbl");
  signalintialvaluecheck(mVcuFaults,Flt_WhdEnbl,0,"Flt_WhdEnbl");
  signalintialvaluecheck(mVcuFaults,Flt_WriteEeprom,0,"Flt_WriteEeprom"); 
 
 }

//Check Data Lengh Code of the message
testcase Tx_Msg_DLC_mVcuFaults_0x204() 
{
  char Description[100] = "To check the Data Length Code of the [mVcuFaults_0x204] message ";
  snprintf(Polarian_ID, elCount(Polarian_ID), "CGMN-14934");
  TestCaseTitle(Polarian_ID,"Tx_Msg_DLC_mVcuFaults_0x204");
  TestCaseDescription(Description);
  DLC_Value = 8;
  Check_DLC(mVcuFaults, Msg_0x204);
}

//Check the Periodicity of the message
testcase Tx_Msg_Periodicity_mVcuFaults_0x204()
{
  char Description[100] = "To check the Periodicity of the [mVcuFaults_0x204] message ";
  float CycMinCycleTime, CycMaxCycleTime;
  Cycle_time = 100; 
  kTIMEOUT = 1000; 
  CycMinCycleTime = kMIN_Cycle_Time_mVcuFaults_0x204;
  CycMaxCycleTime = kMAX_Cycle_Time_mVcuFaults_0x204;
  snprintf(Polarian_ID, elCount(Polarian_ID), "CGMN-14933");
  TestCaseTitle(Polarian_ID,"Tx_Msg_Periodicity_mVcuFaults_0x204");
  TestCaseDescription(Description);
  gCyccheckId = ChkStart_MsgAbsCycleTimeViolation(mVcuFaults, CycMinCycleTime, CycMaxCycleTime);
  CheckMsg(mVcuFaults,CycMinCycleTime, CycMaxCycleTime);  
}

// Check initial values of individual signals within the message
testcase Tx_Msg_Sig_Init_mVcuGitSHA_0x1CFFCACC()
{
  char Description[100] = "To check the initial values of signals in the [mVcuGitSHA_0x1CFFCACC] message ";
  flag = 1;
  snprintf(Polarian_ID, elCount(Polarian_ID), "CGMN-14938");
  TestCaseTitle(Polarian_ID,"Tx_Msg_Sig_Init_mVcuGitSHA_0x1CFFCACC" );
  TestCaseDescription(Description);
  signalintialvaluecheck(mVcuGitSHA,Git_SHA1,0,"Git_SHA1");
  signalintialvaluecheck(mVcuGitSHA,Git_SHA2,0,"Git_SHA2");
  signalintialvaluecheck(mVcuGitSHA,Git_SHA3,0,"Git_SHA3");
  signalintialvaluecheck(mVcuGitSHA,Git_SHA4,0,"Git_SHA4");
  signalintialvaluecheck(mVcuGitSHA,Git_SHA5,0,"Git_SHA5");
  signalintialvaluecheck(mVcuGitSHA,Git_SHA6,0,"Git_SHA6");
  signalintialvaluecheck(mVcuGitSHA,Git_SHA7,0,"Git_SHA7");
  signalintialvaluecheck(mVcuGitSHA,Git_SHA8,0,"Git_SHA8");
 }

//Check Data Lengh Code of the message
testcase Tx_Msg_DLC_mVcuGitSHA_0x1CFFCACC() 
{
  char Description[100] = "To check the Data Length Code of the [mVcuGitSHA_0x1CFFCACC] message ";
  snprintf(Polarian_ID, elCount(Polarian_ID), "CGMN-14937");
  TestCaseTitle(Polarian_ID,"Tx_Msg_DLC_mVcuGitSHA_0x1CFFCACC");
  TestCaseDescription(Description);
  DLC_Value = 8;
  Check_DLC(mVcuGitSHA, Msg_0x1CFFCACC);
}

//Check the Periodicity of the message
testcase Tx_Msg_Periodicity_mVcuGitSHA_0x1CFFCACC()
{
  char Description[100] = "To check the Periodicity of the [mVcuGitSHA_0x1CFFCACC] message ";
  float CycMinCycleTime, CycMaxCycleTime;
  Cycle_time = 10000; 
  kTIMEOUT = 100000; 
  CycMinCycleTime = kMIN_Cycle_Time_mVcuGitSHA_0x1CFFCACC;
  CycMaxCycleTime = kMAX_Cycle_Time_mVcuGitSHA_0x1CFFCACC;
  snprintf(Polarian_ID, elCount(Polarian_ID), "CGMN-14936");
  TestCaseTitle(Polarian_ID,"Tx_Msg_Periodicity_mVcuGitSHA_0x1CFFCACC");
  TestCaseDescription(Description);
  gCyccheckId = ChkStart_MsgAbsCycleTimeViolation(mVcuGitSHA,CycMinCycleTime, CycMaxCycleTime);
  CheckMsg(mVcuGitSHA,CycMinCycleTime, CycMaxCycleTime);  
}

// Check initial values of individual signals within the message
testcase Tx_Msg_Sig_Init_mVcuGyroAngle_0x20D()
{
  char Description[100] = "To check the initial values of signals in the [mVcuGyroAngle_0x20D] message ";
  flag = 1;
  snprintf(Polarian_ID, elCount(Polarian_ID), "CGMN-29586");
  TestCaseTitle(Polarian_ID,"Tx_Msg_Sig_Init_mVcuGyroAngle_0x20D" );
  TestCaseDescription(Description);
  signalintialvaluecheck(mVcuGyroAngle,GyroXAng,0,"GyroXAng");
  signalintialvaluecheck(mVcuGyroAngle,GyroYAng,0,"GyroYAng");
  signalintialvaluecheck(mVcuGyroAngle,Pitch,0,"Pitch");
  signalintialvaluecheck(mVcuGyroAngle,Tilt,0,"Tilt");
  
 }

//Check Data Lengh Code of the message
testcase Tx_Msg_DLC_mVcuGyroAngle_0x20D() 
{
  char Description[100] = "To check the Data Length Code of the [mVcuGyroAngle_0x20D] message ";
  snprintf(Polarian_ID, elCount(Polarian_ID), "CGMN-29585");
  TestCaseTitle(Polarian_ID,"Tx_Msg_DLC_mVcuGyroAngle_0x20D");
  TestCaseDescription(Description);
  DLC_Value = 8;
  Check_DLC(mVcuGyroAngle, Msg_0x20D);
}

//Check the Periodicity of the message
testcase Tx_Msg_Periodicity_mVcuGyroAngle_0x20D()
{
  char Description[100] = "To check the Periodicity of the [mVcuGyroAngle_0x20D] message ";
  float CycMinCycleTime, CycMaxCycleTime;
  Cycle_time = 20; 
  kTIMEOUT = 200; 
  CycMinCycleTime = kMIN_Cycle_Time_mVcuGyroAngle_0x20D;
  CycMaxCycleTime = kMAX_Cycle_Time_mVcuGyroAngle_0x20D;
  snprintf(Polarian_ID, elCount(Polarian_ID), "CGMN-29584");
  TestCaseTitle(Polarian_ID,"Tx_Msg_Periodicity_mVcuGyroAngle_0x20D");
  TestCaseDescription(Description);
  gCyccheckId = ChkStart_MsgAbsCycleTimeViolation(mVcuGyroAngle, CycMinCycleTime, CycMaxCycleTime);
  CheckMsg(mVcuGyroAngle,CycMinCycleTime, CycMaxCycleTime);  
}

// Check initial values of individual signals within the message
testcase Tx_Msg_Sig_Init_mVcuImuAngVel_0x206()
{
  char Description[100] = "To check the initial values of signals in the [mVcuImuAngVel_0x206] message ";
  flag = 1;
  snprintf(Polarian_ID, elCount(Polarian_ID), "CGMN-14941");
  TestCaseTitle(Polarian_ID,"Tx_Msg_Sig_Init_mVcuImuAngVel_0x206" );
  TestCaseDescription(Description);
  signalintialvaluecheck(mVcuImuAngVel,MsgCntr,0,"MsgCntr");
  signalintialvaluecheck(mVcuImuAngVel,MsgCrc,0,"MsgCrc");
  signalintialvaluecheck(mVcuImuAngVel,X_Angular_Rate,0,"X_Angular_Rate");
  signalintialvaluecheck(mVcuImuAngVel,Y_Angular_Rate,0,"Y_Angular_Rate");
  signalintialvaluecheck(mVcuImuAngVel,Z_Angular_Rate,0,"Z_Angular_Rate");
}

//Check Data Lengh Code of the message
testcase Tx_Msg_DLC_mVcuImuAngVel_0x206() 
{
  char Description[100] = "To check the Data Length Code of the [mVcuImuAngVel_0x206] message ";
  snprintf(Polarian_ID, elCount(Polarian_ID), "CGMN-14940");
  TestCaseTitle(Polarian_ID,"Tx_Msg_DLC_mVcuImuAngVel_0x206");
  TestCaseDescription(Description);
  DLC_Value = 8;
  Check_DLC(mVcuImuAngVel, Msg_0x206);
  
}

//Check the Periodicity of the message
testcase Tx_Msg_Periodicity_mVcuImuAngVel_0x206()
{
	char Description[100] = "To check the Periodicity of the [mVcuImuAngVel_0x206] message ";
  float CycMinCycleTime, CycMaxCycleTime;
  Cycle_time = 10; 
   kTIMEOUT = 100; 
  CycMinCycleTime = kMIN_Cycle_Time_mVcuImuAngVel_0x206;
  CycMaxCycleTime = kMAX_Cycle_Time_mVcuImuAngVel_0x206;
  snprintf(Polarian_ID, elCount(Polarian_ID), "CGMN-14939");
  TestCaseTitle(Polarian_ID,"Tx_Msg_Periodicity_mVcuImuAngVel_0x206");
  TestCaseDescription(Description);
  gCyccheckId = ChkStart_MsgAbsCycleTimeViolation(mVcuImuAngVel, CycMinCycleTime, CycMaxCycleTime);
  CheckMsg(mVcuImuAngVel,CycMinCycleTime, CycMaxCycleTime);  
}

// Check initial values of individual signals within the message
testcase Tx_Msg_Sig_Init_mVcuImuAngVel_Filt_0x20C()
{
  char Description[100] = "To check the initial values of signals in the [mVcuImuAngVel_Filt_0x20C] message ";
  flag = 1;
  snprintf(Polarian_ID, elCount(Polarian_ID), "CGMN-29589");
  TestCaseTitle(Polarian_ID,"Tx_Msg_Sig_Init_mVcuImuAngVel_Filt_0x20C" );
  TestCaseDescription(Description);
  signalintialvaluecheck(mVcuImuAngVel_Filt,MsgCntr,0,"MsgCntr");
  signalintialvaluecheck(mVcuImuAngVel_Filt,MsgCrc,0,"MsgCrc");
  signalintialvaluecheck(mVcuImuAngVel_Filt,X_Angular_Rate_Filt,0,"X_Angular_Rate_Filt");
  signalintialvaluecheck(mVcuImuAngVel_Filt,Y_Angular_Rate_Filt,0,"Y_Angular_Rate_Filt");
  signalintialvaluecheck(mVcuImuAngVel_Filt,Z_Angular_Rate_Filt,0,"Z_Angular_Rate_Filt");
 }

//Check Data Lengh Code of the message
testcase Tx_Msg_DLC_mVcuImuAngVel_Filt_0x20C() 
{
  char Description[100] = "To check the Data Length Code of the [mVcuImuAngVel_Filt_0x20C] message ";
  snprintf(Polarian_ID, elCount(Polarian_ID), "CGMN-29588");
  TestCaseTitle(Polarian_ID,"Tx_Msg_DLC_mVcuImuAngVel_Filt_0x20C");
  TestCaseDescription(Description);
  DLC_Value = 8;
  Check_DLC(mVcuImuAngVel_Filt, Msg_0x20C);
}

//Check the Periodicity of the message
testcase Tx_Msg_Periodicity_mVcuImuAngVel_Filt_0x20C()
{
	char Description[100] = "To check the Periodicity of the [mVcuImuAngVel_Filt_0x20C] message ";
  float CycMinCycleTime, CycMaxCycleTime;
  Cycle_time = 100; 
  kTIMEOUT = 1000; 
  CycMinCycleTime = kMIN_Cycle_Time_mVcuImuAngVel_Filt_0x20C;
  CycMaxCycleTime = kMAX_Cycle_Time_mVcuImuAngVel_Filt_0x20C;
  snprintf(Polarian_ID, elCount(Polarian_ID), "CGMN-29587");
  TestCaseTitle(Polarian_ID,"Tx_Msg_Periodicity_mVcuImuAngVel_Filt_0x20C");
  TestCaseDescription(Description);
  gCyccheckId = ChkStart_MsgAbsCycleTimeViolation(mVcuImuAngVel_Filt, CycMinCycleTime, CycMaxCycleTime);
  CheckMsg(mVcuImuAngVel_Filt,CycMinCycleTime, CycMaxCycleTime);  
}

// Check initial values of individual signals within the message
testcase Tx_Msg_Sig_Init_mVcuImuLinAccel_0x205()
{
  char Description[100] = "To check the initial values of signals in the [mVcuImuLinAccel_0x205] message ";
  flag = 1;
  snprintf(Polarian_ID, elCount(Polarian_ID), "CGMN-14944");
  TestCaseTitle(Polarian_ID,"Tx_Msg_Sig_Init_mVcuImuLinAccel_0x205" );
  TestCaseDescription(Description);
  signalintialvaluecheck(mVcuImuLinAccel,MsgCntr,0,"MsgCntr");
  signalintialvaluecheck(mVcuImuLinAccel,MsgCrc,0,"MsgCrc");
  signalintialvaluecheck(mVcuImuLinAccel,X_Accel,0,"X_Accel");
  signalintialvaluecheck(mVcuImuLinAccel,Y_Accel,0,"Y_Accel");
  signalintialvaluecheck(mVcuImuLinAccel,Z_Accel,0,"Z_Accel");
}

//Check Data Lengh Code of the message
testcase Tx_Msg_DLC_mVcuImuLinAccel_0x205() 
{
  char Description[100] = "To check the Data Length Code of the [mVcuImuLinAccel_0x205] message ";
  snprintf(Polarian_ID, elCount(Polarian_ID), "CGMN-14943");
  TestCaseTitle(Polarian_ID,"Tx_Msg_DLC_mVcuImuLinAccel_0x205");
  TestCaseDescription(Description);
  DLC_Value = 8;
  Check_DLC(mVcuImuLinAccel, Msg_0x205);
}

//Check the Periodicity of the message
testcase Tx_Msg_Periodicity_mVcuImuLinAccel_0x205()
{
   char Description[100] = "To check the Periodicity of the [mVcuImuLinAccel_0x205] message ";
   float CycMinCycleTime, CycMaxCycleTime;
   Cycle_time = 10; 
   kTIMEOUT = 100; 
  CycMinCycleTime = kMIN_Cycle_Time_mVcuImuLinAccel_0x205;
  CycMaxCycleTime = kMAX_Cycle_Time_mVcuImuLinAccel_0x205;
  snprintf(Polarian_ID, elCount(Polarian_ID), "CGMN-14942");
  TestCaseTitle(Polarian_ID,"Tx_Msg_Periodicity_mVcuImuLinAccel_0x205");
  TestCaseDescription(Description);
  gCyccheckId = ChkStart_MsgAbsCycleTimeViolation(mVcuImuLinAccel, CycMinCycleTime, CycMaxCycleTime);
  CheckMsg(mVcuImuLinAccel,CycMinCycleTime, CycMaxCycleTime);  
}

// Check initial values of individual signals within the message
testcase Tx_Msg_Sig_Init_mVcuImuLinAccel_Filt_0x20B()
{
  char Description[100] = "To check the initial values of signals in the [mVcuImuLinAccel_Filt_0x20B] message ";
  flag = 1;
  snprintf(Polarian_ID, elCount(Polarian_ID), "CGMN-29592");
  TestCaseTitle(Polarian_ID,"Tx_Msg_Sig_Init_mVcuImuLinAccel_Filt_0x20B" );
  TestCaseDescription(Description);
  signalintialvaluecheck(mVcuImuLinAccel_Filt,MsgCntr,0,"MsgCntr");
  signalintialvaluecheck(mVcuImuLinAccel_Filt,MsgCrc,0,"MsgCrc");
  signalintialvaluecheck(mVcuImuLinAccel_Filt,X_Accel_Filt,0,"X_Accel_Filt");
  signalintialvaluecheck(mVcuImuLinAccel_Filt,Y_Accel_Filt,0,"Y_Accel_Filt");
  signalintialvaluecheck(mVcuImuLinAccel_Filt,Z_Accel_Filt,0,"Z_Accel_Filt");
 }

//Check Data Lengh Code of the message
testcase Tx_Msg_DLC_mVcuImuLinAccel_Filt_0x20B() 
{
  char Description[100] = "To check the Data Length Code of the [mVcuImuLinAccel_Filt_0x20B] message ";
  snprintf(Polarian_ID, elCount(Polarian_ID), "CGMN-29591");
  TestCaseTitle(Polarian_ID,"Tx_Msg_DLC_mVcuImuLinAccel_Filt_0x20B");
  TestCaseDescription(Description);
  DLC_Value = 8;
  Check_DLC(mVcuImuLinAccel_Filt, Msg_0x20B);
}

//Check the Periodicity of the message
testcase Tx_Msg_Periodicity_mVcuImuLinAccel_Filt_0x20B()
{
	char Description[100] = "To check the Periodicity of the [mVcuImuLinAccel_Filt_0x20B] message ";
  float CycMinCycleTime, CycMaxCycleTime;
  Cycle_time = 100; 
  kTIMEOUT = 1000; 
  CycMinCycleTime = kMIN_Cycle_Time_mVcuImuLinAccel_Filt_0x20B;
  CycMaxCycleTime = kMAX_Cycle_Time_mVcuImuLinAccel_Filt_0x20B;
  snprintf(Polarian_ID, elCount(Polarian_ID), "CGMN-29590");
  TestCaseTitle(Polarian_ID,"Tx_Msg_Periodicity_mVcuImuLinAccel_Filt_0x20B");
  TestCaseDescription(Description);
  gCyccheckId = ChkStart_MsgAbsCycleTimeViolation(mVcuImuLinAccel_Filt, CycMinCycleTime, CycMaxCycleTime);
  CheckMsg(mVcuImuLinAccel_Filt,CycMinCycleTime, CycMaxCycleTime);  
}

// Check initial values of individual signals within the message
testcase Tx_Msg_Sig_Init_mVcuSwVer_0x1CFFCCCC()
{
  char Description[100] = "To check the initial values of signals in the [mVcuSwVer_0x1CFFCCCC] message ";
  flag = 1;
  snprintf(Polarian_ID, elCount(Polarian_ID), "CGMN-14945");
  TestCaseTitle(Polarian_ID,"Tx_Msg_Sig_Init_mVcuSwVer_0x1CFFCCCC" );
  TestCaseDescription(Description);
  signalintialvaluecheck(mVcuSwVer,SwMaj,0,"SwMaj");
  signalintialvaluecheck(mVcuSwVer,SwMin,0,"SwMin");
  signalintialvaluecheck(mVcuSwVer,SwRev,0,"SwRev");
  signalintialvaluecheck(mVcuSwVer,SwStat,0,"SwStat");
}

//Check Data Lengh Code of the message
testcase Tx_Msg_DLC_mVcuSwVer_0x1CFFCCCC() 
{
  char Description[100] = "To check the Data Length Code of the [mVcuSwVer_0x1CFFCCCC] message ";
  snprintf(Polarian_ID, elCount(Polarian_ID), "CGMN-12149");
  TestCaseTitle(Polarian_ID,"Tx_Msg_DLC_mVcuSwVer_0x1CFFCCCC");
  TestCaseDescription(Description);
  DLC_Value = 4;
  Check_DLC(mVcuSwVer, Msg_0x1CFFCCCC);
}

//Check the Periodicity of the message
testcase Tx_Msg_Periodicity_mVcuSwVer_0x1CFFCCCC()
{
  char Description[100] = "To check the Periodicity of the [mVcuSwVer_0x1CFFCCCC] message ";
  float CycMinCycleTime, CycMaxCycleTime;
  Cycle_time = 10000; 
  kTIMEOUT = 100000; 
  CycMinCycleTime = kMIN_Cycle_Time_mVcuSwVer_0x1CFFCCCC;
  CycMaxCycleTime = kMAX_Cycle_Time_mVcuSwVer_0x1CFFCCCC;
  snprintf(Polarian_ID, elCount(Polarian_ID), "CGMN-12192");
  TestCaseTitle(Polarian_ID,"Tx_Msg_Periodicity_mVcuSwVer_0x1CFFCCCC");
  TestCaseDescription(Description);
  gCyccheckId = ChkStart_MsgAbsCycleTimeViolation(mVcuSwVer, CycMinCycleTime, CycMaxCycleTime);
  CheckMsg(mVcuSwVer,CycMinCycleTime, CycMaxCycleTime);  
}

// Check initial values of individual signals within the message
testcase Tx_Msg_Sig_Init_mVcuSys_0x302()
{
  char Description[100] = "To check the initial values of signals in the [mVcuSys_0x302] message ";
  flag = 1;
  snprintf(Polarian_ID, elCount(Polarian_ID), "CGMN-12188");
  TestCaseTitle(Polarian_ID,"Tx_Msg_Sig_Init_mVcuSys_0x302" );
  TestCaseDescription(Description);
  signalintialvaluecheck(mVcuSys,AdcuShtdwnRq,0,"AdcuShtdwnRq");
  signalintialvaluecheck(mVcuSys,EbcmShtdwnRq,0,"EbcmShtdwnRq");
  signalintialvaluecheck(mVcuSys,EstopTest,0,"EstopTest");
  signalintialvaluecheck(mVcuSys,MsgCntr,0,"MsgCntr");
  signalintialvaluecheck(mVcuSys,MsgCrc,0,"MsgCrc");
  signalintialvaluecheck(mVcuSys,MtrTrqLmtAccel,0,"MtrTrqLmtAccel");
  signalintialvaluecheck(mVcuSys,MtrTrqLmtDecel,0,"MtrTrqLmtDecel");
  signalintialvaluecheck(mVcuSys,VcuStateInit,0,"VcuStateInit");
  signalintialvaluecheck(mVcuSys,VcuStateShtdwn,0,"VcuStateShtdwn");  
}

//Check Data Lengh Code of the message
testcase Tx_Msg_DLC_mVcuSys_0x302() 
{
  char Description[100] = "To check the Data Length Code of the [mVcuSys_0x302] message ";
  snprintf(Polarian_ID, elCount(Polarian_ID), "CGMN-12186");
  TestCaseTitle(Polarian_ID,"Tx_Msg_DLC_mVcuSys_0x302");
  TestCaseDescription(Description);
  DLC_Value = 8;
  Check_DLC(mVcuSys, Msg_0x302);
}

//Check the Periodicity of the message
testcase Tx_Msg_Periodicity_mVcuSys_0x302()
{
  char Description[100] = "To check the Periodicity of the [mVcuSys_0x302] message ";
  float CycMinCycleTime, CycMaxCycleTime;
  Cycle_time = 50; 
  kTIMEOUT = 500; 
  CycMinCycleTime = kMIN_Cycle_Time_mVcuSys_0x302;
  CycMaxCycleTime = kMAX_Cycle_Time_mVcuSys_0x302;
  snprintf(Polarian_ID, elCount(Polarian_ID), "CGMN-12185");
  TestCaseTitle(Polarian_ID,"Tx_Msg_Periodicity_mVcuSys_0x302");
  TestCaseDescription(Description);
  gCyccheckId = ChkStart_MsgAbsCycleTimeViolation(mVcuSys, CycMinCycleTime, CycMaxCycleTime);
  CheckMsg(mVcuSys,CycMinCycleTime, CycMaxCycleTime);  
}

// Check initial values of individual signals within the message
testcase Tx_Msg_Sig_Init_mVcuVehID_0x1CFFBACC()
{
  char Description[100] = "To check the initial values of signals in the [mVcuVehID_0x1CFFBACC] message ";
  flag = 1;
  snprintf(Polarian_ID, elCount(Polarian_ID), "CGMN-12182");
  TestCaseTitle(Polarian_ID,"Tx_Msg_Sig_Init_mVcuVehID_0x1CFFBACC" );
  TestCaseDescription(Description);
  signalintialvaluecheck(mVcuVehID,VehId_Char1,0,"VehId_Char1");  
  signalintialvaluecheck(mVcuVehID,VehId_Char2,0,"VehId_Char2");  
  signalintialvaluecheck(mVcuVehID,VehId_Char3,0,"VehId_Char3");  
  signalintialvaluecheck(mVcuVehID,VehId_Char4,0,"VehId_Char4");  
  signalintialvaluecheck(mVcuVehID,VehId_Char5,0,"VehId_Char5");  
  signalintialvaluecheck(mVcuVehID,VehId_Char6,0,"VehId_Char6");  
  signalintialvaluecheck(mVcuVehID,VehId_Char7,0,"VehId_Char7");  
  signalintialvaluecheck(mVcuVehID,VehId_Char8,0,"VehId_Char8");
}

//Check Data Lengh Code of the message
testcase Tx_Msg_DLC_mVcuVehID_0x1CFFBACC() 
{
  char Description[100] = "To check the Data Length Code of the [mVcuVehID_0x1CFFBACC] message ";
  snprintf(Polarian_ID, elCount(Polarian_ID), "CGMN-12181");
  TestCaseTitle(Polarian_ID,"Tx_Msg_DLC_mVcuVehID_0x1CFFBACC");
  TestCaseDescription(Description);
  DLC_Value = 8;
  Check_DLC(mVcuVehID, Msg_0x1CFFBACC);
}

//Check the Periodicity of the message
testcase Tx_Msg_Periodicity_mVcuVehID_0x1CFFBACC()
{
  char Description[100] = "To check the Periodicity of the [mVcuVehID_0x1CFFBACC] message ";
  float CycMinCycleTime, CycMaxCycleTime;
  Cycle_time = 10000; 
  kTIMEOUT = 100000; 
  CycMinCycleTime = kMIN_Cycle_Time_mVcuVehID_0x1CFFBACC;
  CycMaxCycleTime = kMAX_Cycle_Time_mVcuVehID_0x1CFFBACC;
  snprintf(Polarian_ID, elCount(Polarian_ID), "CGMN-12190");
  TestCaseTitle(Polarian_ID,"Tx_Msg_Periodicity_mVcuVehID_0x1CFFBACC");
  TestCaseDescription(Description);
  gCyccheckId = ChkStart_MsgAbsCycleTimeViolation(mVcuVehID, CycMinCycleTime, CycMaxCycleTime);
  CheckMsg(mVcuVehID,CycMinCycleTime, CycMaxCycleTime);  
}

// Check initial values of individual signals within the message
testcase Tx_Msg_Sig_Init_mVehState_0x202()
{
  char Description[100] = "To check the initial values of signals in the [mVehState_0x202] message ";
  flag = 1;
  snprintf(Polarian_ID, elCount(Polarian_ID), "CGMN-12188");
  TestCaseTitle(Polarian_ID,"Tx_Msg_Sig_Init_mVehState_0x202" );
  TestCaseDescription(Description);
  signalintialvaluecheck(mVehState,AD_Allowed,0,"AD_Allowed");
  signalintialvaluecheck(mVehState,ArbVehSpd,0,"ArbVehSpd");
  signalintialvaluecheck(mVehState,ArbVehSpdValid,0,"ArbVehSpdValid");
  signalintialvaluecheck(mVehState,CrashSns,0,"CrashSns");
  signalintialvaluecheck(mVehState,EstopDetected,0,"EstopDetected");
  signalintialvaluecheck(mVehState,GearAct,0,"GearAct");
  signalintialvaluecheck(mVehState,GearChangeDrvRevAllow,0,"GearChangeDrvRevAllow");
  signalintialvaluecheck(mVehState,GearChangeParkAllow,0,"GearChangeParkAllow");
  signalintialvaluecheck(mVehState,GearRq,0,"GearRq");
  signalintialvaluecheck(mVehState,Invld_GearRq,0,"Invld_GearRq");
  signalintialvaluecheck(mVehState,LOS_Allowed,0,"LOS_Allowed");
  signalintialvaluecheck(mVehState,LvVolt,0,"LvVolt");
  signalintialvaluecheck(mVehState,MsgCntr,0,"MsgCntr");
  signalintialvaluecheck(mVehState,MsgCrc,0,"MsgCrc");
  signalintialvaluecheck(mVehState,SBW_LfEndStopReached,0,"SBW_LfEndStopReached");
  signalintialvaluecheck(mVehState,SBW_RtEndStopReached,0,"SBW_RtEndStopReached");
  signalintialvaluecheck(mVehState,Tether_Connected,0,"Tether_Connected");
  signalintialvaluecheck(mVehState,TO_Allowed,0,"TO_Allowed");
  signalintialvaluecheck(mVehState,VcuEstopSns,0,"VcuEstopSns");
  signalintialvaluecheck(mVehState,VehDte,0,"VehDte");
  signalintialvaluecheck(mVehState,VehParkRq,0,"VehParkRq");
  signalintialvaluecheck(mVehState,VehState,0,"VehState");

}

//Check Data Lengh Code of the message
testcase Tx_Msg_DLC_mVehState_0x202() 
{
  char Description[100] = "To check the Data Length Code of the [mVehState_0x202] message ";
  snprintf(Polarian_ID, elCount(Polarian_ID), "CGMN-12186");
  TestCaseTitle(Polarian_ID,"Tx_Msg_DLC_mVehState_0x202");
  TestCaseDescription(Description);
  DLC_Value = 8;
  Check_DLC(mVehState, Msg_0x202);
}

//Check the Periodicity of the message
testcase Tx_Msg_Periodicity_mVehState_0x202()
{
  char Description[100] = "To check the Periodicity of the [mVehState_0x302] message ";
  float CycMinCycleTime, CycMaxCycleTime;
  Cycle_time = 50; 
  kTIMEOUT = 500; 
  CycMinCycleTime = kMIN_Cycle_Time_mVehState_0x202;
  CycMaxCycleTime = kMAX_Cycle_Time_mVehState_0x202;
  snprintf(Polarian_ID, elCount(Polarian_ID), "CGMN-12185");
  TestCaseTitle(Polarian_ID,"Tx_Msg_Periodicity_mVehState_0x202");
  TestCaseDescription(Description);
  gCyccheckId = ChkStart_MsgAbsCycleTimeViolation(mVehState, CycMinCycleTime, CycMaxCycleTime);
  CheckMsg(mVehState,CycMinCycleTime, CycMaxCycleTime);  
}

// Check initial values of individual signals within the message
testcase Tx_Msg_Sig_Init_mVehState2_0x208()
{
  char Description[100] = "To check the initial values of signals in the [mVehState2_0x208] message ";
  flag = 1;
  snprintf(Polarian_ID, elCount(Polarian_ID), "CGMN-12178");
  TestCaseTitle(Polarian_ID,"Tx_Msg_Sig_Init_mVehState2_0x208" );
  TestCaseDescription(Description);
  signalintialvaluecheck(mVehState2,ActGndWhlAng,0,"ActGndWhlAng");  
  signalintialvaluecheck(mVehState2,maxAccelAvail,0,"maxAccelAvail");  
  signalintialvaluecheck(mVehState2,maxDecelAvail,0,"maxDecelAvail");  
  signalintialvaluecheck(mVehState2,maxSpeedAllowed,0,"maxSpeedAllowed");  
  signalintialvaluecheck(mVehState2,MsgCntr,0,"MsgCntr");  
  signalintialvaluecheck(mVehState2,MsgCrc,0,"MsgCrc");  
 }

//Check Data Lengh Code of the message
testcase Tx_Msg_DLC_mVehState2_0x208() 
{
  char Description[100] = "To check the Data Length Code of the [mVehState2_0x208] message ";
  snprintf(Polarian_ID, elCount(Polarian_ID), "CGMN-12179");
  TestCaseTitle(Polarian_ID,"Tx_Msg_DLC_mVehState2_0x208");
  TestCaseDescription(Description);
  DLC_Value = 8;
  Check_DLC(mVehState2, Msg_0x208);
}

//Check the Periodicity of the message
testcase Tx_Msg_Periodicity_mVehState2_0x208()
{
	char Description[100] = "To check the Periodicity of the [mVehState2_0x208] message ";
  float CycMinCycleTime, CycMaxCycleTime;
  Cycle_time = 20; 
  kTIMEOUT = 200; 
  CycMinCycleTime = kMIN_Cycle_Time_mVehState2_0x208;
  CycMaxCycleTime = kMAX_Cycle_Time_mVehState2_0x208;
  snprintf(Polarian_ID, elCount(Polarian_ID), "CGMN-12180");
  TestCaseTitle(Polarian_ID,"Tx_Msg_Periodicity_mVehState2_0x208");
  TestCaseDescription(Description);
  gCyccheckId = ChkStart_MsgAbsCycleTimeViolation(mVehState2, CycMinCycleTime, CycMaxCycleTime);
  CheckMsg(mVehState2,CycMinCycleTime, CycMaxCycleTime);  
}

// Check initial values of individual signals within the message
testcase Tx_Msg_Sig_Init_mVehState3_0x209()
{
  char Description[100] = "To check the initial values of signals in the [mVehState3_0x209] message ";
  flag = 1;
  snprintf(Polarian_ID, elCount(Polarian_ID), "CGMN-29595");
  TestCaseTitle(Polarian_ID,"Tx_Msg_Sig_Init_mVehState3_0x209" );
  TestCaseDescription(Description);
  signalintialvaluecheck(mVehState3,Aeb_Active,0,"Aeb_Active");
  signalintialvaluecheck(mVehState3,AebSrc,0,"AebSrc");
  signalintialvaluecheck(mVehState3,ArbVehSpd_mps,0,"ArbVehSpd_mps");
  signalintialvaluecheck(mVehState3,ArbVehSpd_mps_Valid,0,"ArbVehSpd_mps_Valid");
  signalintialvaluecheck(mVehState3,MsgCntr,0,"MsgCntr");
  signalintialvaluecheck(mVehState3,MsgCrc,0,"MsgCrc");
  signalintialvaluecheck(mVehState3,ROI,0,"ROI");
  signalintialvaluecheck(mVehState3,TargetVehSpd_mps,0,"TargetVehSpd_mps");
  
}

//Check Data Lengh Code of the message
testcase Tx_Msg_DLC_mVehState3_0x209() 
{
  char Description[100] = "To check the Data Length Code of the [mVehState3_0x209] message ";
  snprintf(Polarian_ID, elCount(Polarian_ID), "CGMN-29594");
  TestCaseTitle(Polarian_ID,"Tx_Msg_DLC_mVehState3_0x209");
  TestCaseDescription(Description);
  DLC_Value = 8;
  Check_DLC(mVehState3, Msg_0x209);
}

//Check the Periodicity of the message
testcase Tx_Msg_Periodicity_mVehState3_0x209()
{
  char Description[100] = "To check the Periodicity of the [mVehState3_0x209] message ";
  float CycMinCycleTime, CycMaxCycleTime;
   Cycle_time = 50; 
   kTIMEOUT = 500; 
  CycMinCycleTime = kMIN_Cycle_Time_mVehState3_0x209;
  CycMaxCycleTime = kMAX_Cycle_Time_mVehState3_0x209;
  snprintf(Polarian_ID, elCount(Polarian_ID), "CGMN-29593");
  TestCaseTitle(Polarian_ID,"Tx_Msg_Periodicity_mVehState3_0x209");
  TestCaseDescription(Description);
  gCyccheckId = ChkStart_MsgAbsCycleTimeViolation(mVehState3, CycMinCycleTime, CycMaxCycleTime);
  CheckMsg(mVehState3,CycMinCycleTime, CycMaxCycleTime);  
}

// Check initial values of individual signals within the message
testcase Tx_Msg_Sig_Init_mWhdCtrl_0x12()
{
  char Description[100] = "To check the initial values of signals in the [mWhdCtrl_0x12] message ";
  flag = 1;
  snprintf(Polarian_ID, elCount(Polarian_ID), "CGMN-12175");
  TestCaseTitle(Polarian_ID,"Tx_Msg_Sig_Init_mWhdCtrl_0x12" );
  TestCaseDescription(Description);
  signalintialvaluecheck(mWhdCtrl,Boot,0,"Boot");
  signalintialvaluecheck(mWhdCtrl,CtrlMode,0,"CtrlMode");
  signalintialvaluecheck(mWhdCtrl,Debug,0,"Debug");
  signalintialvaluecheck(mWhdCtrl,EnblCmd,0,"EnblCmd");
  signalintialvaluecheck(mWhdCtrl,MsgCntr,0,"MsgCntr");
  signalintialvaluecheck(mWhdCtrl,MsgCrc,0,"MsgCrc");
  signalintialvaluecheck(mWhdCtrl,MtrMode,0,"MtrMode");
  signalintialvaluecheck(mWhdCtrl,SpdCmd,0,"SpdCmd");
  signalintialvaluecheck(mWhdCtrl,SpdSlewLmt,0,"SpdSlewLmt");
  signalintialvaluecheck(mWhdCtrl,TrqCmd,0,"TrqCmd");
  signalintialvaluecheck(mWhdCtrl,TrqSlewLmt,0,"TrqSlewLmt");
  
}

//Check Data Lengh Code of the message
testcase Tx_Msg_DLC_mWhdCtrl_0x12() 
{
  char Description[100] = "To check the Data Length Code of the [mWhdCtrl_0x12] message ";
  snprintf(Polarian_ID, elCount(Polarian_ID), "CGMN-12176");
  TestCaseTitle(Polarian_ID,"Tx_Msg_DLC_mWhdCtrl_0x12");
  TestCaseDescription(Description);
  DLC_Value = 8;
  Check_DLC(mWhdCtrl, Msg_0x12);
}

//Check the Periodicity of the message
testcase Tx_Msg_Periodicity_mWhdCtrl_0x12()
{
   char Description[100] = "To check the Periodicity of the [mWhdCtrl_0x12] message ";
  float CycMinCycleTime, CycMaxCycleTime;
  Cycle_time = 10; 
   kTIMEOUT = 100; 
  CycMinCycleTime = kMIN_Cycle_Time_mWhdCtrl_0x12;
  CycMaxCycleTime = kMAX_Cycle_Time_mWhdCtrl_0x12;
  snprintf(Polarian_ID, elCount(Polarian_ID), "CGMN-12177");
  TestCaseTitle(Polarian_ID,"Tx_Msg_Periodicity_mWhdCtrl_0x12");
  TestCaseDescription(Description);
  gCyccheckId = ChkStart_MsgAbsCycleTimeViolation(mWhdCtrl, CycMinCycleTime, CycMaxCycleTime);
  CheckMsg(mWhdCtrl,CycMinCycleTime, CycMaxCycleTime);  
}

// Check initial values of individual signals within the message
testcase Tx_Msg_Sig_Init_mWhdCtrl2_0x13()
{
  char Description[100] = "To check the initial values of signals in the [mWhdCtrl2_0x13] message ";
  flag = 1;
  snprintf(Polarian_ID, elCount(Polarian_ID), "CGMN-29599");
  TestCaseTitle(Polarian_ID,"Tx_Msg_Sig_Init_mWhdCtrl2_0x13" );
  TestCaseDescription(Description);
  signalintialvaluecheck(mWhdCtrl2,ClearFltRq,0,"ClearFltRq");
  signalintialvaluecheck(mWhdCtrl2,CurrLmtMtr,0,"CurrLmtMtr");
  signalintialvaluecheck(mWhdCtrl2,CurrLmtRegen,0,"CurrLmtRegen");
  signalintialvaluecheck(mWhdCtrl2,MsgCntr,0,"MsgCntr");
  signalintialvaluecheck(mWhdCtrl2,MsgCrc,0,"MsgCrc");
  signalintialvaluecheck(mWhdCtrl2,TrqLmtMtr,0,"TrqLmtMtr");
  signalintialvaluecheck(mWhdCtrl2,TrqLmtRegen,0,"TrqLmtRegen");
  signalintialvaluecheck(mWhdCtrl2,VoltLmtMax,35,"VoltLmtMax");
  signalintialvaluecheck(mWhdCtrl2,VoltLmtMin,35,"VoltLmtMin");
  signalintialvaluecheck(mWhdCtrl2,WhdShtdwnRq,0,"WhdShtdwnRq");

}

//Check Data Lengh Code of the message
testcase Tx_Msg_DLC_mWhdCtrl2_0x13() 
{
  char Description[100] = "To check the Data Length Code of the [mWhdCtrl2_0x13] message ";
  snprintf(Polarian_ID, elCount(Polarian_ID), "CGMN-29598");
  TestCaseTitle(Polarian_ID,"Tx_Msg_DLC_mWhdCtrl2_0x13");
  TestCaseDescription(Description);
  DLC_Value = 8;
  Check_DLC(mWhdCtrl2, Msg_0x13);
}

//Check the Periodicity of the message
testcase Tx_Msg_Periodicity_mWhdCtrl2_0x13()
{
  char Description[100] = "To check the Periodicity of the [mWhdCtrl2_0x13] message ";
  float CycMinCycleTime, CycMaxCycleTime;
   Cycle_time = 100; 
   kTIMEOUT = 1000; 
  CycMinCycleTime = kMIN_Cycle_Time_mWhdCtrl2_0x13;
  CycMaxCycleTime = kMAX_Cycle_Time_mWhdCtrl2_0x13;
  snprintf(Polarian_ID, elCount(Polarian_ID), "CGMN-29596");
  TestCaseTitle(Polarian_ID,"Tx_Msg_Periodicity_mWhdCtrl2_0x13");
  TestCaseDescription(Description);
  gCyccheckId = ChkStart_MsgAbsCycleTimeViolation(mWhdCtrl2, CycMinCycleTime, CycMaxCycleTime);
  CheckMsg(mWhdCtrl2,CycMinCycleTime, CycMaxCycleTime);  
}


// Check initial values of individual signals within the message
testcase Tx_Msg_Sig_Init_VcuTask1msStat_0x666()
{
  char Description[100] = "To check the initial values of signals in the [VcuTask1msStat_0x666] message ";
  flag = 1;
  snprintf(Polarian_ID, elCount(Polarian_ID), "CGMN-12189");
  TestCaseTitle(Polarian_ID,"Tx_Msg_Sig_Init_VcuTask1msStat_0x666" );
  TestCaseDescription(Description);
  signalintialvaluecheck(VcuTask1msStat,CpuUtilization,0,"CpuUtilization");
  signalintialvaluecheck(VcuTask1msStat,CpuUtilizationValid,0,"CpuUtilizationValid");
  signalintialvaluecheck(VcuTask1msStat,MaxExecTime,0,"MaxExecTime");
  signalintialvaluecheck(VcuTask1msStat,MaxExecTimeValid,0,"MaxExecTimeValid");
  signalintialvaluecheck(VcuTask1msStat,MaxUtilization,0,"MaxUtilization");
  signalintialvaluecheck(VcuTask1msStat,MaxUtilizationValid,0,"MaxUtilizationValid");
}

//Check Data Lengh Code of the message
testcase Tx_Msg_DLC_VcuTask1msStat_0x666() 
{
  char Description[100] = "To check the Data Length Code of the [VcuTask1msStat_0x666] message ";
  snprintf(Polarian_ID, elCount(Polarian_ID), "CGMN-12191");
  TestCaseTitle(Polarian_ID,"Tx_Msg_DLC_VcuTask1msStat_0x666");
  TestCaseDescription(Description);
  DLC_Value = 8;
  Check_DLC(VcuTask1msStat, Msg_0x666);
}

//Check the Periodicity of the message
testcase Tx_Msg_Periodicity_VcuTask1msStat_0x666()
{
  char Description[100] = "To check the Periodicity of the [VcuTask1msStat_0x666] message ";
  float CycMinCycleTime, CycMaxCycleTime;
  Cycle_time = 10; 
  kTIMEOUT = 100; 
  CycMinCycleTime = kMIN_Cycle_Time_VcuTask1msStat_0x666;
  CycMaxCycleTime = kMAX_Cycle_Time_VcuTask1msStat_0x666;
  snprintf(Polarian_ID, elCount(Polarian_ID), "CGMN-12174");
  TestCaseTitle(Polarian_ID,"Tx_Msg_Periodicity_VcuTask1msStat_0x666");
  TestCaseDescription(Description);
  gCyccheckId = ChkStart_MsgAbsCycleTimeViolation(VcuTask1msStat, CycMinCycleTime, CycMaxCycleTime);
  CheckMsg(VcuTask1msStat,CycMinCycleTime, CycMaxCycleTime);  
}
// Check initial values of individual signals within the message
testcase Tx_Msg_Sig_Init_VehDiagPort_0x661()
{
  char Description[100] = "To check the initial values of signals in the [VehDiagPort_0x661] message ";
  flag = 1;
  snprintf(Polarian_ID, elCount(Polarian_ID), "CGMN-12189");
  TestCaseTitle(Polarian_ID,"Tx_Msg_Sig_Init_VehDiagPort_0x661" );
  TestCaseDescription(Description);
  signalintialvaluecheck(VehDiagPort,MobilityInhibitCode,0,"MobilityInhibitCode");
}

//Check Data Lengh Code of the message
testcase Tx_Msg_DLC_VehDiagPort_0x661() 
{
  char Description[100] = "To check the Data Length Code of the [VehDiagPort_0x661] message ";
  snprintf(Polarian_ID, elCount(Polarian_ID), "CGMN-12191");
  TestCaseTitle(Polarian_ID,"Tx_Msg_DLC_VehDiagPort_0x661");
  TestCaseDescription(Description);
  DLC_Value = 8;
  Check_DLC(VehDiagPort, Msg_0x661);
}

//Check the Periodicity of the message
testcase Tx_Msg_Periodicity_VehDiagPort_0x661()
{
  char Description[100] = "To check the Periodicity of the [VehDiagPort_0x661] message ";
  float CycMinCycleTime, CycMaxCycleTime;
  Cycle_time = 10; 
  kTIMEOUT = 100; 
  CycMinCycleTime = kMIN_Cycle_Time_VehDiagPort_0x661;
  CycMaxCycleTime = kMAX_Cycle_Time_VehDiagPort_0x661;
  snprintf(Polarian_ID, elCount(Polarian_ID), "CGMN-12174");
  TestCaseTitle(Polarian_ID,"Tx_Msg_Periodicity_VehDiagPort_0x661");
  TestCaseDescription(Description);
  gCyccheckId = ChkStart_MsgAbsCycleTimeViolation(VehDiagPort, CycMinCycleTime, CycMaxCycleTime);
  CheckMsg(VehDiagPort,CycMinCycleTime, CycMaxCycleTime);  
}

//Initial value check function
/*
signal- message signal name
default_value- signal initial value
signalname[]- message signal name

*/
signalintialvaluecheck(dbMsg *msg, signal *sig,float default_value,char signalname[])
{
    char buffer[1000];                                                   // Variable to store the actual signal value from the message trace
    float signal_value;                                                  // Retrieve the current value of the specified signal
    signal_value = getSignal(sig);                                       // Check if this is the first signal being validated in the current test case
  //testWaitForMessage  
  if(testWaitForMessage(msg,WAIT_TIMEOUT) == 1)
    {
      if (flag == 1)
      {
        testStepBegin(Polarian_ID,"Test Case Started");                     // Log the beginning of the test step with the associated Polarion ID
        flag = 0;                                                           // Reset the flag to ensure this step isn't logged repeatedly
      }
      if(default_value==signal_value)                                       // Compare the retrieved signal value with the expected default value
      {
        snprintf(buffer, elCount(buffer), " Default value of signal %s in DBC %f and the actual value %f got in trace are same", signalname,default_value,signal_value); // Format and store the success message in the buffer
        testStepPass("", buffer);                                           // Log the test step as passed
      }
      else
      {
        snprintf(buffer, elCount(buffer), " Default value in signal %s DBC %f and the actual value %f got in trace are not same ", signalname,default_value,signal_value); // Format and store the failure message in the buffer
        testStepFail("", buffer);                                           // Log the test step as failed
      }
    }
  else
    {
      snprintf(buffer, elCount(buffer), "CAN message is not found");   // Format and store the failure message in the buffer
      testStepFail("", buffer);  // Log the test step as failed
    }
}
//DLC check function
/*
msg- message name
msg_instance- declared corresponding message object in variable
*/
Check_DLC(dbMsg *msg,message *msg_instance)
{
  char buffer[100];                                                       // Buffer to store the formatted test result messages
  testStepBegin(Polarian_ID,"Test Case Started");                         // Log the start of the test step with the associated Polarion ID
  if(testWaitForMessage(msg,WAIT_TIMEOUT) == 1)                           // Wait for the message within the specified timeout period
  {                                                                       // 1 indicates the message was received
    if(DLC_Value == canGetDataLength(msg_instance))                       // Check if the DLC value matches the expected value
    {
      snprintf(buffer, elCount(buffer), "DLC Value of Message & Expected DLC Value: %x & %x is as expected", canGetDataLength(msg_instance), DLC_Value);    // Format and store the success message in the buffer
      testStepPass("", buffer);                                           // Log the test step as passed
    }
    else
    {
      snprintf(buffer, elCount(buffer), "DLC Value of Message & Expected DLC Value: %x & %x is not expected", canGetDataLength(msg_instance), DLC_Value);   // Format and store the failure message in the buffer
      testStepFail("", buffer);                                           // Log the test step as failed
    }
  }
  else
  {
      snprintf(buffer, elCount(buffer), "CAN message is not found");   // Format and store the failure message in the buffer
      testStepFail("", buffer);  // Log the test step as failed
  }
}
//Cycle time check function
/*
aCycMinCycleTime- minimum cycle time
bCycMaxCycleTime- maximum cycle time
*/
CheckMsg(dbMsg *msg, float aCycMinCycleTime, float bCycMaxCycleTime)
{
  long Avg, Min, Max;                                                        // Variables to store cycle time statistics
  char buffer[100];
  testStepBegin(Polarian_ID,"Test Case Started");                            // Log the beginning of the test step with the Polarion ID 
  testWaitForTimeout(kTIMEOUT);                                              // Wait for the specified timeout to allow message 
  
  Avg = ChkQuery_StatProbeIntervalAvg(gCyccheckId);                          // Retrieve statistical data on message intervals
  Min = ChkQuery_StatProbeIntervalMin(gCyccheckId);
  Max = ChkQuery_StatProbeIntervalMax(gCyccheckId);
  if(testWaitForMessage(msg,WAIT_TIMEOUT) == 1)                             // Wait for the message within the specified timeout period
  {
    if(ChkQuery_NumEvents (gCyccheckId) > 0)                                   // Check if any events were captured for the given message ID
    {
      snprintf(buffer, elCount(buffer), "Periodicity of messages is not as expected");  // Log that the message periodicity is not as expected
      testStepFail("", buffer);
    
      snprintf(buffer, elCount(buffer), "Average Cycle Time: %dms", Avg);            // Log the cycle time statistics
      testStep("", buffer);
    
      snprintf(buffer, elCount(buffer), "Minimum Cycle Time: %dms", Min);
      testStep("", buffer);
    
      snprintf(buffer, elCount(buffer), "Maximum Cycle Time: %dms", Max);
      testStep("", buffer);
    
      snprintf(buffer, elCount(buffer), "Actual Cycle Time: %dms", Cycle_time);
      testStep("", buffer);
     }
    else
    {
      snprintf(buffer, elCount(buffer), "Periodicity of messages is as expected");      // Log that the message periodicity is as expected
      testStepPass("", buffer);
    
      snprintf(buffer, elCount(buffer), "Average Cycle Time: %dms", Avg);               // Log the cycle time statistics
      testStep("", buffer);
    
      snprintf(buffer, elCount(buffer), "Minimum Cycle Time: %dms", Min);
      testStep("", buffer);
    
      snprintf(buffer, elCount(buffer), "Maximum Cycle Time: %dms", Max);
      testStep("", buffer);
    
      snprintf(buffer, elCount(buffer), "Actual Cycle Time: %dms", Cycle_time);
      testStep("", buffer);
    }
  }
  else
  {
      snprintf(buffer, elCount(buffer), "CAN message is not found");   // Format and store the failure message in the buffer
      testStepFail("", buffer);  // Log the test step as failed
  }
}
