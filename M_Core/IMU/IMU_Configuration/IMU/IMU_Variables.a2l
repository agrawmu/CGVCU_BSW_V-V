/* @@@@ File written by CANAPE_VERSION 17 0 31 @@@@ */ ASAP2_VERSION 1 71
/begin PROJECT New ""
/begin MODULE New ""
/begin MOD_COMMON "" BYTE_ORDER MSB_LAST ALIGNMENT_BYTE 1 ALIGNMENT_WORD 2 ALIGNMENT_LONG 4 ALIGNMENT_INT64 8 ALIGNMENT_FLOAT16_IEEE 1 ALIGNMENT_FLOAT32_IEEE 4 ALIGNMENT_FLOAT64_IEEE 8 /end MOD_COMMON
/begin IF_DATA XCP
 /begin PROTOCOL_LAYER 0x0100 0x07D0 0x2710 0x00 0x00 0x00 0x00 0x00 0x08 0x08 BYTE_ORDER_MSB_LAST ADDRESS_GRANULARITY_BYTE OPTIONAL_CMD GET_DAQ_PROCESSOR_INFO OPTIONAL_CMD SHORT_UPLOAD OPTIONAL_CMD UPLOAD OPTIONAL_CMD SET_MTA OPTIONAL_CMD GET_COMM_MODE_INFO COMMUNICATION_MODE_SUPPORTED BLOCK SLAVE MASTER 0x2B 0xC8 /end PROTOCOL_LAYER
 /begin DAQ DYNAMIC 0x00 0x00 0x00 OPTIMISATION_TYPE_DEFAULT ADDRESS_EXTENSION_FREE IDENTIFICATION_FIELD_TYPE_ABSOLUTE GRANULARITY_ODT_ENTRY_SIZE_DAQ_BYTE 0x04 OVERLOAD_INDICATION_PID PRESCALER_SUPPORTED /begin STIM GRANULARITY_ODT_ENTRY_SIZE_STIM_BYTE 0x00 /end STIM /begin TIMESTAMP_SUPPORTED 0x01 SIZE_WORD UNIT_1MS /end TIMESTAMP_SUPPORTED /end DAQ
 /begin PAG 0x00 /end PAG
 /begin PGM PGM_MODE_ABSOLUTE 0x00 0x00 /end PGM
 /begin XCP_ON_CAN 0x0100 CAN_ID_MASTER 0x0731 CAN_ID_SLAVE 0x0732 BAUDRATE 0x07A120 SAMPLE_POINT 0x4B SAMPLE_RATE SINGLE BTL_CYCLES 0x08 SJW 0x02 SYNC_EDGE SINGLE /end XCP_ON_CAN
/end IF_DATA
/begin MOD_PAR "" /end MOD_PAR
/begin COMPU_VTAB_RANGE accelBwValue.CONVERSION "" 8 0 0 "ACCEL_BW_218_0" 1 1 "ACCEL_BW_218_1" 2 2 "ACCEL_BW_90_0" 3 3 "ACCEL_BW_44_8" 4 4 "ACCEL_BW_21_2" 5 5 "ACCEL_BW_10_2" 6 6 "ACCEL_BW_5_1" 7 7 "ACCEL_BW_420_0" DEFAULT_VALUE "" /end COMPU_VTAB_RANGE
/begin COMPU_VTAB_RANGE accelFsValue.CONVERSION "" 4 0 0 "ACCEL_2G" 1 1 "ACCEL_4G" 2 2 "ACCEL_8G" 3 3 "ACCEL_16G" DEFAULT_VALUE "" /end COMPU_VTAB_RANGE
/begin COMPU_VTAB_RANGE gyroBwValue.CONVERSION "" 7 0 0 "GYRO_BW_250" 1 1 "GYRO_BW_176" 2 2 "GYRO_BW_92" 3 3 "GYRO_BW_41" 4 4 "GYRO_BW_20" 5 5 "GYRO_BW_10" 6 6 "GYRO_BW_5" DEFAULT_VALUE "" /end COMPU_VTAB_RANGE
/begin COMPU_VTAB_RANGE gyroFsValue.CONVERSION "" 4 0 0 "GYRO_250" 1 1 "GYRO_500" 2 2 "GYRO_1000" 3 3 "GYRO_2000" DEFAULT_VALUE "" /end COMPU_VTAB_RANGE
/begin COMPU_VTAB Table_3896 "" TAB_VERB 4 0 "ACCEL_2G" 1 "ACCEL_4G" 2 "ACCEL_8G" 3 "ACCEL_16G" DEFAULT_VALUE "" /end COMPU_VTAB
/begin COMPU_VTAB Table_3897 "" TAB_VERB 4 0 "GYRO_250" 1 "GYRO_500" 2 "GYRO_1000" 3 "GYRO_2000" DEFAULT_VALUE "" /end COMPU_VTAB
/begin COMPU_VTAB Table_3898 "" TAB_VERB 8 0 "ACCEL_BW_218_0" 1 "ACCEL_BW_218_1" 2 "ACCEL_BW_90_0" 3 "ACCEL_BW_44_8" 4 "ACCEL_BW_21_2" 5 "ACCEL_BW_10_2" 6 "ACCEL_BW_5_1" 7 "ACCEL_BW_420_0" DEFAULT_VALUE "" /end COMPU_VTAB
/begin COMPU_VTAB Table_3899 "" TAB_VERB 7 0 "GYRO_BW_250" 1 "GYRO_BW_176" 2 "GYRO_BW_92" 3 "GYRO_BW_41" 4 "GYRO_BW_20" 5 "GYRO_BW_10" 6 "GYRO_BW_5" DEFAULT_VALUE "" /end COMPU_VTAB
/begin COMPU_METHOD accelBwValue.CONVERSION "enumeration table" TAB_VERB "%.0" "" COMPU_TAB_REF accelBwValue.CONVERSION /end COMPU_METHOD
/begin COMPU_METHOD accelFsValue.CONVERSION "enumeration table" TAB_VERB "%.0" "" COMPU_TAB_REF accelFsValue.CONVERSION /end COMPU_METHOD
/begin COMPU_METHOD gyroBwValue.CONVERSION "enumeration table" TAB_VERB "%.0" "" COMPU_TAB_REF gyroBwValue.CONVERSION /end COMPU_METHOD
/begin COMPU_METHOD gyroFsValue.CONVERSION "enumeration table" TAB_VERB "%.0" "" COMPU_TAB_REF gyroFsValue.CONVERSION /end COMPU_METHOD
/begin COMPU_METHOD Table_3896 "" TAB_VERB "%6.3" "" COMPU_TAB_REF Table_3896 /end COMPU_METHOD
/begin COMPU_METHOD Table_3897 "" TAB_VERB "%6.3" "" COMPU_TAB_REF Table_3897 /end COMPU_METHOD
/begin COMPU_METHOD Table_3898 "" TAB_VERB "%6.3" "" COMPU_TAB_REF Table_3898 /end COMPU_METHOD
/begin COMPU_METHOD Table_3899 "" TAB_VERB "%6.3" "" COMPU_TAB_REF Table_3899 /end COMPU_METHOD
/begin CHARACTERISTIC Accel._0_ "" VALUE 0x340F3CF4 __FLOAT32_IEEE_S 0 NO_COMPU_METHOD -3.40282346639e+38 3.40282346639e+38 FORMAT "%.15" /end CHARACTERISTIC
/begin CHARACTERISTIC Accel._1_ "" VALUE 0x340F3CF8 __FLOAT32_IEEE_S 0 NO_COMPU_METHOD -3.40282346639e+38 3.40282346639e+38 FORMAT "%.15" /end CHARACTERISTIC
/begin CHARACTERISTIC Accel._2_ "" VALUE 0x340F3CFC __FLOAT32_IEEE_S 0 NO_COMPU_METHOD -3.40282346639e+38 3.40282346639e+38 FORMAT "%.15" /end CHARACTERISTIC
/begin CHARACTERISTIC Accel_Calib._0_ "" VALUE 0x340F3D5C __FLOAT32_IEEE_S 0 NO_COMPU_METHOD -3.40282346639e+38 3.40282346639e+38 FORMAT "%.15" /end CHARACTERISTIC
/begin CHARACTERISTIC Accel_Calib._1_ "" VALUE 0x340F3D60 __FLOAT32_IEEE_S 0 NO_COMPU_METHOD -3.40282346639e+38 3.40282346639e+38 FORMAT "%.15" /end CHARACTERISTIC
/begin CHARACTERISTIC Accel_Calib._2_ "" VALUE 0x340F3D64 __FLOAT32_IEEE_S 0 NO_COMPU_METHOD -3.40282346639e+38 3.40282346639e+38 FORMAT "%.15" /end CHARACTERISTIC
/begin CHARACTERISTIC Gyro._0_ "" VALUE 0x340F3D00 __FLOAT32_IEEE_S 0 NO_COMPU_METHOD -3.40282346639e+38 3.40282346639e+38 FORMAT "%.15" /end CHARACTERISTIC
/begin CHARACTERISTIC Gyro._1_ "" VALUE 0x340F3D04 __FLOAT32_IEEE_S 0 NO_COMPU_METHOD -3.40282346639e+38 3.40282346639e+38 FORMAT "%.15" /end CHARACTERISTIC
/begin CHARACTERISTIC Gyro._2_ "" VALUE 0x340F3D08 __FLOAT32_IEEE_S 0 NO_COMPU_METHOD -3.40282346639e+38 3.40282346639e+38 FORMAT "%.15" /end CHARACTERISTIC
/begin CHARACTERISTIC Gyro_Calib._0_ "" VALUE 0x340F3D40 __FLOAT32_IEEE_S 0 NO_COMPU_METHOD -3.40282346639e+38 3.40282346639e+38 FORMAT "%.15" /end CHARACTERISTIC
/begin CHARACTERISTIC Gyro_Calib._1_ "" VALUE 0x340F3D44 __FLOAT32_IEEE_S 0 NO_COMPU_METHOD -3.40282346639e+38 3.40282346639e+38 FORMAT "%.15" /end CHARACTERISTIC
/begin CHARACTERISTIC Gyro_Calib._2_ "" VALUE 0x340F3D48 __FLOAT32_IEEE_S 0 NO_COMPU_METHOD -3.40282346639e+38 3.40282346639e+38 FORMAT "%.15" /end CHARACTERISTIC
/begin CHARACTERISTIC Imu_DevId "" VALUE 0x340F3D12 __UBYTE_S 0 NO_COMPU_METHOD 0 255 FORMAT "%.15" /end CHARACTERISTIC
/begin CHARACTERISTIC accelBwValue "" VALUE 0x34117624 __SLONG_S 0 accelBwValue.CONVERSION -2147483648 2147483647 FORMAT "%6.3" /end CHARACTERISTIC
/begin CHARACTERISTIC accelFsValue "" VALUE 0x340F3D88 __SLONG_S 0 accelFsValue.CONVERSION -2147483648 2147483647 FORMAT "%6.3" /end CHARACTERISTIC
/begin CHARACTERISTIC gyroBwValue "" VALUE 0x3411762C __SLONG_S 0 gyroBwValue.CONVERSION -2147483648 2147483647 FORMAT "%6.3" /end CHARACTERISTIC
/begin CHARACTERISTIC gyroFsValue "" VALUE 0x340F3D8C __SLONG_S 0 gyroFsValue.CONVERSION -2147483648 2147483647 FORMAT "%6.3" /end CHARACTERISTIC
/begin RECORD_LAYOUT __UBYTE_Z FNC_VALUES 1 UBYTE ROW_DIR DIRECT /end RECORD_LAYOUT
/begin RECORD_LAYOUT __UWORD_Z FNC_VALUES 1 UWORD ROW_DIR DIRECT /end RECORD_LAYOUT
/begin RECORD_LAYOUT __ULONG_Z FNC_VALUES 1 ULONG ROW_DIR DIRECT /end RECORD_LAYOUT
/begin RECORD_LAYOUT __SBYTE_Z FNC_VALUES 1 SBYTE ROW_DIR DIRECT /end RECORD_LAYOUT
/begin RECORD_LAYOUT __SWORD_Z FNC_VALUES 1 SWORD ROW_DIR DIRECT /end RECORD_LAYOUT
/begin RECORD_LAYOUT __SLONG_Z FNC_VALUES 1 SLONG ROW_DIR DIRECT /end RECORD_LAYOUT
/begin RECORD_LAYOUT __FLOAT32_IEEE_Z FNC_VALUES 1 FLOAT32_IEEE ROW_DIR DIRECT /end RECORD_LAYOUT
/begin RECORD_LAYOUT __FLOAT64_IEEE_Z FNC_VALUES 1 FLOAT64_IEEE ROW_DIR DIRECT /end RECORD_LAYOUT
/begin RECORD_LAYOUT __UBYTE_S FNC_VALUES 1 UBYTE COLUMN_DIR DIRECT /end RECORD_LAYOUT
/begin RECORD_LAYOUT __UWORD_S FNC_VALUES 1 UWORD COLUMN_DIR DIRECT /end RECORD_LAYOUT
/begin RECORD_LAYOUT __ULONG_S FNC_VALUES 1 ULONG COLUMN_DIR DIRECT /end RECORD_LAYOUT
/begin RECORD_LAYOUT __SBYTE_S FNC_VALUES 1 SBYTE COLUMN_DIR DIRECT /end RECORD_LAYOUT
/begin RECORD_LAYOUT __SWORD_S FNC_VALUES 1 SWORD COLUMN_DIR DIRECT /end RECORD_LAYOUT
/begin RECORD_LAYOUT __SLONG_S FNC_VALUES 1 SLONG COLUMN_DIR DIRECT /end RECORD_LAYOUT
/begin RECORD_LAYOUT __FLOAT32_IEEE_S FNC_VALUES 1 FLOAT32_IEEE COLUMN_DIR DIRECT /end RECORD_LAYOUT
/begin RECORD_LAYOUT __FLOAT64_IEEE_S FNC_VALUES 1 FLOAT64_IEEE COLUMN_DIR DIRECT /end RECORD_LAYOUT
/begin RECORD_LAYOUT SSV__UBYTE_S AXIS_PTS_X 1 UBYTE INDEX_INCR DIRECT /end RECORD_LAYOUT
/begin RECORD_LAYOUT SSV__UWORD_S AXIS_PTS_X 1 UWORD INDEX_INCR DIRECT /end RECORD_LAYOUT
/begin RECORD_LAYOUT SSV__ULONG_S AXIS_PTS_X 1 ULONG INDEX_INCR DIRECT /end RECORD_LAYOUT
/begin RECORD_LAYOUT SSV__SBYTE_S AXIS_PTS_X 1 SBYTE INDEX_INCR DIRECT /end RECORD_LAYOUT
/begin RECORD_LAYOUT SSV__SWORD_S AXIS_PTS_X 1 SWORD INDEX_INCR DIRECT /end RECORD_LAYOUT
/begin RECORD_LAYOUT SSV__SLONG_S AXIS_PTS_X 1 SLONG INDEX_INCR DIRECT /end RECORD_LAYOUT
/begin RECORD_LAYOUT SSV__FLOAT32_IEEE_S AXIS_PTS_X 1 FLOAT32_IEEE INDEX_INCR DIRECT /end RECORD_LAYOUT
/begin RECORD_LAYOUT SSV__FLOAT64_IEEE_S AXIS_PTS_X 1 FLOAT64_IEEE INDEX_INCR DIRECT /end RECORD_LAYOUT
/begin RECORD_LAYOUT __A_UINT64_Z FNC_VALUES 1 A_UINT64 ROW_DIR DIRECT /end RECORD_LAYOUT
/begin RECORD_LAYOUT __A_INT64_Z FNC_VALUES 1 A_INT64 ROW_DIR DIRECT /end RECORD_LAYOUT
/begin RECORD_LAYOUT __A_UINT64_S FNC_VALUES 1 A_UINT64 COLUMN_DIR DIRECT /end RECORD_LAYOUT
/begin RECORD_LAYOUT __A_INT64_S FNC_VALUES 1 A_INT64 COLUMN_DIR DIRECT /end RECORD_LAYOUT
/begin RECORD_LAYOUT SSV__A_UINT64_S AXIS_PTS_X 1 A_UINT64 INDEX_INCR DIRECT /end RECORD_LAYOUT
/begin RECORD_LAYOUT SSV__A_INT64_S AXIS_PTS_X 1 A_INT64 INDEX_INCR DIRECT /end RECORD_LAYOUT
/end MODULE
/end PROJECT
